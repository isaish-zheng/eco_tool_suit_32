ASAP2_VERSION 1 31
/begin PROJECT ProjectName "Project Comment Goes Here"
/begin HEADER "Header Comments go here" /end HEADER
/begin MODULE ModuleName "Module Comment Goes Here"
/begin MOD_COMMON "" /* Comment */ ALIGNMENT_BYTE 1 ALIGNMENT_WORD 1 ALIGNMENT_LONG 1 ALIGNMENT_FLOAT32_IEEE 1 ALIGNMENT_FLOAT64_IEEE 1 BYTE_ORDER MSB_FIRST DEPOSIT ABSOLUTE /end MOD_COMMON
/begin RECORD_LAYOUT Scalar_BOOLEAN FNC_VALUES 1 UBYTE COLUMN_DIR DIRECT /end RECORD_LAYOUT
/begin RECORD_LAYOUT Scalar_UBYTE FNC_VALUES 1 UBYTE COLUMN_DIR DIRECT /end RECORD_LAYOUT
/begin RECORD_LAYOUT Lookup1D_BYTE FNC_VALUES 1 SBYTE COLUMN_DIR DIRECT /end RECORD_LAYOUT
/begin RECORD_LAYOUT Lookup1D_X_BYTE AXIS_PTS_X 1 SBYTE INDEX_INCR DIRECT /end RECORD_LAYOUT
/begin RECORD_LAYOUT Lookup1D_UBYTE FNC_VALUES 1 UBYTE COLUMN_DIR DIRECT /end RECORD_LAYOUT
/begin RECORD_LAYOUT Lookup1D_X_UBYTE AXIS_PTS_X 1 UBYTE INDEX_INCR DIRECT /end RECORD_LAYOUT
/begin RECORD_LAYOUT Lookup1D_UWORD FNC_VALUES 1 UWORD COLUMN_DIR DIRECT /end RECORD_LAYOUT
/begin RECORD_LAYOUT Lookup1D_X_UWORD AXIS_PTS_X 1 UWORD INDEX_INCR DIRECT /end RECORD_LAYOUT
/begin RECORD_LAYOUT Lookup1D_WORD FNC_VALUES 1 SWORD COLUMN_DIR DIRECT /end RECORD_LAYOUT
/begin RECORD_LAYOUT Lookup1D_X_WORD AXIS_PTS_X 1 SWORD INDEX_INCR DIRECT /end RECORD_LAYOUT
/begin RECORD_LAYOUT Lookup1D_ULONG FNC_VALUES 1 ULONG COLUMN_DIR DIRECT /end RECORD_LAYOUT
/begin RECORD_LAYOUT Lookup1D_X_ULONG AXIS_PTS_X 1 ULONG INDEX_INCR DIRECT /end RECORD_LAYOUT
/begin RECORD_LAYOUT Lookup1D_SLONG FNC_VALUES 1 SLONG COLUMN_DIR DIRECT /end RECORD_LAYOUT
/begin RECORD_LAYOUT Lookup1D_X_LONG AXIS_PTS_X 1 SLONG INDEX_INCR DIRECT /end RECORD_LAYOUT
/begin RECORD_LAYOUT Lookup1D_FLOAT32_IEEE FNC_VALUES 1 FLOAT32_IEEE COLUMN_DIR DIRECT /end RECORD_LAYOUT
/begin RECORD_LAYOUT Lookup1D_X_FLOAT32_IEEE AXIS_PTS_X 1 FLOAT32_IEEE INDEX_INCR DIRECT /end RECORD_LAYOUT
/begin RECORD_LAYOUT Lookup1D_FLOAT64_IEEE FNC_VALUES 1 FLOAT64_IEEE COLUMN_DIR DIRECT /end RECORD_LAYOUT
/begin RECORD_LAYOUT Lookup1D_X_FLOAT64_IEEE AXIS_PTS_X 1 FLOAT64_IEEE INDEX_INCR DIRECT /end RECORD_LAYOUT
/begin RECORD_LAYOUT Lookup2D_BOOLEAN FNC_VALUES 1 UBYTE COLUMN_DIR DIRECT /end RECORD_LAYOUT
/begin RECORD_LAYOUT Lookup2D_X_BOOLEAN AXIS_PTS_X 1 UBYTE INDEX_INCR DIRECT /end RECORD_LAYOUT
/begin RECORD_LAYOUT Lookup2D_UBYTE FNC_VALUES 1 UBYTE COLUMN_DIR DIRECT /end RECORD_LAYOUT
/begin RECORD_LAYOUT Lookup2D_X_UBYTE AXIS_PTS_X 1 UBYTE INDEX_INCR DIRECT /end RECORD_LAYOUT
/begin RECORD_LAYOUT Lookup2D_BYTE FNC_VALUES 1 SBYTE COLUMN_DIR DIRECT /end RECORD_LAYOUT
/begin RECORD_LAYOUT Lookup2D_X_BYTE AXIS_PTS_X 1 SBYTE INDEX_INCR DIRECT /end RECORD_LAYOUT
/begin RECORD_LAYOUT Lookup2D_UWORD FNC_VALUES 1 UWORD COLUMN_DIR DIRECT /end RECORD_LAYOUT
/begin RECORD_LAYOUT Lookup2D_X_UWORD AXIS_PTS_X 1 UWORD INDEX_INCR DIRECT /end RECORD_LAYOUT
/begin RECORD_LAYOUT Lookup2D_WORD FNC_VALUES 1 SWORD COLUMN_DIR DIRECT /end RECORD_LAYOUT
/begin RECORD_LAYOUT Lookup2D_X_WORD AXIS_PTS_X 1 SWORD INDEX_INCR DIRECT /end RECORD_LAYOUT
/begin RECORD_LAYOUT Lookup2D_ULONG FNC_VALUES 1 ULONG COLUMN_DIR DIRECT /end RECORD_LAYOUT
/begin RECORD_LAYOUT Lookup2D_X_ULONG AXIS_PTS_X 1 ULONG INDEX_INCR DIRECT /end RECORD_LAYOUT
/begin RECORD_LAYOUT Lookup2D_LONG FNC_VALUES 1 SLONG COLUMN_DIR DIRECT /end RECORD_LAYOUT
/begin RECORD_LAYOUT Lookup2D_X_LONG AXIS_PTS_X 1 SLONG INDEX_INCR DIRECT /end RECORD_LAYOUT
/begin RECORD_LAYOUT Lookup2D_FLOAT32_IEEE FNC_VALUES 1 FLOAT32_IEEE COLUMN_DIR DIRECT /end RECORD_LAYOUT
/begin RECORD_LAYOUT Lookup2D_X_FLOAT32_IEEE AXIS_PTS_X 1 FLOAT32_IEEE INDEX_INCR DIRECT /end RECORD_LAYOUT
/begin RECORD_LAYOUT Lookup2D_FLOAT64_IEEE FNC_VALUES 1 FLOAT64_IEEE COLUMN_DIR DIRECT /end RECORD_LAYOUT
/begin RECORD_LAYOUT Lookup2D_X_FLOAT64_IEEE AXIS_PTS_X 1 FLOAT64_IEEE INDEX_INCR DIRECT /end RECORD_LAYOUT
/begin CHARACTERISTIC gcp_M1External_TopGear145KW_arPeakSpeed "特百佳145KW电机，峰值外特性的转矩" CURVE 0xfd1584 /* @ECU_Address@gcp_M1External_TopGear145KW_arPeakSpeed@ */ Lookup1D_FLOAT32_IEEE 0 SC_KZQ_EV2274A_4_1_CM_single -3.4E+38 3.4E+38
 /begin AXIS_DESCR COM_AXIS NO_INPUT_QUANTITY SC_KZQ_EV2274A_4_1_CM_single 9 -3.4E+38 3.4E+38 AXIS_PTS_REF gcp_M1External_TopGear145KW_arPeakTroque /end AXIS_DESCR
/end CHARACTERISTIC
/begin CHARACTERISTIC gcp_M1External_TopGear220KW_arPeakSpeed "特百佳220KW电机，峰值外特性的转矩" CURVE 0xfd15cc /* @ECU_Address@gcp_M1External_TopGear220KW_arPeakSpeed@ */ Lookup1D_FLOAT32_IEEE 0 SC_KZQ_EV2274A_4_1_CM_single -3.4E+38 3.4E+38
 /begin AXIS_DESCR COM_AXIS NO_INPUT_QUANTITY SC_KZQ_EV2274A_4_1_CM_single 12 -3.4E+38 3.4E+38 AXIS_PTS_REF gcp_M1External_TopGear220KW_arPeakTroque /end AXIS_DESCR
/end CHARACTERISTIC
/begin CHARACTERISTIC gcp_M1External_TopGear286KW_arPeakSpeed "特百佳286KW电机，峰值外特性的转矩" CURVE 0xfd162c /* @ECU_Address@gcp_M1External_TopGear286KW_arPeakSpeed@ */ Lookup1D_FLOAT32_IEEE 0 SC_KZQ_EV2274A_4_1_CM_single -3.4E+38 3.4E+38
 /begin AXIS_DESCR COM_AXIS NO_INPUT_QUANTITY SC_KZQ_EV2274A_4_1_CM_single 10 -3.4E+38 3.4E+38 AXIS_PTS_REF gcp_M1External_TopGear286KW_arPeakTroque /end AXIS_DESCR
/end CHARACTERISTIC
/begin CHARACTERISTIC gcp_M1External_TopGear315KW_arPeakSpeed "特百佳315KW电机，峰值外特性的转矩" CURVE 0xfd167c /* @ECU_Address@gcp_M1External_TopGear315KW_arPeakSpeed@ */ Lookup1D_FLOAT32_IEEE 0 SC_KZQ_EV2274A_4_1_CM_single -3.4E+38 3.4E+38
 /begin AXIS_DESCR COM_AXIS NO_INPUT_QUANTITY SC_KZQ_EV2274A_4_1_CM_single 10 -3.4E+38 3.4E+38 AXIS_PTS_REF gcp_M1External_TopGear315KW_arPeakTroque /end AXIS_DESCR
/end CHARACTERISTIC
/begin CHARACTERISTIC gcp_M1Eff_TopGear145KW_aarEff "效率，为数据，m(转矩)*n（转速）的矩阵" MAP 0xfd0030 /* @ECU_Address@gcp_M1Eff_TopGear145KW_aarEff@ */ Lookup2D_FLOAT32_IEEE 0 SC_KZQ_EV2274A_4_1_CM_single -3.4E+38 3.4E+38
 /begin AXIS_DESCR COM_AXIS NO_INPUT_QUANTITY SC_KZQ_EV2274A_4_1_CM_single 12 -3.4E+38 3.4E+38 AXIS_PTS_REF gcp_M1Eff_TopGear145KW_arSpeed /end AXIS_DESCR
 /begin AXIS_DESCR COM_AXIS NO_INPUT_QUANTITY SC_KZQ_EV2274A_4_1_CM_single 42 -3.4E+38 3.4E+38 AXIS_PTS_REF gcp_M1Eff_TopGear145KW_arTorque /end AXIS_DESCR
/end CHARACTERISTIC
/begin CHARACTERISTIC gcp_M1Eff_TopGear220KW_aarEff "效率，为数据，m(转矩)*n（转速）的矩阵" MAP 0xfd08e8 /* @ECU_Address@gcp_M1Eff_TopGear220KW_aarEff@ */ Lookup2D_FLOAT32_IEEE 0 SC_KZQ_EV2274A_4_1_CM_single -3.4E+38 3.4E+38
 /begin AXIS_DESCR COM_AXIS NO_INPUT_QUANTITY SC_KZQ_EV2274A_4_1_CM_single 11 -3.4E+38 3.4E+38 AXIS_PTS_REF gcp_M1Eff_TopGear220KW_arSpeed /end AXIS_DESCR
 /begin AXIS_DESCR COM_AXIS NO_INPUT_QUANTITY SC_KZQ_EV2274A_4_1_CM_single 28 -3.4E+38 3.4E+38 AXIS_PTS_REF gcp_M1Eff_TopGear220KW_arTorque /end AXIS_DESCR
/end CHARACTERISTIC
/begin CHARACTERISTIC gcp_M1Eff_TopGear286KW_aarEff "效率，为数据，m(转矩)*n（转速）的矩阵" MAP 0xfd0e54 /* @ECU_Address@gcp_M1Eff_TopGear286KW_aarEff@ */ Lookup2D_FLOAT32_IEEE 0 SC_KZQ_EV2274A_4_1_CM_single -3.4E+38 3.4E+38
 /begin AXIS_DESCR COM_AXIS NO_INPUT_QUANTITY SC_KZQ_EV2274A_4_1_CM_single 10 -3.4E+38 3.4E+38 AXIS_PTS_REF gcp_M1Eff_TopGear286KW_arSpeed /end AXIS_DESCR
 /begin AXIS_DESCR COM_AXIS NO_INPUT_QUANTITY SC_KZQ_EV2274A_4_1_CM_single 20 -3.4E+38 3.4E+38 AXIS_PTS_REF gcp_M1Eff_TopGear286KW_arTorque /end AXIS_DESCR
/end CHARACTERISTIC
/begin CHARACTERISTIC gcp_M1Eff_TopGear315KW_aarEff "效率，为数据，m(转矩)*n（转速）的矩阵" MAP 0xfd11ec /* @ECU_Address@gcp_M1Eff_TopGear315KW_aarEff@ */ Lookup2D_FLOAT32_IEEE 0 SC_KZQ_EV2274A_4_1_CM_single -3.4E+38 3.4E+38
 /begin AXIS_DESCR COM_AXIS NO_INPUT_QUANTITY SC_KZQ_EV2274A_4_1_CM_single 10 -3.4E+38 3.4E+38 AXIS_PTS_REF gcp_M1Eff_TopGear315KW_arSpeed /end AXIS_DESCR
 /begin AXIS_DESCR COM_AXIS NO_INPUT_QUANTITY SC_KZQ_EV2274A_4_1_CM_single 20 -3.4E+38 3.4E+38 AXIS_PTS_REF gcp_M1Eff_TopGear315KW_arTorque /end AXIS_DESCR
/end CHARACTERISTIC
/begin CHARACTERISTIC core_gp_xSwapBytes "" VALUE 0xfd0014 /* @ECU_Address@core_gp_xSwapBytes@ */ Scalar_BOOLEAN 0 SC_KZQ_EV2274A_4_1_CM_boolean 0 1 /end CHARACTERISTIC
/begin CHARACTERISTIC core_gcp_u8CanSDOCmd_ErrReply "0x80" VALUE 0xfd0009 /* @ECU_Address@core_gcp_u8CanSDOCmd_ErrReply@ */ Scalar_UBYTE 0 SC_KZQ_EV2274A_4_1_CM_uint8 0 255 /end CHARACTERISTIC
/begin CHARACTERISTIC core_gcp_u8CanSDOCmd_ErrReply_MainIndexMismatch "0x02" VALUE 0xfd000a /* @ECU_Address@core_gcp_u8CanSDOCmd_ErrReply_MainIndexMismatch@ */ Scalar_UBYTE 0 SC_KZQ_EV2274A_4_1_CM_uint8 0 255 /end CHARACTERISTIC
/begin CHARACTERISTIC core_gcp_u8CanSDOCmd_ErrReply_SubIndexMismatch "0x03" VALUE 0xfd000b /* @ECU_Address@core_gcp_u8CanSDOCmd_ErrReply_SubIndexMismatch@ */ Scalar_UBYTE 0 SC_KZQ_EV2274A_4_1_CM_uint8 0 255 /end CHARACTERISTIC
/begin CHARACTERISTIC core_gcp_u8CanSDOCmd_ErrReply_WrongCommand "0x01" VALUE 0xfd000c /* @ECU_Address@core_gcp_u8CanSDOCmd_ErrReply_WrongCommand@ */ Scalar_UBYTE 0 SC_KZQ_EV2274A_4_1_CM_uint8 0 255 /end CHARACTERISTIC
/begin CHARACTERISTIC core_gcp_u8CanSDOCmd_QuickWrite "0x20" VALUE 0xfd000d /* @ECU_Address@core_gcp_u8CanSDOCmd_QuickWrite@ */ Scalar_UBYTE 0 SC_KZQ_EV2274A_4_1_CM_uint8 0 255 /end CHARACTERISTIC
/begin CHARACTERISTIC core_gcp_u8CanSDOCmd_Write "0x23" VALUE 0xfd000e /* @ECU_Address@core_gcp_u8CanSDOCmd_Write@ */ Scalar_UBYTE 0 SC_KZQ_EV2274A_4_1_CM_uint8 0 255 /end CHARACTERISTIC
/begin AXIS_PTS gcp_M1External_TopGear145KW_arPeakTroque "特百佳145KW电机，峰值外特性的转矩" 0xfd15a8 /* @ECU_Address@gcp_M1External_TopGear145KW_arPeakTroque@ */ NO_INPUT_QUANTITY Lookup1D_X_FLOAT32_IEEE 0 SC_KZQ_EV2274A_4_1_CM_single 9 -3.4E+38 3.4E+38 /end AXIS_PTS
/begin AXIS_PTS gcp_M1External_TopGear220KW_arPeakTroque "特百佳220KW电机，峰值外特性的转矩" 0xfd15fc /* @ECU_Address@gcp_M1External_TopGear220KW_arPeakTroque@ */ NO_INPUT_QUANTITY Lookup1D_X_FLOAT32_IEEE 0 SC_KZQ_EV2274A_4_1_CM_single 12 -3.4E+38 3.4E+38 /end AXIS_PTS
/begin AXIS_PTS gcp_M1External_TopGear286KW_arPeakTroque "特百佳286KW电机，峰值外特性的转矩" 0xfd1654 /* @ECU_Address@gcp_M1External_TopGear286KW_arPeakTroque@ */ NO_INPUT_QUANTITY Lookup1D_X_FLOAT32_IEEE 0 SC_KZQ_EV2274A_4_1_CM_single 10 -3.4E+38 3.4E+38 /end AXIS_PTS
/begin AXIS_PTS gcp_M1External_TopGear315KW_arPeakTroque "特百佳315KW电机，峰值外特性的转矩" 0xfd16a4 /* @ECU_Address@gcp_M1External_TopGear315KW_arPeakTroque@ */ NO_INPUT_QUANTITY Lookup1D_X_FLOAT32_IEEE 0 SC_KZQ_EV2274A_4_1_CM_single 10 -3.4E+38 3.4E+38 /end AXIS_PTS
/begin AXIS_PTS gcp_M1Eff_TopGear145KW_arTorque "转矩，N.m，为Y轴，即行变量，m行，breakpoints 1" 0xfd0840 /* @ECU_Address@gcp_M1Eff_TopGear145KW_arTorque@ */ NO_INPUT_QUANTITY Lookup2D_X_FLOAT32_IEEE 0 SC_KZQ_EV2274A_4_1_CM_single 42 -3.4E+38 3.4E+38 /end AXIS_PTS
/begin AXIS_PTS gcp_M1Eff_TopGear145KW_arSpeed "转速，rpm，为X轴，即列变量，n列，breakpoints 2" 0xfd0810 /* @ECU_Address@gcp_M1Eff_TopGear145KW_arSpeed@ */ NO_INPUT_QUANTITY Lookup2D_X_FLOAT32_IEEE 0 SC_KZQ_EV2274A_4_1_CM_single 12 -3.4E+38 3.4E+38 /end AXIS_PTS
/begin AXIS_PTS gcp_M1Eff_TopGear220KW_arTorque "转矩，N.m，为Y轴，即行变量，m行，breakpoints 1" 0xfd0de4 /* @ECU_Address@gcp_M1Eff_TopGear220KW_arTorque@ */ NO_INPUT_QUANTITY Lookup2D_X_FLOAT32_IEEE 0 SC_KZQ_EV2274A_4_1_CM_single 28 -3.4E+38 3.4E+38 /end AXIS_PTS
/begin AXIS_PTS gcp_M1Eff_TopGear220KW_arSpeed "转速，rpm，为X轴，即列变量，n列，breakpoints 2" 0xfd0db8 /* @ECU_Address@gcp_M1Eff_TopGear220KW_arSpeed@ */ NO_INPUT_QUANTITY Lookup2D_X_FLOAT32_IEEE 0 SC_KZQ_EV2274A_4_1_CM_single 11 -3.4E+38 3.4E+38 /end AXIS_PTS
/begin AXIS_PTS gcp_M1Eff_TopGear286KW_arTorque "转矩，N.m，为Y轴，即行变量，m行，breakpoints 1" 0xfd119c /* @ECU_Address@gcp_M1Eff_TopGear286KW_arTorque@ */ NO_INPUT_QUANTITY Lookup2D_X_FLOAT32_IEEE 0 SC_KZQ_EV2274A_4_1_CM_single 20 -3.4E+38 3.4E+38 /end AXIS_PTS
/begin AXIS_PTS gcp_M1Eff_TopGear286KW_arSpeed "转速，rpm，为X轴，即列变量，n列，breakpoints 2" 0xfd1174 /* @ECU_Address@gcp_M1Eff_TopGear286KW_arSpeed@ */ NO_INPUT_QUANTITY Lookup2D_X_FLOAT32_IEEE 0 SC_KZQ_EV2274A_4_1_CM_single 10 -3.4E+38 3.4E+38 /end AXIS_PTS
/begin AXIS_PTS gcp_M1Eff_TopGear315KW_arTorque "转矩，N.m，为Y轴，即行变量，m行，breakpoints 1" 0xfd1534 /* @ECU_Address@gcp_M1Eff_TopGear315KW_arTorque@ */ NO_INPUT_QUANTITY Lookup2D_X_FLOAT32_IEEE 0 SC_KZQ_EV2274A_4_1_CM_single 20 -3.4E+38 3.4E+38 /end AXIS_PTS
/begin AXIS_PTS gcp_M1Eff_TopGear315KW_arSpeed "转速，rpm，为X轴，即列变量，n列，breakpoints 2" 0xfd150c /* @ECU_Address@gcp_M1Eff_TopGear315KW_arSpeed@ */ NO_INPUT_QUANTITY Lookup2D_X_FLOAT32_IEEE 0 SC_KZQ_EV2274A_4_1_CM_single 10 -3.4E+38 3.4E+38 /end AXIS_PTS
/begin COMPU_METHOD SC_KZQ_EV2274A_4_1_CM_single "Q = V" RAT_FUNC "%8.6" "" COEFFS 0 1 0 0 0 1 /end COMPU_METHOD
/begin COMPU_METHOD SC_KZQ_EV2274A_4_1_CM_boolean "Q = V" RAT_FUNC "%1.0" "" COEFFS 0 1 0 0 0 1 /end COMPU_METHOD
/begin COMPU_METHOD SC_KZQ_EV2274A_4_1_CM_uint8 "Q = V" RAT_FUNC "%3.0" "" COEFFS 0 1 0 0 0 1 /end COMPU_METHOD
/begin GROUP S48_value_To_uint8_4_1 "SC_KZQ_EV2274A_4_1/Main/CAN Status/value_To_uint8[4]1" /begin REF_CHARACTERISTIC core_gp_xSwapBytes /end REF_CHARACTERISTIC /end GROUP
/begin GROUP S48_value_To_uint8_4_2 "SC_KZQ_EV2274A_4_1/Main/CAN Status/value_To_uint8[4]2" /begin REF_CHARACTERISTIC core_gp_xSwapBytes /end REF_CHARACTERISTIC /end GROUP
/begin GROUP S49_fbM1Contol "SC_KZQ_EV2274A_4_1/Main/Control Layer/fbM1Contol"
 /begin REF_CHARACTERISTIC gcp_M1Eff_TopGear145KW_aarEff gcp_M1Eff_TopGear220KW_aarEff gcp_M1Eff_TopGear286KW_aarEff gcp_M1Eff_TopGear315KW_aarEff gcp_M1External_TopGear145KW_arPeakSpeed gcp_M1External_TopGear220KW_arPeakSpeed gcp_M1External_TopGear286KW_arPeakSpeed gcp_M1External_TopGear315KW_arPeakSpeed /end REF_CHARACTERISTIC
/end GROUP
/begin GROUP S51_SDO__0x7B "SC_KZQ_EV2274A_4_1/Main/GPS /SDO  0x7B" /begin SUB_GROUP S4856_Case_0x6520h_25888_ S4856_SDO_Error_Reply /end SUB_GROUP /end GROUP
/begin GROUP S51_value_To_uint8_4_ "SC_KZQ_EV2274A_4_1/Main/GPS /value_To_uint8[4]" /begin REF_CHARACTERISTIC core_gp_xSwapBytes /end REF_CHARACTERISTIC /end GROUP
/begin GROUP S51_value_To_uint8_4_1 "SC_KZQ_EV2274A_4_1/Main/GPS /value_To_uint8[4]1" /begin REF_CHARACTERISTIC core_gp_xSwapBytes /end REF_CHARACTERISTIC /end GROUP
/begin GROUP S51_value_To_uint8_4_2 "SC_KZQ_EV2274A_4_1/Main/GPS /value_To_uint8[4]2" /begin REF_CHARACTERISTIC core_gp_xSwapBytes /end REF_CHARACTERISTIC /end GROUP
/begin GROUP S51_value_To_uint8_4_3 "SC_KZQ_EV2274A_4_1/Main/GPS /value_To_uint8[4]3" /begin REF_CHARACTERISTIC core_gp_xSwapBytes /end REF_CHARACTERISTIC /end GROUP
/begin GROUP S51_value_To_uint8_4_4 "SC_KZQ_EV2274A_4_1/Main/GPS /value_To_uint8[4]4" /begin REF_CHARACTERISTIC core_gp_xSwapBytes /end REF_CHARACTERISTIC /end GROUP
/begin GROUP S51_value_To_uint8_4_5 "SC_KZQ_EV2274A_4_1/Main/GPS /value_To_uint8[4]5" /begin REF_CHARACTERISTIC core_gp_xSwapBytes /end REF_CHARACTERISTIC /end GROUP
/begin GROUP S1023_Case_0x6440h_25664_ "SC_KZQ_EV2274A_4_1/Main/CAN SDO/SDO  0x7C/Case 0x6440h(25664)"
 /begin SUB_GROUP S1031_SDO_Error_Reply S1031__Case_0x6440_001 S1031__Case_0x6440_002 S1031__Case_0x6440_003 S1031__Case_0x6440_004 S1031__Case_0x6440_005 S1031__Case_0x6440_006 S1031__Case_0x6440_007 S1031__Case_0x6440_008 S1031__Case_0x6440_009 S1031__Case_0x6440_010 S1031__Case_0x6440_011 S1031__Case_0x6440_012 S1031__Case_0x6440_013 S1031__Case_0x6440_014 S1031__Case_0x6440_015 S1031__Case_0x6440_016 /end SUB_GROUP
/end GROUP
/begin GROUP S1023_Case_0x6443h "SC_KZQ_EV2274A_4_1/Main/CAN SDO/SDO  0x7C/Case 0x6443h"
 /begin SUB_GROUP S1032_SDO_Error_Reply S1032__Case_0x6443_001 S1032__Case_0x6443_002 S1032__Case_0x6443_003 S1032__Case_0x6443_004 S1032__Case_0x6443_005 S1032__Case_0x6443_006 S1032__Case_0x6443_007 S1032__Case_0x6443_008 S1032__Case_0x6443_009 S1032__Case_0x6443_010 S1032__Case_0x6443_011 S1032__Case_0x6443_012 S1032__Case_0x6443_013 S1032__Case_0x6443_014 S1032__Case_0x6443_015 S1032__Case_0x6443_016 S1032__Case_0x6443_017 S1032__Case_0x6443_018 S1032__Case_0x6443_019 S1032__Case_0x6443_020 S1032__Case_0x6443_021 S1032__Case_0x6443_022 S1032__Case_0x6443_023 S1032__Case_0x6443_024 S1032__Case_0x6443_025 S1032__Case_0x6443_026 S1032__Case_0x6443_027 S1032__Case_0x6443_028 S1032__Case_0x6443_029 S1032__Case_0x6443_030 S1032__Case_0x6443_031 S1032__Case_0x6443_032 /end SUB_GROUP
/end GROUP
/begin GROUP S1023_Case_0x6445h "SC_KZQ_EV2274A_4_1/Main/CAN SDO/SDO  0x7C/Case 0x6445h"
 /begin SUB_GROUP S1033_SDO_Error_Reply S1033__Case_0x6445_001 S1033__Case_0x6445_002 S1033__Case_0x6445_003 S1033__Case_0x6445_004 S1033__Case_0x6445_030 S1033__Case_0x6445_040 S1033__Case_0x6445_041 S1033__Case_0x6445_042 S1033__Case_0x6445_043 S1033__Case_0x6445_044 S1033__Case_0x6445_045 S1033__Case_0x6445_046 S1033__Case_0x6445_060 S1033__Case_0x6445_061 S1033__Case_0x6445_062 S1033__Case_0x6445_080 S1033__Case_0x6445_081 S1033__Case_0x6445_090 S1033__Case_0x6445_091 S1033__Case_0x6445_092 S1033__Case_0x6445_093 S1033__Case_0x6445_180 /end SUB_GROUP
/end GROUP
/begin GROUP S1023_Case_0x6447h "SC_KZQ_EV2274A_4_1/Main/CAN SDO/SDO  0x7C/Case 0x6447h"
 /begin SUB_GROUP S1034_SDO_Error_Reply S1034__Case_0x6447_001 S1034__Case_0x6447_002 S1034__Case_0x6447_003 S1034__Case_0x6447_004 S1034__Case_0x6447_005 S1034__Case_0x6447_006 S1034__Case_0x6447_031 S1034__Case_0x6447_034 S1034__Case_0x6447_061 S1034__Case_0x6447_064 S1034__Case_0x6447_067 S1034__Case_0x6447_070 S1034__Case_0x6447_073 S1034__Case_0x6447_076 S1034__Case_0x6447_097 S1034__Case_0x6447_100 S1034__Case_0x6447_103 S1034__Case_0x6447_106 S1034__Case_0x6447_151 S1034__Case_0x6447_154 S1034__Case_0x6447_37 S1034__Case_0x6447_38 /end SUB_GROUP
/end GROUP
/begin GROUP S1023_Case_0x6508h "SC_KZQ_EV2274A_4_1/Main/CAN SDO/SDO  0x7C/Case 0x6508h"
 /begin SUB_GROUP S1035_SDO_Error_Reply S1035__Case_0x6508_001 S1035__Case_0x6508_010 S1035__Case_0x6508_020 /end SUB_GROUP
/end GROUP
/begin GROUP S1023_Case_0x6510h "SC_KZQ_EV2274A_4_1/Main/CAN SDO/SDO  0x7C/Case 0x6510h"
 /begin SUB_GROUP S1036_SDO_Error_Reply S1036__Case_0x6510_001 S1036__Case_0x6510_002 /end SUB_GROUP
/end GROUP
/begin GROUP S1023_SDO_Error_Reply "SC_KZQ_EV2274A_4_1/Main/CAN SDO/SDO  0x7C/SDO Error Reply"
 /begin REF_CHARACTERISTIC core_gcp_u8CanSDOCmd_ErrReply core_gcp_u8CanSDOCmd_ErrReply_MainIndexMismatch core_gcp_u8CanSDOCmd_ErrReply_SubIndexMismatch core_gcp_u8CanSDOCmd_ErrReply_WrongCommand /end REF_CHARACTERISTIC
/end GROUP
/begin GROUP S4856_Case_0x6520h_25888_ "SC_KZQ_EV2274A_4_1/Main/GPS /SDO  0x7B/Case 0x6520h(25888)"
 /begin SUB_GROUP S4873_SDO_Error_Reply S4873__Case_0x6520_001 S4873__Case_0x6520_002 S4873__Case_0x6520_003 S4873__Case_0x6520_004 S4873__Case_0x6520_005 S4873__Case_0x6520_010 S4873__Case_0x6520_011 /end SUB_GROUP
/end GROUP
/begin GROUP S4856_SDO_Error_Reply "SC_KZQ_EV2274A_4_1/Main/GPS /SDO  0x7B/SDO Error Reply"
 /begin REF_CHARACTERISTIC core_gcp_u8CanSDOCmd_ErrReply core_gcp_u8CanSDOCmd_ErrReply_MainIndexMismatch core_gcp_u8CanSDOCmd_ErrReply_SubIndexMismatch core_gcp_u8CanSDOCmd_ErrReply_WrongCommand /end REF_CHARACTERISTIC
/end GROUP
/begin GROUP S1031__Case_0x6440_001 "SC_KZQ_EV2274A_4_1/Main/CAN SDO/SDO  0x7C/Case 0x6440h(25664)/ Case 0x6440-001" /begin SUB_GROUP S1039_SDO_Reply /end SUB_GROUP /end GROUP
/begin GROUP S1031__Case_0x6440_002 "SC_KZQ_EV2274A_4_1/Main/CAN SDO/SDO  0x7C/Case 0x6440h(25664)/ Case 0x6440-002" /begin SUB_GROUP S1040_SDO_Reply /end SUB_GROUP /end GROUP
/begin GROUP S1031__Case_0x6440_003 "SC_KZQ_EV2274A_4_1/Main/CAN SDO/SDO  0x7C/Case 0x6440h(25664)/ Case 0x6440-003" /begin SUB_GROUP S1041_SDO_Reply /end SUB_GROUP /end GROUP
/begin GROUP S1031__Case_0x6440_004 "SC_KZQ_EV2274A_4_1/Main/CAN SDO/SDO  0x7C/Case 0x6440h(25664)/ Case 0x6440-004" /begin SUB_GROUP S1042_SDO_Reply /end SUB_GROUP /end GROUP
/begin GROUP S1031__Case_0x6440_005 "SC_KZQ_EV2274A_4_1/Main/CAN SDO/SDO  0x7C/Case 0x6440h(25664)/ Case 0x6440-005" /begin SUB_GROUP S1043_SDO_Reply /end SUB_GROUP /end GROUP
/begin GROUP S1031__Case_0x6440_006 "SC_KZQ_EV2274A_4_1/Main/CAN SDO/SDO  0x7C/Case 0x6440h(25664)/ Case 0x6440-006" /begin SUB_GROUP S1044_SDO_Reply /end SUB_GROUP /end GROUP
/begin GROUP S1031__Case_0x6440_007 "SC_KZQ_EV2274A_4_1/Main/CAN SDO/SDO  0x7C/Case 0x6440h(25664)/ Case 0x6440-007" /begin SUB_GROUP S1045_SDO_Reply /end SUB_GROUP /end GROUP
/begin GROUP S1031__Case_0x6440_008 "SC_KZQ_EV2274A_4_1/Main/CAN SDO/SDO  0x7C/Case 0x6440h(25664)/ Case 0x6440-008" /begin SUB_GROUP S1046_SDO_Reply /end SUB_GROUP /end GROUP
/begin GROUP S1031__Case_0x6440_009 "SC_KZQ_EV2274A_4_1/Main/CAN SDO/SDO  0x7C/Case 0x6440h(25664)/ Case 0x6440-009" /begin SUB_GROUP S1047_SDO_Reply /end SUB_GROUP /end GROUP
/begin GROUP S1031__Case_0x6440_010 "SC_KZQ_EV2274A_4_1/Main/CAN SDO/SDO  0x7C/Case 0x6440h(25664)/ Case 0x6440-010" /begin SUB_GROUP S1048_SDO_Reply /end SUB_GROUP /end GROUP
/begin GROUP S1031__Case_0x6440_011 "SC_KZQ_EV2274A_4_1/Main/CAN SDO/SDO  0x7C/Case 0x6440h(25664)/ Case 0x6440-011" /begin SUB_GROUP S1049_SDO_Reply /end SUB_GROUP /end GROUP
/begin GROUP S1031__Case_0x6440_012 "SC_KZQ_EV2274A_4_1/Main/CAN SDO/SDO  0x7C/Case 0x6440h(25664)/ Case 0x6440-012" /begin SUB_GROUP S1050_SDO_Reply /end SUB_GROUP /end GROUP
/begin GROUP S1031__Case_0x6440_013 "SC_KZQ_EV2274A_4_1/Main/CAN SDO/SDO  0x7C/Case 0x6440h(25664)/ Case 0x6440-013" /begin SUB_GROUP S1051_SDO_Reply /end SUB_GROUP /end GROUP
/begin GROUP S1031__Case_0x6440_014 "SC_KZQ_EV2274A_4_1/Main/CAN SDO/SDO  0x7C/Case 0x6440h(25664)/ Case 0x6440-014" /begin SUB_GROUP S1052_SDO_Reply /end SUB_GROUP /end GROUP
/begin GROUP S1031__Case_0x6440_015 "SC_KZQ_EV2274A_4_1/Main/CAN SDO/SDO  0x7C/Case 0x6440h(25664)/ Case 0x6440-015" /begin SUB_GROUP S1053_SDO_Reply /end SUB_GROUP /end GROUP
/begin GROUP S1031__Case_0x6440_016 "SC_KZQ_EV2274A_4_1/Main/CAN SDO/SDO  0x7C/Case 0x6440h(25664)/ Case 0x6440-016" /begin SUB_GROUP S1054_SDO_Reply /end SUB_GROUP /end GROUP
/begin GROUP S1031_SDO_Error_Reply "SC_KZQ_EV2274A_4_1/Main/CAN SDO/SDO  0x7C/Case 0x6440h(25664)/SDO Error Reply"
 /begin REF_CHARACTERISTIC core_gcp_u8CanSDOCmd_ErrReply core_gcp_u8CanSDOCmd_ErrReply_MainIndexMismatch core_gcp_u8CanSDOCmd_ErrReply_SubIndexMismatch core_gcp_u8CanSDOCmd_ErrReply_WrongCommand /end REF_CHARACTERISTIC
/end GROUP
/begin GROUP S1032__Case_0x6443_001 "SC_KZQ_EV2274A_4_1/Main/CAN SDO/SDO  0x7C/Case 0x6443h/ Case 0x6443-001" /begin SUB_GROUP S1637_SDO_Reply /end SUB_GROUP /end GROUP
/begin GROUP S1032__Case_0x6443_002 "SC_KZQ_EV2274A_4_1/Main/CAN SDO/SDO  0x7C/Case 0x6443h/ Case 0x6443-002" /begin SUB_GROUP S1638_SDO_Reply /end SUB_GROUP /end GROUP
/begin GROUP S1032__Case_0x6443_003 "SC_KZQ_EV2274A_4_1/Main/CAN SDO/SDO  0x7C/Case 0x6443h/ Case 0x6443-003" /begin SUB_GROUP S1639_SDO_Reply /end SUB_GROUP /end GROUP
/begin GROUP S1032__Case_0x6443_004 "SC_KZQ_EV2274A_4_1/Main/CAN SDO/SDO  0x7C/Case 0x6443h/ Case 0x6443-004" /begin SUB_GROUP S1640_SDO_Reply /end SUB_GROUP /end GROUP
/begin GROUP S1032__Case_0x6443_005 "SC_KZQ_EV2274A_4_1/Main/CAN SDO/SDO  0x7C/Case 0x6443h/ Case 0x6443-005" /begin SUB_GROUP S1641_SDO_Reply /end SUB_GROUP /end GROUP
/begin GROUP S1032__Case_0x6443_006 "SC_KZQ_EV2274A_4_1/Main/CAN SDO/SDO  0x7C/Case 0x6443h/ Case 0x6443-006" /begin SUB_GROUP S1642_SDO_Reply /end SUB_GROUP /end GROUP
/begin GROUP S1032__Case_0x6443_007 "SC_KZQ_EV2274A_4_1/Main/CAN SDO/SDO  0x7C/Case 0x6443h/ Case 0x6443-007" /begin SUB_GROUP S1643_SDO_Reply /end SUB_GROUP /end GROUP
/begin GROUP S1032__Case_0x6443_008 "SC_KZQ_EV2274A_4_1/Main/CAN SDO/SDO  0x7C/Case 0x6443h/ Case 0x6443-008" /begin SUB_GROUP S1644_SDO_Reply /end SUB_GROUP /end GROUP
/begin GROUP S1032__Case_0x6443_009 "SC_KZQ_EV2274A_4_1/Main/CAN SDO/SDO  0x7C/Case 0x6443h/ Case 0x6443-009" /begin SUB_GROUP S1645_SDO_Reply /end SUB_GROUP /end GROUP
/begin GROUP S1032__Case_0x6443_010 "SC_KZQ_EV2274A_4_1/Main/CAN SDO/SDO  0x7C/Case 0x6443h/ Case 0x6443-010" /begin SUB_GROUP S1646_SDO_Reply /end SUB_GROUP /end GROUP
/begin GROUP S1032__Case_0x6443_011 "SC_KZQ_EV2274A_4_1/Main/CAN SDO/SDO  0x7C/Case 0x6443h/ Case 0x6443-011" /begin SUB_GROUP S1647_SDO_Reply /end SUB_GROUP /end GROUP
/begin GROUP S1032__Case_0x6443_012 "SC_KZQ_EV2274A_4_1/Main/CAN SDO/SDO  0x7C/Case 0x6443h/ Case 0x6443-012" /begin SUB_GROUP S1648_SDO_Reply /end SUB_GROUP /end GROUP
/begin GROUP S1032__Case_0x6443_013 "SC_KZQ_EV2274A_4_1/Main/CAN SDO/SDO  0x7C/Case 0x6443h/ Case 0x6443-013" /begin SUB_GROUP S1649_SDO_Reply /end SUB_GROUP /end GROUP
/begin GROUP S1032__Case_0x6443_014 "SC_KZQ_EV2274A_4_1/Main/CAN SDO/SDO  0x7C/Case 0x6443h/ Case 0x6443-014" /begin SUB_GROUP S1650_SDO_Reply /end SUB_GROUP /end GROUP
/begin GROUP S1032__Case_0x6443_015 "SC_KZQ_EV2274A_4_1/Main/CAN SDO/SDO  0x7C/Case 0x6443h/ Case 0x6443-015" /begin SUB_GROUP S1651_SDO_Reply /end SUB_GROUP /end GROUP
/begin GROUP S1032__Case_0x6443_016 "SC_KZQ_EV2274A_4_1/Main/CAN SDO/SDO  0x7C/Case 0x6443h/ Case 0x6443-016" /begin SUB_GROUP S1652_SDO_Reply /end SUB_GROUP /end GROUP
/begin GROUP S1032__Case_0x6443_017 "SC_KZQ_EV2274A_4_1/Main/CAN SDO/SDO  0x7C/Case 0x6443h/ Case 0x6443-017" /begin SUB_GROUP S1653_SDO_Reply /end SUB_GROUP /end GROUP
/begin GROUP S1032__Case_0x6443_018 "SC_KZQ_EV2274A_4_1/Main/CAN SDO/SDO  0x7C/Case 0x6443h/ Case 0x6443-018" /begin SUB_GROUP S1654_SDO_Reply /end SUB_GROUP /end GROUP
/begin GROUP S1032__Case_0x6443_019 "SC_KZQ_EV2274A_4_1/Main/CAN SDO/SDO  0x7C/Case 0x6443h/ Case 0x6443-019" /begin SUB_GROUP S1655_SDO_Reply /end SUB_GROUP /end GROUP
/begin GROUP S1032__Case_0x6443_020 "SC_KZQ_EV2274A_4_1/Main/CAN SDO/SDO  0x7C/Case 0x6443h/ Case 0x6443-020" /begin SUB_GROUP S1656_SDO_Reply /end SUB_GROUP /end GROUP
/begin GROUP S1032__Case_0x6443_021 "SC_KZQ_EV2274A_4_1/Main/CAN SDO/SDO  0x7C/Case 0x6443h/ Case 0x6443-021" /begin SUB_GROUP S1657_SDO_Reply /end SUB_GROUP /end GROUP
/begin GROUP S1032__Case_0x6443_022 "SC_KZQ_EV2274A_4_1/Main/CAN SDO/SDO  0x7C/Case 0x6443h/ Case 0x6443-022" /begin SUB_GROUP S1658_SDO_Reply /end SUB_GROUP /end GROUP
/begin GROUP S1032__Case_0x6443_023 "SC_KZQ_EV2274A_4_1/Main/CAN SDO/SDO  0x7C/Case 0x6443h/ Case 0x6443-023" /begin SUB_GROUP S1659_SDO_Reply /end SUB_GROUP /end GROUP
/begin GROUP S1032__Case_0x6443_024 "SC_KZQ_EV2274A_4_1/Main/CAN SDO/SDO  0x7C/Case 0x6443h/ Case 0x6443-024" /begin SUB_GROUP S1660_SDO_Reply /end SUB_GROUP /end GROUP
/begin GROUP S1032__Case_0x6443_025 "SC_KZQ_EV2274A_4_1/Main/CAN SDO/SDO  0x7C/Case 0x6443h/ Case 0x6443-025" /begin SUB_GROUP S1661_SDO_Reply /end SUB_GROUP /end GROUP
/begin GROUP S1032__Case_0x6443_026 "SC_KZQ_EV2274A_4_1/Main/CAN SDO/SDO  0x7C/Case 0x6443h/ Case 0x6443-026" /begin SUB_GROUP S1662_SDO_Reply /end SUB_GROUP /end GROUP
/begin GROUP S1032__Case_0x6443_027 "SC_KZQ_EV2274A_4_1/Main/CAN SDO/SDO  0x7C/Case 0x6443h/ Case 0x6443-027" /begin SUB_GROUP S1663_SDO_Reply /end SUB_GROUP /end GROUP
/begin GROUP S1032__Case_0x6443_028 "SC_KZQ_EV2274A_4_1/Main/CAN SDO/SDO  0x7C/Case 0x6443h/ Case 0x6443-028" /begin SUB_GROUP S1664_SDO_Reply /end SUB_GROUP /end GROUP
/begin GROUP S1032__Case_0x6443_029 "SC_KZQ_EV2274A_4_1/Main/CAN SDO/SDO  0x7C/Case 0x6443h/ Case 0x6443-029" /begin SUB_GROUP S1665_SDO_Reply /end SUB_GROUP /end GROUP
/begin GROUP S1032__Case_0x6443_030 "SC_KZQ_EV2274A_4_1/Main/CAN SDO/SDO  0x7C/Case 0x6443h/ Case 0x6443-030" /begin SUB_GROUP S1666_SDO_Reply /end SUB_GROUP /end GROUP
/begin GROUP S1032__Case_0x6443_031 "SC_KZQ_EV2274A_4_1/Main/CAN SDO/SDO  0x7C/Case 0x6443h/ Case 0x6443-031" /begin SUB_GROUP S1667_SDO_Reply /end SUB_GROUP /end GROUP
/begin GROUP S1032__Case_0x6443_032 "SC_KZQ_EV2274A_4_1/Main/CAN SDO/SDO  0x7C/Case 0x6443h/ Case 0x6443-032" /begin SUB_GROUP S1668_SDO_Reply /end SUB_GROUP /end GROUP
/begin GROUP S1032_SDO_Error_Reply "SC_KZQ_EV2274A_4_1/Main/CAN SDO/SDO  0x7C/Case 0x6443h/SDO Error Reply"
 /begin REF_CHARACTERISTIC core_gcp_u8CanSDOCmd_ErrReply core_gcp_u8CanSDOCmd_ErrReply_MainIndexMismatch core_gcp_u8CanSDOCmd_ErrReply_SubIndexMismatch core_gcp_u8CanSDOCmd_ErrReply_WrongCommand /end REF_CHARACTERISTIC
/end GROUP
/begin GROUP S1033__Case_0x6445_001 "SC_KZQ_EV2274A_4_1/Main/CAN SDO/SDO  0x7C/Case 0x6445h/ Case 0x6445-001" /begin SUB_GROUP S2827_SDO_Reply /end SUB_GROUP /end GROUP
/begin GROUP S1033__Case_0x6445_002 "SC_KZQ_EV2274A_4_1/Main/CAN SDO/SDO  0x7C/Case 0x6445h/ Case 0x6445-002" /begin SUB_GROUP S2828_SDO_Reply /end SUB_GROUP /end GROUP
/begin GROUP S1033__Case_0x6445_003 "SC_KZQ_EV2274A_4_1/Main/CAN SDO/SDO  0x7C/Case 0x6445h/ Case 0x6445-003" /begin SUB_GROUP S2829_SDO_Reply /end SUB_GROUP /end GROUP
/begin GROUP S1033__Case_0x6445_004 "SC_KZQ_EV2274A_4_1/Main/CAN SDO/SDO  0x7C/Case 0x6445h/ Case 0x6445-004" /begin SUB_GROUP S2830_SDO_Reply /end SUB_GROUP /end GROUP
/begin GROUP S1033__Case_0x6445_030 "SC_KZQ_EV2274A_4_1/Main/CAN SDO/SDO  0x7C/Case 0x6445h/ Case 0x6445-030" /begin SUB_GROUP S2831_SDO_Reply /end SUB_GROUP /end GROUP
/begin GROUP S1033__Case_0x6445_040 "SC_KZQ_EV2274A_4_1/Main/CAN SDO/SDO  0x7C/Case 0x6445h/ Case 0x6445-040" /begin SUB_GROUP S2832_SDO_Reply /end SUB_GROUP /end GROUP
/begin GROUP S1033__Case_0x6445_041 "SC_KZQ_EV2274A_4_1/Main/CAN SDO/SDO  0x7C/Case 0x6445h/ Case 0x6445-041" /begin SUB_GROUP S2833_SDO_Reply /end SUB_GROUP /end GROUP
/begin GROUP S1033__Case_0x6445_042 "SC_KZQ_EV2274A_4_1/Main/CAN SDO/SDO  0x7C/Case 0x6445h/ Case 0x6445-042" /begin SUB_GROUP S2834_SDO_Reply /end SUB_GROUP /end GROUP
/begin GROUP S1033__Case_0x6445_043 "SC_KZQ_EV2274A_4_1/Main/CAN SDO/SDO  0x7C/Case 0x6445h/ Case 0x6445-043" /begin SUB_GROUP S2835_SDO_Reply /end SUB_GROUP /end GROUP
/begin GROUP S1033__Case_0x6445_044 "SC_KZQ_EV2274A_4_1/Main/CAN SDO/SDO  0x7C/Case 0x6445h/ Case 0x6445-044" /begin SUB_GROUP S2836_SDO_Reply /end SUB_GROUP /end GROUP
/begin GROUP S1033__Case_0x6445_045 "SC_KZQ_EV2274A_4_1/Main/CAN SDO/SDO  0x7C/Case 0x6445h/ Case 0x6445-045" /begin SUB_GROUP S2837_SDO_Reply /end SUB_GROUP /end GROUP
/begin GROUP S1033__Case_0x6445_046 "SC_KZQ_EV2274A_4_1/Main/CAN SDO/SDO  0x7C/Case 0x6445h/ Case 0x6445-046" /begin SUB_GROUP S2838_SDO_Reply /end SUB_GROUP /end GROUP
/begin GROUP S1033__Case_0x6445_060 "SC_KZQ_EV2274A_4_1/Main/CAN SDO/SDO  0x7C/Case 0x6445h/ Case 0x6445-060" /begin SUB_GROUP S2839_SDO_Reply /end SUB_GROUP /end GROUP
/begin GROUP S1033__Case_0x6445_061 "SC_KZQ_EV2274A_4_1/Main/CAN SDO/SDO  0x7C/Case 0x6445h/ Case 0x6445-061" /begin SUB_GROUP S2840_SDO_Reply /end SUB_GROUP /end GROUP
/begin GROUP S1033__Case_0x6445_062 "SC_KZQ_EV2274A_4_1/Main/CAN SDO/SDO  0x7C/Case 0x6445h/ Case 0x6445-062" /begin SUB_GROUP S2841_SDO_Reply /end SUB_GROUP /end GROUP
/begin GROUP S1033__Case_0x6445_080 "SC_KZQ_EV2274A_4_1/Main/CAN SDO/SDO  0x7C/Case 0x6445h/ Case 0x6445-080" /begin SUB_GROUP S2842_SDO_Reply /end SUB_GROUP /end GROUP
/begin GROUP S1033__Case_0x6445_081 "SC_KZQ_EV2274A_4_1/Main/CAN SDO/SDO  0x7C/Case 0x6445h/ Case 0x6445-081" /begin SUB_GROUP S2843_SDO_Reply /end SUB_GROUP /end GROUP
/begin GROUP S1033__Case_0x6445_090 "SC_KZQ_EV2274A_4_1/Main/CAN SDO/SDO  0x7C/Case 0x6445h/ Case 0x6445-090" /begin SUB_GROUP S2844_SDO_Reply /end SUB_GROUP /end GROUP
/begin GROUP S1033__Case_0x6445_091 "SC_KZQ_EV2274A_4_1/Main/CAN SDO/SDO  0x7C/Case 0x6445h/ Case 0x6445-091" /begin SUB_GROUP S2845_SDO_Reply /end SUB_GROUP /end GROUP
/begin GROUP S1033__Case_0x6445_092 "SC_KZQ_EV2274A_4_1/Main/CAN SDO/SDO  0x7C/Case 0x6445h/ Case 0x6445-092" /begin SUB_GROUP S2846_SDO_Reply /end SUB_GROUP /end GROUP
/begin GROUP S1033__Case_0x6445_093 "SC_KZQ_EV2274A_4_1/Main/CAN SDO/SDO  0x7C/Case 0x6445h/ Case 0x6445-093" /begin SUB_GROUP S2847_SDO_Reply /end SUB_GROUP /end GROUP
/begin GROUP S1033__Case_0x6445_180 "SC_KZQ_EV2274A_4_1/Main/CAN SDO/SDO  0x7C/Case 0x6445h/ Case 0x6445-180" /begin SUB_GROUP S2848_SDO_Reply /end SUB_GROUP /end GROUP
/begin GROUP S1033_SDO_Error_Reply "SC_KZQ_EV2274A_4_1/Main/CAN SDO/SDO  0x7C/Case 0x6445h/SDO Error Reply"
 /begin REF_CHARACTERISTIC core_gcp_u8CanSDOCmd_ErrReply core_gcp_u8CanSDOCmd_ErrReply_MainIndexMismatch core_gcp_u8CanSDOCmd_ErrReply_SubIndexMismatch core_gcp_u8CanSDOCmd_ErrReply_WrongCommand /end REF_CHARACTERISTIC
/end GROUP
/begin GROUP S1034__Case_0x6447_001 "SC_KZQ_EV2274A_4_1/Main/CAN SDO/SDO  0x7C/Case 0x6447h/ Case 0x6447-001" /begin SUB_GROUP S3647_SDO_Reply /end SUB_GROUP /end GROUP
/begin GROUP S1034__Case_0x6447_002 "SC_KZQ_EV2274A_4_1/Main/CAN SDO/SDO  0x7C/Case 0x6447h/ Case 0x6447-002" /begin SUB_GROUP S3648_SDO_Reply /end SUB_GROUP /end GROUP
/begin GROUP S1034__Case_0x6447_003 "SC_KZQ_EV2274A_4_1/Main/CAN SDO/SDO  0x7C/Case 0x6447h/ Case 0x6447-003" /begin SUB_GROUP S3649_SDO_Reply /end SUB_GROUP /end GROUP
/begin GROUP S1034__Case_0x6447_004 "SC_KZQ_EV2274A_4_1/Main/CAN SDO/SDO  0x7C/Case 0x6447h/ Case 0x6447-004" /begin SUB_GROUP S3650_SDO_Reply /end SUB_GROUP /end GROUP
/begin GROUP S1034__Case_0x6447_005 "SC_KZQ_EV2274A_4_1/Main/CAN SDO/SDO  0x7C/Case 0x6447h/ Case 0x6447-005" /begin SUB_GROUP S3651_SDO_Reply /end SUB_GROUP /end GROUP
/begin GROUP S1034__Case_0x6447_006 "SC_KZQ_EV2274A_4_1/Main/CAN SDO/SDO  0x7C/Case 0x6447h/ Case 0x6447-006" /begin SUB_GROUP S3652_SDO_Reply /end SUB_GROUP /end GROUP
/begin GROUP S1034__Case_0x6447_031 "SC_KZQ_EV2274A_4_1/Main/CAN SDO/SDO  0x7C/Case 0x6447h/ Case 0x6447-031" /begin SUB_GROUP S3653_SDO_Reply /end SUB_GROUP /end GROUP
/begin GROUP S1034__Case_0x6447_034 "SC_KZQ_EV2274A_4_1/Main/CAN SDO/SDO  0x7C/Case 0x6447h/ Case 0x6447-034" /begin SUB_GROUP S3654_SDO_Reply /end SUB_GROUP /end GROUP
/begin GROUP S1034__Case_0x6447_061 "SC_KZQ_EV2274A_4_1/Main/CAN SDO/SDO  0x7C/Case 0x6447h/ Case 0x6447-061" /begin SUB_GROUP S3655_SDO_Reply /end SUB_GROUP /end GROUP
/begin GROUP S1034__Case_0x6447_064 "SC_KZQ_EV2274A_4_1/Main/CAN SDO/SDO  0x7C/Case 0x6447h/ Case 0x6447-064" /begin SUB_GROUP S3656_SDO_Reply /end SUB_GROUP /end GROUP
/begin GROUP S1034__Case_0x6447_067 "SC_KZQ_EV2274A_4_1/Main/CAN SDO/SDO  0x7C/Case 0x6447h/ Case 0x6447-067" /begin SUB_GROUP S3657_SDO_Reply /end SUB_GROUP /end GROUP
/begin GROUP S1034__Case_0x6447_070 "SC_KZQ_EV2274A_4_1/Main/CAN SDO/SDO  0x7C/Case 0x6447h/ Case 0x6447-070" /begin SUB_GROUP S3658_SDO_Reply /end SUB_GROUP /end GROUP
/begin GROUP S1034__Case_0x6447_073 "SC_KZQ_EV2274A_4_1/Main/CAN SDO/SDO  0x7C/Case 0x6447h/ Case 0x6447-073" /begin SUB_GROUP S3659_SDO_Reply /end SUB_GROUP /end GROUP
/begin GROUP S1034__Case_0x6447_076 "SC_KZQ_EV2274A_4_1/Main/CAN SDO/SDO  0x7C/Case 0x6447h/ Case 0x6447-076" /begin SUB_GROUP S3660_SDO_Reply /end SUB_GROUP /end GROUP
/begin GROUP S1034__Case_0x6447_097 "SC_KZQ_EV2274A_4_1/Main/CAN SDO/SDO  0x7C/Case 0x6447h/ Case 0x6447-097" /begin SUB_GROUP S3661_SDO_Reply /end SUB_GROUP /end GROUP
/begin GROUP S1034__Case_0x6447_100 "SC_KZQ_EV2274A_4_1/Main/CAN SDO/SDO  0x7C/Case 0x6447h/ Case 0x6447-100" /begin SUB_GROUP S3662_SDO_Reply /end SUB_GROUP /end GROUP
/begin GROUP S1034__Case_0x6447_103 "SC_KZQ_EV2274A_4_1/Main/CAN SDO/SDO  0x7C/Case 0x6447h/ Case 0x6447-103" /begin SUB_GROUP S3663_SDO_Reply /end SUB_GROUP /end GROUP
/begin GROUP S1034__Case_0x6447_106 "SC_KZQ_EV2274A_4_1/Main/CAN SDO/SDO  0x7C/Case 0x6447h/ Case 0x6447-106" /begin SUB_GROUP S3664_SDO_Reply /end SUB_GROUP /end GROUP
/begin GROUP S1034__Case_0x6447_151 "SC_KZQ_EV2274A_4_1/Main/CAN SDO/SDO  0x7C/Case 0x6447h/ Case 0x6447-151" /begin SUB_GROUP S3665_SDO_Reply /end SUB_GROUP /end GROUP
/begin GROUP S1034__Case_0x6447_154 "SC_KZQ_EV2274A_4_1/Main/CAN SDO/SDO  0x7C/Case 0x6447h/ Case 0x6447-154" /begin SUB_GROUP S3666_SDO_Reply /end SUB_GROUP /end GROUP
/begin GROUP S1034__Case_0x6447_37 "SC_KZQ_EV2274A_4_1/Main/CAN SDO/SDO  0x7C/Case 0x6447h/ Case 0x6447-37" /begin SUB_GROUP S3667_SDO_Reply /end SUB_GROUP /end GROUP
/begin GROUP S1034__Case_0x6447_38 "SC_KZQ_EV2274A_4_1/Main/CAN SDO/SDO  0x7C/Case 0x6447h/ Case 0x6447-38" /begin SUB_GROUP S3668_SDO_Reply /end SUB_GROUP /end GROUP
/begin GROUP S1034_SDO_Error_Reply "SC_KZQ_EV2274A_4_1/Main/CAN SDO/SDO  0x7C/Case 0x6447h/SDO Error Reply"
 /begin REF_CHARACTERISTIC core_gcp_u8CanSDOCmd_ErrReply core_gcp_u8CanSDOCmd_ErrReply_MainIndexMismatch core_gcp_u8CanSDOCmd_ErrReply_SubIndexMismatch core_gcp_u8CanSDOCmd_ErrReply_WrongCommand /end REF_CHARACTERISTIC
/end GROUP
/begin GROUP S1035__Case_0x6508_001 "SC_KZQ_EV2274A_4_1/Main/CAN SDO/SDO  0x7C/Case 0x6508h/ Case 0x6508-001" /begin SUB_GROUP S4467_SDO_Reply /end SUB_GROUP /end GROUP
/begin GROUP S1035__Case_0x6508_010 "SC_KZQ_EV2274A_4_1/Main/CAN SDO/SDO  0x7C/Case 0x6508h/ Case 0x6508-010" /begin SUB_GROUP S4468_SDO_Reply /end SUB_GROUP /end GROUP
/begin GROUP S1035__Case_0x6508_020 "SC_KZQ_EV2274A_4_1/Main/CAN SDO/SDO  0x7C/Case 0x6508h/ Case 0x6508-020" /begin SUB_GROUP S4469_SDO_Reply /end SUB_GROUP /end GROUP
/begin GROUP S1035_SDO_Error_Reply "SC_KZQ_EV2274A_4_1/Main/CAN SDO/SDO  0x7C/Case 0x6508h/SDO Error Reply"
 /begin REF_CHARACTERISTIC core_gcp_u8CanSDOCmd_ErrReply core_gcp_u8CanSDOCmd_ErrReply_MainIndexMismatch core_gcp_u8CanSDOCmd_ErrReply_SubIndexMismatch core_gcp_u8CanSDOCmd_ErrReply_WrongCommand /end REF_CHARACTERISTIC
/end GROUP
/begin GROUP S1036__Case_0x6510_001 "SC_KZQ_EV2274A_4_1/Main/CAN SDO/SDO  0x7C/Case 0x6510h/ Case 0x6510-001" /begin SUB_GROUP S4584_SDO_Reply /end SUB_GROUP /end GROUP
/begin GROUP S1036__Case_0x6510_002 "SC_KZQ_EV2274A_4_1/Main/CAN SDO/SDO  0x7C/Case 0x6510h/ Case 0x6510-002" /begin SUB_GROUP S4585_SDO_Reply /end SUB_GROUP /end GROUP
/begin GROUP S1036_SDO_Error_Reply "SC_KZQ_EV2274A_4_1/Main/CAN SDO/SDO  0x7C/Case 0x6510h/SDO Error Reply"
 /begin REF_CHARACTERISTIC core_gcp_u8CanSDOCmd_ErrReply core_gcp_u8CanSDOCmd_ErrReply_MainIndexMismatch core_gcp_u8CanSDOCmd_ErrReply_SubIndexMismatch core_gcp_u8CanSDOCmd_ErrReply_WrongCommand /end REF_CHARACTERISTIC
/end GROUP
/begin GROUP S4873__Case_0x6520_001 "SC_KZQ_EV2274A_4_1/Main/GPS /SDO  0x7B/Case 0x6520h(25888)/ Case 0x6520-001" /begin SUB_GROUP S4876_SDO_Reply /end SUB_GROUP /end GROUP
/begin GROUP S4873__Case_0x6520_002 "SC_KZQ_EV2274A_4_1/Main/GPS /SDO  0x7B/Case 0x6520h(25888)/ Case 0x6520-002" /begin SUB_GROUP S4877_SDO_Reply /end SUB_GROUP /end GROUP
/begin GROUP S4873__Case_0x6520_003 "SC_KZQ_EV2274A_4_1/Main/GPS /SDO  0x7B/Case 0x6520h(25888)/ Case 0x6520-003" /begin SUB_GROUP S4878_SDO_Reply /end SUB_GROUP /end GROUP
/begin GROUP S4873__Case_0x6520_004 "SC_KZQ_EV2274A_4_1/Main/GPS /SDO  0x7B/Case 0x6520h(25888)/ Case 0x6520-004" /begin SUB_GROUP S4879_SDO_Reply /end SUB_GROUP /end GROUP
/begin GROUP S4873__Case_0x6520_005 "SC_KZQ_EV2274A_4_1/Main/GPS /SDO  0x7B/Case 0x6520h(25888)/ Case 0x6520-005" /begin SUB_GROUP S4880_SDO_Reply /end SUB_GROUP /end GROUP
/begin GROUP S4873__Case_0x6520_010 "SC_KZQ_EV2274A_4_1/Main/GPS /SDO  0x7B/Case 0x6520h(25888)/ Case 0x6520-010" /begin SUB_GROUP S4881_SDO_Reply /end SUB_GROUP /begin REF_CHARACTERISTIC core_gcp_u8CanSDOCmd_QuickWrite /end REF_CHARACTERISTIC /end GROUP
/begin GROUP S4873__Case_0x6520_011 "SC_KZQ_EV2274A_4_1/Main/GPS /SDO  0x7B/Case 0x6520h(25888)/ Case 0x6520-011" /begin SUB_GROUP S4882_SDO_Reply /end SUB_GROUP /begin REF_CHARACTERISTIC core_gcp_u8CanSDOCmd_Write /end REF_CHARACTERISTIC /end GROUP
/begin GROUP S4873_SDO_Error_Reply "SC_KZQ_EV2274A_4_1/Main/GPS /SDO  0x7B/Case 0x6520h(25888)/SDO Error Reply"
 /begin REF_CHARACTERISTIC core_gcp_u8CanSDOCmd_ErrReply core_gcp_u8CanSDOCmd_ErrReply_MainIndexMismatch core_gcp_u8CanSDOCmd_ErrReply_SubIndexMismatch core_gcp_u8CanSDOCmd_ErrReply_WrongCommand /end REF_CHARACTERISTIC
/end GROUP
/begin GROUP S1039_SDO_Reply "SC_KZQ_EV2274A_4_1/Main/CAN SDO/SDO  0x7C/Case 0x6440h(25664)/ Case 0x6440-001/SDO Reply"
 /begin SUB_GROUP S1057_SDO_Error_Reply S1057_value_To_uint8_4_ S1057_value_To_uint8_4_1 /end SUB_GROUP
 /begin REF_CHARACTERISTIC core_gp_xSwapBytes /end REF_CHARACTERISTIC
/end GROUP
/begin GROUP S1040_SDO_Reply "SC_KZQ_EV2274A_4_1/Main/CAN SDO/SDO  0x7C/Case 0x6440h(25664)/ Case 0x6440-002/SDO Reply"
 /begin SUB_GROUP S1093_SDO_Error_Reply S1093_value_To_uint8_4_ S1093_value_To_uint8_4_1 /end SUB_GROUP
 /begin REF_CHARACTERISTIC core_gp_xSwapBytes /end REF_CHARACTERISTIC
/end GROUP
/begin GROUP S1041_SDO_Reply "SC_KZQ_EV2274A_4_1/Main/CAN SDO/SDO  0x7C/Case 0x6440h(25664)/ Case 0x6440-003/SDO Reply"
 /begin SUB_GROUP S1129_SDO_Error_Reply S1129_value_To_uint8_4_ S1129_value_To_uint8_4_1 /end SUB_GROUP
 /begin REF_CHARACTERISTIC core_gp_xSwapBytes /end REF_CHARACTERISTIC
/end GROUP
/begin GROUP S1042_SDO_Reply "SC_KZQ_EV2274A_4_1/Main/CAN SDO/SDO  0x7C/Case 0x6440h(25664)/ Case 0x6440-004/SDO Reply"
 /begin SUB_GROUP S1165_SDO_Error_Reply S1165_value_To_uint8_4_ S1165_value_To_uint8_4_1 /end SUB_GROUP
 /begin REF_CHARACTERISTIC core_gp_xSwapBytes /end REF_CHARACTERISTIC
/end GROUP
/begin GROUP S1043_SDO_Reply "SC_KZQ_EV2274A_4_1/Main/CAN SDO/SDO  0x7C/Case 0x6440h(25664)/ Case 0x6440-005/SDO Reply"
 /begin SUB_GROUP S1201_SDO_Error_Reply S1201_value_To_uint8_4_ S1201_value_To_uint8_4_1 /end SUB_GROUP
 /begin REF_CHARACTERISTIC core_gp_xSwapBytes /end REF_CHARACTERISTIC
/end GROUP
/begin GROUP S1044_SDO_Reply "SC_KZQ_EV2274A_4_1/Main/CAN SDO/SDO  0x7C/Case 0x6440h(25664)/ Case 0x6440-006/SDO Reply"
 /begin SUB_GROUP S1237_SDO_Error_Reply S1237_value_To_uint8_4_ S1237_value_To_uint8_4_1 /end SUB_GROUP
 /begin REF_CHARACTERISTIC core_gp_xSwapBytes /end REF_CHARACTERISTIC
/end GROUP
/begin GROUP S1045_SDO_Reply "SC_KZQ_EV2274A_4_1/Main/CAN SDO/SDO  0x7C/Case 0x6440h(25664)/ Case 0x6440-007/SDO Reply"
 /begin SUB_GROUP S1273_SDO_Error_Reply S1273_value_To_uint8_4_ S1273_value_To_uint8_4_1 /end SUB_GROUP
 /begin REF_CHARACTERISTIC core_gp_xSwapBytes /end REF_CHARACTERISTIC
/end GROUP
/begin GROUP S1046_SDO_Reply "SC_KZQ_EV2274A_4_1/Main/CAN SDO/SDO  0x7C/Case 0x6440h(25664)/ Case 0x6440-008/SDO Reply"
 /begin SUB_GROUP S1309_SDO_Error_Reply S1309_value_To_uint8_4_ S1309_value_To_uint8_4_1 /end SUB_GROUP
 /begin REF_CHARACTERISTIC core_gp_xSwapBytes /end REF_CHARACTERISTIC
/end GROUP
/begin GROUP S1047_SDO_Reply "SC_KZQ_EV2274A_4_1/Main/CAN SDO/SDO  0x7C/Case 0x6440h(25664)/ Case 0x6440-009/SDO Reply"
 /begin SUB_GROUP S1345_SDO_Error_Reply S1345_value_To_uint8_4_ S1345_value_To_uint8_4_1 /end SUB_GROUP
 /begin REF_CHARACTERISTIC core_gp_xSwapBytes /end REF_CHARACTERISTIC
/end GROUP
/begin GROUP S1048_SDO_Reply "SC_KZQ_EV2274A_4_1/Main/CAN SDO/SDO  0x7C/Case 0x6440h(25664)/ Case 0x6440-010/SDO Reply"
 /begin SUB_GROUP S1381_SDO_Error_Reply S1381_value_To_uint8_4_ S1381_value_To_uint8_4_1 /end SUB_GROUP
 /begin REF_CHARACTERISTIC core_gp_xSwapBytes /end REF_CHARACTERISTIC
/end GROUP
/begin GROUP S1049_SDO_Reply "SC_KZQ_EV2274A_4_1/Main/CAN SDO/SDO  0x7C/Case 0x6440h(25664)/ Case 0x6440-011/SDO Reply"
 /begin SUB_GROUP S1417_SDO_Error_Reply S1417_value_To_uint8_4_ S1417_value_To_uint8_4_1 /end SUB_GROUP
 /begin REF_CHARACTERISTIC core_gp_xSwapBytes /end REF_CHARACTERISTIC
/end GROUP
/begin GROUP S1050_SDO_Reply "SC_KZQ_EV2274A_4_1/Main/CAN SDO/SDO  0x7C/Case 0x6440h(25664)/ Case 0x6440-012/SDO Reply"
 /begin SUB_GROUP S1453_SDO_Error_Reply S1453_value_To_uint8_4_ S1453_value_To_uint8_4_1 /end SUB_GROUP
 /begin REF_CHARACTERISTIC core_gp_xSwapBytes /end REF_CHARACTERISTIC
/end GROUP
/begin GROUP S1051_SDO_Reply "SC_KZQ_EV2274A_4_1/Main/CAN SDO/SDO  0x7C/Case 0x6440h(25664)/ Case 0x6440-013/SDO Reply"
 /begin SUB_GROUP S1489_SDO_Error_Reply S1489_value_To_uint8_4_ S1489_value_To_uint8_4_1 /end SUB_GROUP
 /begin REF_CHARACTERISTIC core_gp_xSwapBytes /end REF_CHARACTERISTIC
/end GROUP
/begin GROUP S1052_SDO_Reply "SC_KZQ_EV2274A_4_1/Main/CAN SDO/SDO  0x7C/Case 0x6440h(25664)/ Case 0x6440-014/SDO Reply"
 /begin SUB_GROUP S1525_SDO_Error_Reply S1525_value_To_uint8_4_ S1525_value_To_uint8_4_1 /end SUB_GROUP
 /begin REF_CHARACTERISTIC core_gp_xSwapBytes /end REF_CHARACTERISTIC
/end GROUP
/begin GROUP S1053_SDO_Reply "SC_KZQ_EV2274A_4_1/Main/CAN SDO/SDO  0x7C/Case 0x6440h(25664)/ Case 0x6440-015/SDO Reply"
 /begin SUB_GROUP S1561_SDO_Error_Reply S1561_value_To_uint8_4_ S1561_value_To_uint8_4_1 /end SUB_GROUP
 /begin REF_CHARACTERISTIC core_gp_xSwapBytes /end REF_CHARACTERISTIC
/end GROUP
/begin GROUP S1054_SDO_Reply "SC_KZQ_EV2274A_4_1/Main/CAN SDO/SDO  0x7C/Case 0x6440h(25664)/ Case 0x6440-016/SDO Reply"
 /begin SUB_GROUP S1597_SDO_Error_Reply S1597_value_To_uint8_4_ S1597_value_To_uint8_4_1 /end SUB_GROUP
 /begin REF_CHARACTERISTIC core_gp_xSwapBytes /end REF_CHARACTERISTIC
/end GROUP
/begin GROUP S1637_SDO_Reply "SC_KZQ_EV2274A_4_1/Main/CAN SDO/SDO  0x7C/Case 0x6443h/ Case 0x6443-001/SDO Reply"
 /begin SUB_GROUP S1671_SDO_Error_Reply S1671_value_To_uint8_4_ S1671_value_To_uint8_4_1 /end SUB_GROUP
 /begin REF_CHARACTERISTIC core_gp_xSwapBytes /end REF_CHARACTERISTIC
/end GROUP
/begin GROUP S1638_SDO_Reply "SC_KZQ_EV2274A_4_1/Main/CAN SDO/SDO  0x7C/Case 0x6443h/ Case 0x6443-002/SDO Reply"
 /begin SUB_GROUP S1707_SDO_Error_Reply S1707_value_To_uint8_4_ S1707_value_To_uint8_4_1 /end SUB_GROUP
 /begin REF_CHARACTERISTIC core_gp_xSwapBytes /end REF_CHARACTERISTIC
/end GROUP
/begin GROUP S1639_SDO_Reply "SC_KZQ_EV2274A_4_1/Main/CAN SDO/SDO  0x7C/Case 0x6443h/ Case 0x6443-003/SDO Reply"
 /begin SUB_GROUP S1743_SDO_Error_Reply S1743_value_To_uint8_4_ S1743_value_To_uint8_4_1 /end SUB_GROUP
 /begin REF_CHARACTERISTIC core_gp_xSwapBytes /end REF_CHARACTERISTIC
/end GROUP
/begin GROUP S1640_SDO_Reply "SC_KZQ_EV2274A_4_1/Main/CAN SDO/SDO  0x7C/Case 0x6443h/ Case 0x6443-004/SDO Reply"
 /begin SUB_GROUP S1779_SDO_Error_Reply S1779_value_To_uint8_4_ S1779_value_To_uint8_4_1 /end SUB_GROUP
 /begin REF_CHARACTERISTIC core_gp_xSwapBytes /end REF_CHARACTERISTIC
/end GROUP
/begin GROUP S1641_SDO_Reply "SC_KZQ_EV2274A_4_1/Main/CAN SDO/SDO  0x7C/Case 0x6443h/ Case 0x6443-005/SDO Reply"
 /begin SUB_GROUP S1815_SDO_Error_Reply S1815_value_To_uint8_4_ S1815_value_To_uint8_4_1 /end SUB_GROUP
 /begin REF_CHARACTERISTIC core_gp_xSwapBytes /end REF_CHARACTERISTIC
/end GROUP
/begin GROUP S1642_SDO_Reply "SC_KZQ_EV2274A_4_1/Main/CAN SDO/SDO  0x7C/Case 0x6443h/ Case 0x6443-006/SDO Reply"
 /begin SUB_GROUP S1851_SDO_Error_Reply S1851_value_To_uint8_4_ S1851_value_To_uint8_4_1 /end SUB_GROUP
 /begin REF_CHARACTERISTIC core_gp_xSwapBytes /end REF_CHARACTERISTIC
/end GROUP
/begin GROUP S1643_SDO_Reply "SC_KZQ_EV2274A_4_1/Main/CAN SDO/SDO  0x7C/Case 0x6443h/ Case 0x6443-007/SDO Reply"
 /begin SUB_GROUP S1887_SDO_Error_Reply S1887_value_To_uint8_4_ S1887_value_To_uint8_4_1 /end SUB_GROUP
 /begin REF_CHARACTERISTIC core_gp_xSwapBytes /end REF_CHARACTERISTIC
/end GROUP
/begin GROUP S1644_SDO_Reply "SC_KZQ_EV2274A_4_1/Main/CAN SDO/SDO  0x7C/Case 0x6443h/ Case 0x6443-008/SDO Reply"
 /begin SUB_GROUP S1923_SDO_Error_Reply S1923_value_To_uint8_4_ S1923_value_To_uint8_4_1 /end SUB_GROUP
 /begin REF_CHARACTERISTIC core_gp_xSwapBytes /end REF_CHARACTERISTIC
/end GROUP
/begin GROUP S1645_SDO_Reply "SC_KZQ_EV2274A_4_1/Main/CAN SDO/SDO  0x7C/Case 0x6443h/ Case 0x6443-009/SDO Reply"
 /begin SUB_GROUP S1959_SDO_Error_Reply S1959_value_To_uint8_4_ S1959_value_To_uint8_4_1 /end SUB_GROUP
 /begin REF_CHARACTERISTIC core_gp_xSwapBytes /end REF_CHARACTERISTIC
/end GROUP
/begin GROUP S1646_SDO_Reply "SC_KZQ_EV2274A_4_1/Main/CAN SDO/SDO  0x7C/Case 0x6443h/ Case 0x6443-010/SDO Reply"
 /begin SUB_GROUP S1995_SDO_Error_Reply S1995_value_To_uint8_4_ S1995_value_To_uint8_4_1 /end SUB_GROUP
 /begin REF_CHARACTERISTIC core_gp_xSwapBytes /end REF_CHARACTERISTIC
/end GROUP
/begin GROUP S1647_SDO_Reply "SC_KZQ_EV2274A_4_1/Main/CAN SDO/SDO  0x7C/Case 0x6443h/ Case 0x6443-011/SDO Reply"
 /begin SUB_GROUP S2031_SDO_Error_Reply S2031_value_To_uint8_4_ S2031_value_To_uint8_4_1 /end SUB_GROUP
 /begin REF_CHARACTERISTIC core_gp_xSwapBytes /end REF_CHARACTERISTIC
/end GROUP
/begin GROUP S1648_SDO_Reply "SC_KZQ_EV2274A_4_1/Main/CAN SDO/SDO  0x7C/Case 0x6443h/ Case 0x6443-012/SDO Reply"
 /begin SUB_GROUP S2067_SDO_Error_Reply S2067_value_To_uint8_4_ S2067_value_To_uint8_4_1 /end SUB_GROUP
 /begin REF_CHARACTERISTIC core_gp_xSwapBytes /end REF_CHARACTERISTIC
/end GROUP
/begin GROUP S1649_SDO_Reply "SC_KZQ_EV2274A_4_1/Main/CAN SDO/SDO  0x7C/Case 0x6443h/ Case 0x6443-013/SDO Reply"
 /begin SUB_GROUP S2103_SDO_Error_Reply S2103_value_To_uint8_4_ S2103_value_To_uint8_4_1 /end SUB_GROUP
 /begin REF_CHARACTERISTIC core_gp_xSwapBytes /end REF_CHARACTERISTIC
/end GROUP
/begin GROUP S1650_SDO_Reply "SC_KZQ_EV2274A_4_1/Main/CAN SDO/SDO  0x7C/Case 0x6443h/ Case 0x6443-014/SDO Reply"
 /begin SUB_GROUP S2139_SDO_Error_Reply S2139_value_To_uint8_4_ S2139_value_To_uint8_4_1 /end SUB_GROUP
 /begin REF_CHARACTERISTIC core_gp_xSwapBytes /end REF_CHARACTERISTIC
/end GROUP
/begin GROUP S1651_SDO_Reply "SC_KZQ_EV2274A_4_1/Main/CAN SDO/SDO  0x7C/Case 0x6443h/ Case 0x6443-015/SDO Reply"
 /begin SUB_GROUP S2175_SDO_Error_Reply S2175_value_To_uint8_4_ S2175_value_To_uint8_4_1 /end SUB_GROUP
 /begin REF_CHARACTERISTIC core_gp_xSwapBytes /end REF_CHARACTERISTIC
/end GROUP
/begin GROUP S1652_SDO_Reply "SC_KZQ_EV2274A_4_1/Main/CAN SDO/SDO  0x7C/Case 0x6443h/ Case 0x6443-016/SDO Reply"
 /begin SUB_GROUP S2211_SDO_Error_Reply S2211_value_To_uint8_4_ S2211_value_To_uint8_4_1 /end SUB_GROUP
 /begin REF_CHARACTERISTIC core_gp_xSwapBytes /end REF_CHARACTERISTIC
/end GROUP
/begin GROUP S1653_SDO_Reply "SC_KZQ_EV2274A_4_1/Main/CAN SDO/SDO  0x7C/Case 0x6443h/ Case 0x6443-017/SDO Reply"
 /begin SUB_GROUP S2247_SDO_Error_Reply S2247_value_To_uint8_4_ S2247_value_To_uint8_4_1 /end SUB_GROUP
 /begin REF_CHARACTERISTIC core_gp_xSwapBytes /end REF_CHARACTERISTIC
/end GROUP
/begin GROUP S1654_SDO_Reply "SC_KZQ_EV2274A_4_1/Main/CAN SDO/SDO  0x7C/Case 0x6443h/ Case 0x6443-018/SDO Reply"
 /begin SUB_GROUP S2283_SDO_Error_Reply S2283_value_To_uint8_4_ S2283_value_To_uint8_4_1 /end SUB_GROUP
 /begin REF_CHARACTERISTIC core_gp_xSwapBytes /end REF_CHARACTERISTIC
/end GROUP
/begin GROUP S1655_SDO_Reply "SC_KZQ_EV2274A_4_1/Main/CAN SDO/SDO  0x7C/Case 0x6443h/ Case 0x6443-019/SDO Reply"
 /begin SUB_GROUP S2319_SDO_Error_Reply S2319_value_To_uint8_4_ S2319_value_To_uint8_4_1 /end SUB_GROUP
 /begin REF_CHARACTERISTIC core_gp_xSwapBytes /end REF_CHARACTERISTIC
/end GROUP
/begin GROUP S1656_SDO_Reply "SC_KZQ_EV2274A_4_1/Main/CAN SDO/SDO  0x7C/Case 0x6443h/ Case 0x6443-020/SDO Reply"
 /begin SUB_GROUP S2355_SDO_Error_Reply S2355_value_To_uint8_4_ S2355_value_To_uint8_4_1 /end SUB_GROUP
 /begin REF_CHARACTERISTIC core_gp_xSwapBytes /end REF_CHARACTERISTIC
/end GROUP
/begin GROUP S1657_SDO_Reply "SC_KZQ_EV2274A_4_1/Main/CAN SDO/SDO  0x7C/Case 0x6443h/ Case 0x6443-021/SDO Reply"
 /begin SUB_GROUP S2391_SDO_Error_Reply S2391_value_To_uint8_4_ S2391_value_To_uint8_4_1 /end SUB_GROUP
 /begin REF_CHARACTERISTIC core_gp_xSwapBytes /end REF_CHARACTERISTIC
/end GROUP
/begin GROUP S1658_SDO_Reply "SC_KZQ_EV2274A_4_1/Main/CAN SDO/SDO  0x7C/Case 0x6443h/ Case 0x6443-022/SDO Reply"
 /begin SUB_GROUP S2427_SDO_Error_Reply S2427_value_To_uint8_4_ S2427_value_To_uint8_4_1 /end SUB_GROUP
 /begin REF_CHARACTERISTIC core_gp_xSwapBytes /end REF_CHARACTERISTIC
/end GROUP
/begin GROUP S1659_SDO_Reply "SC_KZQ_EV2274A_4_1/Main/CAN SDO/SDO  0x7C/Case 0x6443h/ Case 0x6443-023/SDO Reply"
 /begin SUB_GROUP S2463_SDO_Error_Reply S2463_value_To_uint8_4_ S2463_value_To_uint8_4_1 /end SUB_GROUP
 /begin REF_CHARACTERISTIC core_gp_xSwapBytes /end REF_CHARACTERISTIC
/end GROUP
/begin GROUP S1660_SDO_Reply "SC_KZQ_EV2274A_4_1/Main/CAN SDO/SDO  0x7C/Case 0x6443h/ Case 0x6443-024/SDO Reply"
 /begin SUB_GROUP S2499_SDO_Error_Reply S2499_value_To_uint8_4_ S2499_value_To_uint8_4_1 /end SUB_GROUP
 /begin REF_CHARACTERISTIC core_gp_xSwapBytes /end REF_CHARACTERISTIC
/end GROUP
/begin GROUP S1661_SDO_Reply "SC_KZQ_EV2274A_4_1/Main/CAN SDO/SDO  0x7C/Case 0x6443h/ Case 0x6443-025/SDO Reply"
 /begin SUB_GROUP S2535_SDO_Error_Reply S2535_value_To_uint8_4_ S2535_value_To_uint8_4_1 /end SUB_GROUP
 /begin REF_CHARACTERISTIC core_gp_xSwapBytes /end REF_CHARACTERISTIC
/end GROUP
/begin GROUP S1662_SDO_Reply "SC_KZQ_EV2274A_4_1/Main/CAN SDO/SDO  0x7C/Case 0x6443h/ Case 0x6443-026/SDO Reply"
 /begin SUB_GROUP S2571_SDO_Error_Reply S2571_value_To_uint8_4_ S2571_value_To_uint8_4_1 /end SUB_GROUP
 /begin REF_CHARACTERISTIC core_gp_xSwapBytes /end REF_CHARACTERISTIC
/end GROUP
/begin GROUP S1663_SDO_Reply "SC_KZQ_EV2274A_4_1/Main/CAN SDO/SDO  0x7C/Case 0x6443h/ Case 0x6443-027/SDO Reply"
 /begin SUB_GROUP S2607_SDO_Error_Reply S2607_value_To_uint8_4_ S2607_value_To_uint8_4_1 /end SUB_GROUP
 /begin REF_CHARACTERISTIC core_gp_xSwapBytes /end REF_CHARACTERISTIC
/end GROUP
/begin GROUP S1664_SDO_Reply "SC_KZQ_EV2274A_4_1/Main/CAN SDO/SDO  0x7C/Case 0x6443h/ Case 0x6443-028/SDO Reply"
 /begin SUB_GROUP S2643_SDO_Error_Reply S2643_value_To_uint8_4_ S2643_value_To_uint8_4_1 /end SUB_GROUP
 /begin REF_CHARACTERISTIC core_gp_xSwapBytes /end REF_CHARACTERISTIC
/end GROUP
/begin GROUP S1665_SDO_Reply "SC_KZQ_EV2274A_4_1/Main/CAN SDO/SDO  0x7C/Case 0x6443h/ Case 0x6443-029/SDO Reply"
 /begin SUB_GROUP S2679_SDO_Error_Reply S2679_value_To_uint8_4_ S2679_value_To_uint8_4_1 /end SUB_GROUP
 /begin REF_CHARACTERISTIC core_gp_xSwapBytes /end REF_CHARACTERISTIC
/end GROUP
/begin GROUP S1666_SDO_Reply "SC_KZQ_EV2274A_4_1/Main/CAN SDO/SDO  0x7C/Case 0x6443h/ Case 0x6443-030/SDO Reply"
 /begin SUB_GROUP S2715_SDO_Error_Reply S2715_value_To_uint8_4_ S2715_value_To_uint8_4_1 /end SUB_GROUP
 /begin REF_CHARACTERISTIC core_gp_xSwapBytes /end REF_CHARACTERISTIC
/end GROUP
/begin GROUP S1667_SDO_Reply "SC_KZQ_EV2274A_4_1/Main/CAN SDO/SDO  0x7C/Case 0x6443h/ Case 0x6443-031/SDO Reply"
 /begin SUB_GROUP S2751_SDO_Error_Reply S2751_value_To_uint8_4_ S2751_value_To_uint8_4_1 /end SUB_GROUP
 /begin REF_CHARACTERISTIC core_gp_xSwapBytes /end REF_CHARACTERISTIC
/end GROUP
/begin GROUP S1668_SDO_Reply "SC_KZQ_EV2274A_4_1/Main/CAN SDO/SDO  0x7C/Case 0x6443h/ Case 0x6443-032/SDO Reply"
 /begin SUB_GROUP S2787_SDO_Error_Reply S2787_value_To_uint8_4_ S2787_value_To_uint8_4_1 /end SUB_GROUP
 /begin REF_CHARACTERISTIC core_gp_xSwapBytes /end REF_CHARACTERISTIC
/end GROUP
/begin GROUP S2827_SDO_Reply "SC_KZQ_EV2274A_4_1/Main/CAN SDO/SDO  0x7C/Case 0x6445h/ Case 0x6445-001/SDO Reply"
 /begin SUB_GROUP S2851_SDO_Error_Reply S2851_value_To_uint8_4_ S2851_value_To_uint8_4_1 /end SUB_GROUP
 /begin REF_CHARACTERISTIC core_gp_xSwapBytes /end REF_CHARACTERISTIC
/end GROUP
/begin GROUP S2828_SDO_Reply "SC_KZQ_EV2274A_4_1/Main/CAN SDO/SDO  0x7C/Case 0x6445h/ Case 0x6445-002/SDO Reply"
 /begin SUB_GROUP S2887_SDO_Error_Reply S2887_value_To_uint8_4_ S2887_value_To_uint8_4_1 /end SUB_GROUP
 /begin REF_CHARACTERISTIC core_gp_xSwapBytes /end REF_CHARACTERISTIC
/end GROUP
/begin GROUP S2829_SDO_Reply "SC_KZQ_EV2274A_4_1/Main/CAN SDO/SDO  0x7C/Case 0x6445h/ Case 0x6445-003/SDO Reply"
 /begin SUB_GROUP S2923_SDO_Error_Reply S2923_value_To_uint8_4_ S2923_value_To_uint8_4_1 /end SUB_GROUP
 /begin REF_CHARACTERISTIC core_gp_xSwapBytes /end REF_CHARACTERISTIC
/end GROUP
/begin GROUP S2830_SDO_Reply "SC_KZQ_EV2274A_4_1/Main/CAN SDO/SDO  0x7C/Case 0x6445h/ Case 0x6445-004/SDO Reply"
 /begin SUB_GROUP S2959_SDO_Error_Reply S2959_value_To_uint8_4_ S2959_value_To_uint8_4_1 /end SUB_GROUP
 /begin REF_CHARACTERISTIC core_gp_xSwapBytes /end REF_CHARACTERISTIC
/end GROUP
/begin GROUP S2831_SDO_Reply "SC_KZQ_EV2274A_4_1/Main/CAN SDO/SDO  0x7C/Case 0x6445h/ Case 0x6445-030/SDO Reply"
 /begin SUB_GROUP S2995_SDO_Error_Reply S2995_value_To_uint8_4_ S2995_value_To_uint8_4_1 /end SUB_GROUP
 /begin REF_CHARACTERISTIC core_gp_xSwapBytes /end REF_CHARACTERISTIC
/end GROUP
/begin GROUP S2832_SDO_Reply "SC_KZQ_EV2274A_4_1/Main/CAN SDO/SDO  0x7C/Case 0x6445h/ Case 0x6445-040/SDO Reply"
 /begin SUB_GROUP S3031_SDO_Error_Reply S3031_value_To_uint8_4_ S3031_value_To_uint8_4_1 /end SUB_GROUP
 /begin REF_CHARACTERISTIC core_gp_xSwapBytes /end REF_CHARACTERISTIC
/end GROUP
/begin GROUP S2833_SDO_Reply "SC_KZQ_EV2274A_4_1/Main/CAN SDO/SDO  0x7C/Case 0x6445h/ Case 0x6445-041/SDO Reply"
 /begin SUB_GROUP S3067_SDO_Error_Reply S3067_value_To_uint8_4_ S3067_value_To_uint8_4_1 /end SUB_GROUP
 /begin REF_CHARACTERISTIC core_gp_xSwapBytes /end REF_CHARACTERISTIC
/end GROUP
/begin GROUP S2834_SDO_Reply "SC_KZQ_EV2274A_4_1/Main/CAN SDO/SDO  0x7C/Case 0x6445h/ Case 0x6445-042/SDO Reply"
 /begin SUB_GROUP S3103_SDO_Error_Reply S3103_value_To_uint8_4_ S3103_value_To_uint8_4_1 /end SUB_GROUP
 /begin REF_CHARACTERISTIC core_gp_xSwapBytes /end REF_CHARACTERISTIC
/end GROUP
/begin GROUP S2835_SDO_Reply "SC_KZQ_EV2274A_4_1/Main/CAN SDO/SDO  0x7C/Case 0x6445h/ Case 0x6445-043/SDO Reply"
 /begin SUB_GROUP S3139_SDO_Error_Reply S3139_value_To_uint8_4_ S3139_value_To_uint8_4_1 /end SUB_GROUP
 /begin REF_CHARACTERISTIC core_gp_xSwapBytes /end REF_CHARACTERISTIC
/end GROUP
/begin GROUP S2836_SDO_Reply "SC_KZQ_EV2274A_4_1/Main/CAN SDO/SDO  0x7C/Case 0x6445h/ Case 0x6445-044/SDO Reply"
 /begin SUB_GROUP S3175_SDO_Error_Reply S3175_value_To_uint8_4_ S3175_value_To_uint8_4_1 /end SUB_GROUP
 /begin REF_CHARACTERISTIC core_gp_xSwapBytes /end REF_CHARACTERISTIC
/end GROUP
/begin GROUP S2837_SDO_Reply "SC_KZQ_EV2274A_4_1/Main/CAN SDO/SDO  0x7C/Case 0x6445h/ Case 0x6445-045/SDO Reply"
 /begin SUB_GROUP S3211_SDO_Error_Reply S3211_value_To_uint8_4_ S3211_value_To_uint8_4_1 /end SUB_GROUP
 /begin REF_CHARACTERISTIC core_gp_xSwapBytes /end REF_CHARACTERISTIC
/end GROUP
/begin GROUP S2838_SDO_Reply "SC_KZQ_EV2274A_4_1/Main/CAN SDO/SDO  0x7C/Case 0x6445h/ Case 0x6445-046/SDO Reply"
 /begin SUB_GROUP S3247_SDO_Error_Reply S3247_value_To_uint8_4_ S3247_value_To_uint8_4_1 /end SUB_GROUP
 /begin REF_CHARACTERISTIC core_gp_xSwapBytes /end REF_CHARACTERISTIC
/end GROUP
/begin GROUP S2839_SDO_Reply "SC_KZQ_EV2274A_4_1/Main/CAN SDO/SDO  0x7C/Case 0x6445h/ Case 0x6445-060/SDO Reply"
 /begin SUB_GROUP S3283_SDO_Error_Reply S3283_value_To_uint8_4_ S3283_value_To_uint8_4_1 /end SUB_GROUP
 /begin REF_CHARACTERISTIC core_gp_xSwapBytes /end REF_CHARACTERISTIC
/end GROUP
/begin GROUP S2840_SDO_Reply "SC_KZQ_EV2274A_4_1/Main/CAN SDO/SDO  0x7C/Case 0x6445h/ Case 0x6445-061/SDO Reply"
 /begin SUB_GROUP S3319_SDO_Error_Reply S3319_value_To_uint8_4_ S3319_value_To_uint8_4_1 /end SUB_GROUP
 /begin REF_CHARACTERISTIC core_gp_xSwapBytes /end REF_CHARACTERISTIC
/end GROUP
/begin GROUP S2841_SDO_Reply "SC_KZQ_EV2274A_4_1/Main/CAN SDO/SDO  0x7C/Case 0x6445h/ Case 0x6445-062/SDO Reply"
 /begin SUB_GROUP S3355_SDO_Error_Reply S3355_value_To_uint8_4_ S3355_value_To_uint8_4_1 /end SUB_GROUP
 /begin REF_CHARACTERISTIC core_gp_xSwapBytes /end REF_CHARACTERISTIC
/end GROUP
/begin GROUP S2842_SDO_Reply "SC_KZQ_EV2274A_4_1/Main/CAN SDO/SDO  0x7C/Case 0x6445h/ Case 0x6445-080/SDO Reply"
 /begin SUB_GROUP S3391_SDO_Error_Reply S3391_value_To_uint8_4_ S3391_value_To_uint8_4_1 /end SUB_GROUP
 /begin REF_CHARACTERISTIC core_gp_xSwapBytes /end REF_CHARACTERISTIC
/end GROUP
/begin GROUP S2843_SDO_Reply "SC_KZQ_EV2274A_4_1/Main/CAN SDO/SDO  0x7C/Case 0x6445h/ Case 0x6445-081/SDO Reply"
 /begin SUB_GROUP S3427_SDO_Error_Reply S3427_value_To_uint8_4_ S3427_value_To_uint8_4_1 /end SUB_GROUP
 /begin REF_CHARACTERISTIC core_gp_xSwapBytes /end REF_CHARACTERISTIC
/end GROUP
/begin GROUP S2844_SDO_Reply "SC_KZQ_EV2274A_4_1/Main/CAN SDO/SDO  0x7C/Case 0x6445h/ Case 0x6445-090/SDO Reply"
 /begin SUB_GROUP S3463_SDO_Error_Reply S3463_value_To_uint8_4_ S3463_value_To_uint8_4_1 /end SUB_GROUP
 /begin REF_CHARACTERISTIC core_gp_xSwapBytes /end REF_CHARACTERISTIC
/end GROUP
/begin GROUP S2845_SDO_Reply "SC_KZQ_EV2274A_4_1/Main/CAN SDO/SDO  0x7C/Case 0x6445h/ Case 0x6445-091/SDO Reply"
 /begin SUB_GROUP S3499_SDO_Error_Reply S3499_value_To_uint8_4_ S3499_value_To_uint8_4_1 /end SUB_GROUP
 /begin REF_CHARACTERISTIC core_gp_xSwapBytes /end REF_CHARACTERISTIC
/end GROUP
/begin GROUP S2846_SDO_Reply "SC_KZQ_EV2274A_4_1/Main/CAN SDO/SDO  0x7C/Case 0x6445h/ Case 0x6445-092/SDO Reply"
 /begin SUB_GROUP S3535_SDO_Error_Reply S3535_value_To_uint8_4_ S3535_value_To_uint8_4_1 /end SUB_GROUP
 /begin REF_CHARACTERISTIC core_gp_xSwapBytes /end REF_CHARACTERISTIC
/end GROUP
/begin GROUP S2847_SDO_Reply "SC_KZQ_EV2274A_4_1/Main/CAN SDO/SDO  0x7C/Case 0x6445h/ Case 0x6445-093/SDO Reply"
 /begin SUB_GROUP S3571_SDO_Error_Reply S3571_value_To_uint8_4_ S3571_value_To_uint8_4_1 /end SUB_GROUP
 /begin REF_CHARACTERISTIC core_gp_xSwapBytes /end REF_CHARACTERISTIC
/end GROUP
/begin GROUP S2848_SDO_Reply "SC_KZQ_EV2274A_4_1/Main/CAN SDO/SDO  0x7C/Case 0x6445h/ Case 0x6445-180/SDO Reply"
 /begin SUB_GROUP S3607_SDO_Error_Reply S3607_value_To_uint8_4_ S3607_value_To_uint8_4_1 /end SUB_GROUP
 /begin REF_CHARACTERISTIC core_gp_xSwapBytes /end REF_CHARACTERISTIC
/end GROUP
/begin GROUP S3647_SDO_Reply "SC_KZQ_EV2274A_4_1/Main/CAN SDO/SDO  0x7C/Case 0x6447h/ Case 0x6447-001/SDO Reply"
 /begin SUB_GROUP S3671_SDO_Error_Reply S3671_value_To_uint8_4_ S3671_value_To_uint8_4_1 /end SUB_GROUP
 /begin REF_CHARACTERISTIC core_gp_xSwapBytes /end REF_CHARACTERISTIC
/end GROUP
/begin GROUP S3648_SDO_Reply "SC_KZQ_EV2274A_4_1/Main/CAN SDO/SDO  0x7C/Case 0x6447h/ Case 0x6447-002/SDO Reply"
 /begin SUB_GROUP S3707_SDO_Error_Reply S3707_value_To_uint8_4_ S3707_value_To_uint8_4_1 /end SUB_GROUP
 /begin REF_CHARACTERISTIC core_gp_xSwapBytes /end REF_CHARACTERISTIC
/end GROUP
/begin GROUP S3649_SDO_Reply "SC_KZQ_EV2274A_4_1/Main/CAN SDO/SDO  0x7C/Case 0x6447h/ Case 0x6447-003/SDO Reply"
 /begin SUB_GROUP S3743_SDO_Error_Reply S3743_value_To_uint8_4_ S3743_value_To_uint8_4_1 /end SUB_GROUP
 /begin REF_CHARACTERISTIC core_gp_xSwapBytes /end REF_CHARACTERISTIC
/end GROUP
/begin GROUP S3650_SDO_Reply "SC_KZQ_EV2274A_4_1/Main/CAN SDO/SDO  0x7C/Case 0x6447h/ Case 0x6447-004/SDO Reply"
 /begin SUB_GROUP S3779_SDO_Error_Reply S3779_value_To_uint8_4_ S3779_value_To_uint8_4_1 /end SUB_GROUP
 /begin REF_CHARACTERISTIC core_gp_xSwapBytes /end REF_CHARACTERISTIC
/end GROUP
/begin GROUP S3651_SDO_Reply "SC_KZQ_EV2274A_4_1/Main/CAN SDO/SDO  0x7C/Case 0x6447h/ Case 0x6447-005/SDO Reply"
 /begin SUB_GROUP S3815_SDO_Error_Reply S3815_value_To_uint8_4_ S3815_value_To_uint8_4_1 /end SUB_GROUP
 /begin REF_CHARACTERISTIC core_gp_xSwapBytes /end REF_CHARACTERISTIC
/end GROUP
/begin GROUP S3652_SDO_Reply "SC_KZQ_EV2274A_4_1/Main/CAN SDO/SDO  0x7C/Case 0x6447h/ Case 0x6447-006/SDO Reply"
 /begin SUB_GROUP S3851_SDO_Error_Reply S3851_value_To_uint8_4_ S3851_value_To_uint8_4_1 /end SUB_GROUP
 /begin REF_CHARACTERISTIC core_gp_xSwapBytes /end REF_CHARACTERISTIC
/end GROUP
/begin GROUP S3653_SDO_Reply "SC_KZQ_EV2274A_4_1/Main/CAN SDO/SDO  0x7C/Case 0x6447h/ Case 0x6447-031/SDO Reply"
 /begin SUB_GROUP S3887_SDO_Error_Reply S3887_value_To_uint8_4_ S3887_value_To_uint8_4_1 /end SUB_GROUP
 /begin REF_CHARACTERISTIC core_gp_xSwapBytes /end REF_CHARACTERISTIC
/end GROUP
/begin GROUP S3654_SDO_Reply "SC_KZQ_EV2274A_4_1/Main/CAN SDO/SDO  0x7C/Case 0x6447h/ Case 0x6447-034/SDO Reply"
 /begin SUB_GROUP S3923_SDO_Error_Reply S3923_value_To_uint8_4_ S3923_value_To_uint8_4_1 /end SUB_GROUP
 /begin REF_CHARACTERISTIC core_gp_xSwapBytes /end REF_CHARACTERISTIC
/end GROUP
/begin GROUP S3655_SDO_Reply "SC_KZQ_EV2274A_4_1/Main/CAN SDO/SDO  0x7C/Case 0x6447h/ Case 0x6447-061/SDO Reply"
 /begin SUB_GROUP S3959_SDO_Error_Reply S3959_value_To_uint8_4_ S3959_value_To_uint8_4_1 /end SUB_GROUP
 /begin REF_CHARACTERISTIC core_gp_xSwapBytes /end REF_CHARACTERISTIC
/end GROUP
/begin GROUP S3656_SDO_Reply "SC_KZQ_EV2274A_4_1/Main/CAN SDO/SDO  0x7C/Case 0x6447h/ Case 0x6447-064/SDO Reply"
 /begin SUB_GROUP S3995_SDO_Error_Reply S3995_value_To_uint8_4_ S3995_value_To_uint8_4_1 /end SUB_GROUP
 /begin REF_CHARACTERISTIC core_gp_xSwapBytes /end REF_CHARACTERISTIC
/end GROUP
/begin GROUP S3657_SDO_Reply "SC_KZQ_EV2274A_4_1/Main/CAN SDO/SDO  0x7C/Case 0x6447h/ Case 0x6447-067/SDO Reply"
 /begin SUB_GROUP S4031_SDO_Error_Reply S4031_value_To_uint8_4_ S4031_value_To_uint8_4_1 /end SUB_GROUP
 /begin REF_CHARACTERISTIC core_gp_xSwapBytes /end REF_CHARACTERISTIC
/end GROUP
/begin GROUP S3658_SDO_Reply "SC_KZQ_EV2274A_4_1/Main/CAN SDO/SDO  0x7C/Case 0x6447h/ Case 0x6447-070/SDO Reply"
 /begin SUB_GROUP S4067_SDO_Error_Reply S4067_value_To_uint8_4_ S4067_value_To_uint8_4_1 /end SUB_GROUP
 /begin REF_CHARACTERISTIC core_gp_xSwapBytes /end REF_CHARACTERISTIC
/end GROUP
/begin GROUP S3659_SDO_Reply "SC_KZQ_EV2274A_4_1/Main/CAN SDO/SDO  0x7C/Case 0x6447h/ Case 0x6447-073/SDO Reply"
 /begin SUB_GROUP S4103_SDO_Error_Reply S4103_value_To_uint8_4_ S4103_value_To_uint8_4_1 /end SUB_GROUP
 /begin REF_CHARACTERISTIC core_gp_xSwapBytes /end REF_CHARACTERISTIC
/end GROUP
/begin GROUP S3660_SDO_Reply "SC_KZQ_EV2274A_4_1/Main/CAN SDO/SDO  0x7C/Case 0x6447h/ Case 0x6447-076/SDO Reply"
 /begin SUB_GROUP S4139_SDO_Error_Reply S4139_value_To_uint8_4_ S4139_value_To_uint8_4_1 /end SUB_GROUP
 /begin REF_CHARACTERISTIC core_gp_xSwapBytes /end REF_CHARACTERISTIC
/end GROUP
/begin GROUP S3661_SDO_Reply "SC_KZQ_EV2274A_4_1/Main/CAN SDO/SDO  0x7C/Case 0x6447h/ Case 0x6447-097/SDO Reply"
 /begin SUB_GROUP S4175_SDO_Error_Reply S4175_value_To_uint8_4_ S4175_value_To_uint8_4_1 /end SUB_GROUP
 /begin REF_CHARACTERISTIC core_gp_xSwapBytes /end REF_CHARACTERISTIC
/end GROUP
/begin GROUP S3662_SDO_Reply "SC_KZQ_EV2274A_4_1/Main/CAN SDO/SDO  0x7C/Case 0x6447h/ Case 0x6447-100/SDO Reply"
 /begin SUB_GROUP S4211_SDO_Error_Reply S4211_value_To_uint8_4_ S4211_value_To_uint8_4_1 /end SUB_GROUP
 /begin REF_CHARACTERISTIC core_gp_xSwapBytes /end REF_CHARACTERISTIC
/end GROUP
/begin GROUP S3663_SDO_Reply "SC_KZQ_EV2274A_4_1/Main/CAN SDO/SDO  0x7C/Case 0x6447h/ Case 0x6447-103/SDO Reply"
 /begin SUB_GROUP S4247_SDO_Error_Reply S4247_value_To_uint8_4_ S4247_value_To_uint8_4_1 /end SUB_GROUP
 /begin REF_CHARACTERISTIC core_gp_xSwapBytes /end REF_CHARACTERISTIC
/end GROUP
/begin GROUP S3664_SDO_Reply "SC_KZQ_EV2274A_4_1/Main/CAN SDO/SDO  0x7C/Case 0x6447h/ Case 0x6447-106/SDO Reply"
 /begin SUB_GROUP S4283_SDO_Error_Reply S4283_value_To_uint8_4_ S4283_value_To_uint8_4_1 /end SUB_GROUP
 /begin REF_CHARACTERISTIC core_gp_xSwapBytes /end REF_CHARACTERISTIC
/end GROUP
/begin GROUP S3665_SDO_Reply "SC_KZQ_EV2274A_4_1/Main/CAN SDO/SDO  0x7C/Case 0x6447h/ Case 0x6447-151/SDO Reply"
 /begin SUB_GROUP S4319_SDO_Error_Reply S4319_value_To_uint8_4_ S4319_value_To_uint8_4_1 /end SUB_GROUP
 /begin REF_CHARACTERISTIC core_gp_xSwapBytes /end REF_CHARACTERISTIC
/end GROUP
/begin GROUP S3666_SDO_Reply "SC_KZQ_EV2274A_4_1/Main/CAN SDO/SDO  0x7C/Case 0x6447h/ Case 0x6447-154/SDO Reply"
 /begin SUB_GROUP S4355_SDO_Error_Reply S4355_value_To_uint8_4_ S4355_value_To_uint8_4_1 /end SUB_GROUP
 /begin REF_CHARACTERISTIC core_gp_xSwapBytes /end REF_CHARACTERISTIC
/end GROUP
/begin GROUP S3667_SDO_Reply "SC_KZQ_EV2274A_4_1/Main/CAN SDO/SDO  0x7C/Case 0x6447h/ Case 0x6447-37/SDO Reply"
 /begin SUB_GROUP S4391_SDO_Error_Reply S4391_value_To_uint8_4_ S4391_value_To_uint8_4_1 /end SUB_GROUP
 /begin REF_CHARACTERISTIC core_gp_xSwapBytes /end REF_CHARACTERISTIC
/end GROUP
/begin GROUP S3668_SDO_Reply "SC_KZQ_EV2274A_4_1/Main/CAN SDO/SDO  0x7C/Case 0x6447h/ Case 0x6447-38/SDO Reply"
 /begin SUB_GROUP S4427_SDO_Error_Reply S4427_value_To_uint8_4_ S4427_value_To_uint8_4_1 /end SUB_GROUP
 /begin REF_CHARACTERISTIC core_gp_xSwapBytes /end REF_CHARACTERISTIC
/end GROUP
/begin GROUP S4467_SDO_Reply "SC_KZQ_EV2274A_4_1/Main/CAN SDO/SDO  0x7C/Case 0x6508h/ Case 0x6508-001/SDO Reply"
 /begin SUB_GROUP S4472_SDO_Error_Reply S4472_value_To_uint8_4_ S4472_value_To_uint8_4_1 /end SUB_GROUP
 /begin REF_CHARACTERISTIC core_gp_xSwapBytes /end REF_CHARACTERISTIC
/end GROUP
/begin GROUP S4468_SDO_Reply "SC_KZQ_EV2274A_4_1/Main/CAN SDO/SDO  0x7C/Case 0x6508h/ Case 0x6508-010/SDO Reply"
 /begin SUB_GROUP S4508_SDO_Error_Reply S4508_value_To_uint8_4_ S4508_value_To_uint8_4_1 /end SUB_GROUP
 /begin REF_CHARACTERISTIC core_gp_xSwapBytes /end REF_CHARACTERISTIC
/end GROUP
/begin GROUP S4469_SDO_Reply "SC_KZQ_EV2274A_4_1/Main/CAN SDO/SDO  0x7C/Case 0x6508h/ Case 0x6508-020/SDO Reply"
 /begin SUB_GROUP S4544_SDO_Error_Reply S4544_value_To_uint8_4_ S4544_value_To_uint8_4_1 /end SUB_GROUP
 /begin REF_CHARACTERISTIC core_gp_xSwapBytes /end REF_CHARACTERISTIC
/end GROUP
/begin GROUP S4584_SDO_Reply "SC_KZQ_EV2274A_4_1/Main/CAN SDO/SDO  0x7C/Case 0x6510h/ Case 0x6510-001/SDO Reply"
 /begin SUB_GROUP S4588_SDO_Error_Reply S4588_value_To_uint8_4_ S4588_value_To_uint8_4_1 /end SUB_GROUP
 /begin REF_CHARACTERISTIC core_gp_xSwapBytes /end REF_CHARACTERISTIC
/end GROUP
/begin GROUP S4585_SDO_Reply "SC_KZQ_EV2274A_4_1/Main/CAN SDO/SDO  0x7C/Case 0x6510h/ Case 0x6510-002/SDO Reply"
 /begin SUB_GROUP S4624_SDO_Error_Reply S4624_value_To_uint8_4_ S4624_value_To_uint8_4_1 /end SUB_GROUP
 /begin REF_CHARACTERISTIC core_gp_xSwapBytes /end REF_CHARACTERISTIC
/end GROUP
/begin GROUP S4876_SDO_Reply "SC_KZQ_EV2274A_4_1/Main/GPS /SDO  0x7B/Case 0x6520h(25888)/ Case 0x6520-001/SDO Reply"
 /begin SUB_GROUP S4885_SDO_Error_Reply S4885_value_To_uint8_4_ S4885_value_To_uint8_4_1 /end SUB_GROUP
 /begin REF_CHARACTERISTIC core_gp_xSwapBytes /end REF_CHARACTERISTIC
/end GROUP
/begin GROUP S4877_SDO_Reply "SC_KZQ_EV2274A_4_1/Main/GPS /SDO  0x7B/Case 0x6520h(25888)/ Case 0x6520-002/SDO Reply"
 /begin SUB_GROUP S4921_SDO_Error_Reply S4921_value_To_uint8_4_ S4921_value_To_uint8_4_1 /end SUB_GROUP
 /begin REF_CHARACTERISTIC core_gp_xSwapBytes /end REF_CHARACTERISTIC
/end GROUP
/begin GROUP S4878_SDO_Reply "SC_KZQ_EV2274A_4_1/Main/GPS /SDO  0x7B/Case 0x6520h(25888)/ Case 0x6520-003/SDO Reply"
 /begin SUB_GROUP S4957_SDO_Error_Reply S4957_value_To_uint8_4_ S4957_value_To_uint8_4_1 /end SUB_GROUP
 /begin REF_CHARACTERISTIC core_gp_xSwapBytes /end REF_CHARACTERISTIC
/end GROUP
/begin GROUP S4879_SDO_Reply "SC_KZQ_EV2274A_4_1/Main/GPS /SDO  0x7B/Case 0x6520h(25888)/ Case 0x6520-004/SDO Reply"
 /begin SUB_GROUP S4993_SDO_Error_Reply S4993_value_To_uint8_4_ S4993_value_To_uint8_4_1 /end SUB_GROUP
 /begin REF_CHARACTERISTIC core_gp_xSwapBytes /end REF_CHARACTERISTIC
/end GROUP
/begin GROUP S4880_SDO_Reply "SC_KZQ_EV2274A_4_1/Main/GPS /SDO  0x7B/Case 0x6520h(25888)/ Case 0x6520-005/SDO Reply"
 /begin SUB_GROUP S5029_SDO_Error_Reply S5029_value_To_uint8_4_ S5029_value_To_uint8_4_1 /end SUB_GROUP
 /begin REF_CHARACTERISTIC core_gp_xSwapBytes /end REF_CHARACTERISTIC
/end GROUP
/begin GROUP S4881_SDO_Reply "SC_KZQ_EV2274A_4_1/Main/GPS /SDO  0x7B/Case 0x6520h(25888)/ Case 0x6520-010/SDO Reply"
 /begin SUB_GROUP S5065_SDO_Error_Reply S5065_value_To_uint8_4_ S5065_value_To_uint8_4_1 /end SUB_GROUP
 /begin REF_CHARACTERISTIC core_gp_xSwapBytes /end REF_CHARACTERISTIC
/end GROUP
/begin GROUP S4882_SDO_Reply "SC_KZQ_EV2274A_4_1/Main/GPS /SDO  0x7B/Case 0x6520h(25888)/ Case 0x6520-011/SDO Reply"
 /begin SUB_GROUP S5102_SDO_Error_Reply S5102_value_To_uint8_4_ S5102_value_To_uint8_4_1 /end SUB_GROUP
 /begin REF_CHARACTERISTIC core_gp_xSwapBytes /end REF_CHARACTERISTIC
/end GROUP
/begin GROUP S1057_SDO_Error_Reply "SC_KZQ_EV2274A_4_1/Main/CAN SDO/SDO  0x7C/Case 0x6440h(25664)/ Case 0x6440-001/SDO Reply/SDO Error Reply"
 /begin REF_CHARACTERISTIC core_gcp_u8CanSDOCmd_ErrReply core_gcp_u8CanSDOCmd_ErrReply_MainIndexMismatch core_gcp_u8CanSDOCmd_ErrReply_SubIndexMismatch core_gcp_u8CanSDOCmd_ErrReply_WrongCommand /end REF_CHARACTERISTIC
/end GROUP
/begin GROUP S1057_value_To_uint8_4_ "SC_KZQ_EV2274A_4_1/Main/CAN SDO/SDO  0x7C/Case 0x6440h(25664)/ Case 0x6440-001/SDO Reply/value_To_uint8[4]" /begin REF_CHARACTERISTIC core_gp_xSwapBytes /end REF_CHARACTERISTIC /end GROUP
/begin GROUP S1057_value_To_uint8_4_1 "SC_KZQ_EV2274A_4_1/Main/CAN SDO/SDO  0x7C/Case 0x6440h(25664)/ Case 0x6440-001/SDO Reply/value_To_uint8[4]1" /begin REF_CHARACTERISTIC core_gp_xSwapBytes /end REF_CHARACTERISTIC /end GROUP
/begin GROUP S1093_SDO_Error_Reply "SC_KZQ_EV2274A_4_1/Main/CAN SDO/SDO  0x7C/Case 0x6440h(25664)/ Case 0x6440-002/SDO Reply/SDO Error Reply"
 /begin REF_CHARACTERISTIC core_gcp_u8CanSDOCmd_ErrReply core_gcp_u8CanSDOCmd_ErrReply_MainIndexMismatch core_gcp_u8CanSDOCmd_ErrReply_SubIndexMismatch core_gcp_u8CanSDOCmd_ErrReply_WrongCommand /end REF_CHARACTERISTIC
/end GROUP
/begin GROUP S1093_value_To_uint8_4_ "SC_KZQ_EV2274A_4_1/Main/CAN SDO/SDO  0x7C/Case 0x6440h(25664)/ Case 0x6440-002/SDO Reply/value_To_uint8[4]" /begin REF_CHARACTERISTIC core_gp_xSwapBytes /end REF_CHARACTERISTIC /end GROUP
/begin GROUP S1093_value_To_uint8_4_1 "SC_KZQ_EV2274A_4_1/Main/CAN SDO/SDO  0x7C/Case 0x6440h(25664)/ Case 0x6440-002/SDO Reply/value_To_uint8[4]1" /begin REF_CHARACTERISTIC core_gp_xSwapBytes /end REF_CHARACTERISTIC /end GROUP
/begin GROUP S1129_SDO_Error_Reply "SC_KZQ_EV2274A_4_1/Main/CAN SDO/SDO  0x7C/Case 0x6440h(25664)/ Case 0x6440-003/SDO Reply/SDO Error Reply"
 /begin REF_CHARACTERISTIC core_gcp_u8CanSDOCmd_ErrReply core_gcp_u8CanSDOCmd_ErrReply_MainIndexMismatch core_gcp_u8CanSDOCmd_ErrReply_SubIndexMismatch core_gcp_u8CanSDOCmd_ErrReply_WrongCommand /end REF_CHARACTERISTIC
/end GROUP
/begin GROUP S1129_value_To_uint8_4_ "SC_KZQ_EV2274A_4_1/Main/CAN SDO/SDO  0x7C/Case 0x6440h(25664)/ Case 0x6440-003/SDO Reply/value_To_uint8[4]" /begin REF_CHARACTERISTIC core_gp_xSwapBytes /end REF_CHARACTERISTIC /end GROUP
/begin GROUP S1129_value_To_uint8_4_1 "SC_KZQ_EV2274A_4_1/Main/CAN SDO/SDO  0x7C/Case 0x6440h(25664)/ Case 0x6440-003/SDO Reply/value_To_uint8[4]1" /begin REF_CHARACTERISTIC core_gp_xSwapBytes /end REF_CHARACTERISTIC /end GROUP
/begin GROUP S1165_SDO_Error_Reply "SC_KZQ_EV2274A_4_1/Main/CAN SDO/SDO  0x7C/Case 0x6440h(25664)/ Case 0x6440-004/SDO Reply/SDO Error Reply"
 /begin REF_CHARACTERISTIC core_gcp_u8CanSDOCmd_ErrReply core_gcp_u8CanSDOCmd_ErrReply_MainIndexMismatch core_gcp_u8CanSDOCmd_ErrReply_SubIndexMismatch core_gcp_u8CanSDOCmd_ErrReply_WrongCommand /end REF_CHARACTERISTIC
/end GROUP
/begin GROUP S1165_value_To_uint8_4_ "SC_KZQ_EV2274A_4_1/Main/CAN SDO/SDO  0x7C/Case 0x6440h(25664)/ Case 0x6440-004/SDO Reply/value_To_uint8[4]" /begin REF_CHARACTERISTIC core_gp_xSwapBytes /end REF_CHARACTERISTIC /end GROUP
/begin GROUP S1165_value_To_uint8_4_1 "SC_KZQ_EV2274A_4_1/Main/CAN SDO/SDO  0x7C/Case 0x6440h(25664)/ Case 0x6440-004/SDO Reply/value_To_uint8[4]1" /begin REF_CHARACTERISTIC core_gp_xSwapBytes /end REF_CHARACTERISTIC /end GROUP
/begin GROUP S1201_SDO_Error_Reply "SC_KZQ_EV2274A_4_1/Main/CAN SDO/SDO  0x7C/Case 0x6440h(25664)/ Case 0x6440-005/SDO Reply/SDO Error Reply"
 /begin REF_CHARACTERISTIC core_gcp_u8CanSDOCmd_ErrReply core_gcp_u8CanSDOCmd_ErrReply_MainIndexMismatch core_gcp_u8CanSDOCmd_ErrReply_SubIndexMismatch core_gcp_u8CanSDOCmd_ErrReply_WrongCommand /end REF_CHARACTERISTIC
/end GROUP
/begin GROUP S1201_value_To_uint8_4_ "SC_KZQ_EV2274A_4_1/Main/CAN SDO/SDO  0x7C/Case 0x6440h(25664)/ Case 0x6440-005/SDO Reply/value_To_uint8[4]" /begin REF_CHARACTERISTIC core_gp_xSwapBytes /end REF_CHARACTERISTIC /end GROUP
/begin GROUP S1201_value_To_uint8_4_1 "SC_KZQ_EV2274A_4_1/Main/CAN SDO/SDO  0x7C/Case 0x6440h(25664)/ Case 0x6440-005/SDO Reply/value_To_uint8[4]1" /begin REF_CHARACTERISTIC core_gp_xSwapBytes /end REF_CHARACTERISTIC /end GROUP
/begin GROUP S1237_SDO_Error_Reply "SC_KZQ_EV2274A_4_1/Main/CAN SDO/SDO  0x7C/Case 0x6440h(25664)/ Case 0x6440-006/SDO Reply/SDO Error Reply"
 /begin REF_CHARACTERISTIC core_gcp_u8CanSDOCmd_ErrReply core_gcp_u8CanSDOCmd_ErrReply_MainIndexMismatch core_gcp_u8CanSDOCmd_ErrReply_SubIndexMismatch core_gcp_u8CanSDOCmd_ErrReply_WrongCommand /end REF_CHARACTERISTIC
/end GROUP
/begin GROUP S1237_value_To_uint8_4_ "SC_KZQ_EV2274A_4_1/Main/CAN SDO/SDO  0x7C/Case 0x6440h(25664)/ Case 0x6440-006/SDO Reply/value_To_uint8[4]" /begin REF_CHARACTERISTIC core_gp_xSwapBytes /end REF_CHARACTERISTIC /end GROUP
/begin GROUP S1237_value_To_uint8_4_1 "SC_KZQ_EV2274A_4_1/Main/CAN SDO/SDO  0x7C/Case 0x6440h(25664)/ Case 0x6440-006/SDO Reply/value_To_uint8[4]1" /begin REF_CHARACTERISTIC core_gp_xSwapBytes /end REF_CHARACTERISTIC /end GROUP
/begin GROUP S1273_SDO_Error_Reply "SC_KZQ_EV2274A_4_1/Main/CAN SDO/SDO  0x7C/Case 0x6440h(25664)/ Case 0x6440-007/SDO Reply/SDO Error Reply"
 /begin REF_CHARACTERISTIC core_gcp_u8CanSDOCmd_ErrReply core_gcp_u8CanSDOCmd_ErrReply_MainIndexMismatch core_gcp_u8CanSDOCmd_ErrReply_SubIndexMismatch core_gcp_u8CanSDOCmd_ErrReply_WrongCommand /end REF_CHARACTERISTIC
/end GROUP
/begin GROUP S1273_value_To_uint8_4_ "SC_KZQ_EV2274A_4_1/Main/CAN SDO/SDO  0x7C/Case 0x6440h(25664)/ Case 0x6440-007/SDO Reply/value_To_uint8[4]" /begin REF_CHARACTERISTIC core_gp_xSwapBytes /end REF_CHARACTERISTIC /end GROUP
/begin GROUP S1273_value_To_uint8_4_1 "SC_KZQ_EV2274A_4_1/Main/CAN SDO/SDO  0x7C/Case 0x6440h(25664)/ Case 0x6440-007/SDO Reply/value_To_uint8[4]1" /begin REF_CHARACTERISTIC core_gp_xSwapBytes /end REF_CHARACTERISTIC /end GROUP
/begin GROUP S1309_SDO_Error_Reply "SC_KZQ_EV2274A_4_1/Main/CAN SDO/SDO  0x7C/Case 0x6440h(25664)/ Case 0x6440-008/SDO Reply/SDO Error Reply"
 /begin REF_CHARACTERISTIC core_gcp_u8CanSDOCmd_ErrReply core_gcp_u8CanSDOCmd_ErrReply_MainIndexMismatch core_gcp_u8CanSDOCmd_ErrReply_SubIndexMismatch core_gcp_u8CanSDOCmd_ErrReply_WrongCommand /end REF_CHARACTERISTIC
/end GROUP
/begin GROUP S1309_value_To_uint8_4_ "SC_KZQ_EV2274A_4_1/Main/CAN SDO/SDO  0x7C/Case 0x6440h(25664)/ Case 0x6440-008/SDO Reply/value_To_uint8[4]" /begin REF_CHARACTERISTIC core_gp_xSwapBytes /end REF_CHARACTERISTIC /end GROUP
/begin GROUP S1309_value_To_uint8_4_1 "SC_KZQ_EV2274A_4_1/Main/CAN SDO/SDO  0x7C/Case 0x6440h(25664)/ Case 0x6440-008/SDO Reply/value_To_uint8[4]1" /begin REF_CHARACTERISTIC core_gp_xSwapBytes /end REF_CHARACTERISTIC /end GROUP
/begin GROUP S1345_SDO_Error_Reply "SC_KZQ_EV2274A_4_1/Main/CAN SDO/SDO  0x7C/Case 0x6440h(25664)/ Case 0x6440-009/SDO Reply/SDO Error Reply"
 /begin REF_CHARACTERISTIC core_gcp_u8CanSDOCmd_ErrReply core_gcp_u8CanSDOCmd_ErrReply_MainIndexMismatch core_gcp_u8CanSDOCmd_ErrReply_SubIndexMismatch core_gcp_u8CanSDOCmd_ErrReply_WrongCommand /end REF_CHARACTERISTIC
/end GROUP
/begin GROUP S1345_value_To_uint8_4_ "SC_KZQ_EV2274A_4_1/Main/CAN SDO/SDO  0x7C/Case 0x6440h(25664)/ Case 0x6440-009/SDO Reply/value_To_uint8[4]" /begin REF_CHARACTERISTIC core_gp_xSwapBytes /end REF_CHARACTERISTIC /end GROUP
/begin GROUP S1345_value_To_uint8_4_1 "SC_KZQ_EV2274A_4_1/Main/CAN SDO/SDO  0x7C/Case 0x6440h(25664)/ Case 0x6440-009/SDO Reply/value_To_uint8[4]1" /begin REF_CHARACTERISTIC core_gp_xSwapBytes /end REF_CHARACTERISTIC /end GROUP
/begin GROUP S1381_SDO_Error_Reply "SC_KZQ_EV2274A_4_1/Main/CAN SDO/SDO  0x7C/Case 0x6440h(25664)/ Case 0x6440-010/SDO Reply/SDO Error Reply"
 /begin REF_CHARACTERISTIC core_gcp_u8CanSDOCmd_ErrReply core_gcp_u8CanSDOCmd_ErrReply_MainIndexMismatch core_gcp_u8CanSDOCmd_ErrReply_SubIndexMismatch core_gcp_u8CanSDOCmd_ErrReply_WrongCommand /end REF_CHARACTERISTIC
/end GROUP
/begin GROUP S1381_value_To_uint8_4_ "SC_KZQ_EV2274A_4_1/Main/CAN SDO/SDO  0x7C/Case 0x6440h(25664)/ Case 0x6440-010/SDO Reply/value_To_uint8[4]" /begin REF_CHARACTERISTIC core_gp_xSwapBytes /end REF_CHARACTERISTIC /end GROUP
/begin GROUP S1381_value_To_uint8_4_1 "SC_KZQ_EV2274A_4_1/Main/CAN SDO/SDO  0x7C/Case 0x6440h(25664)/ Case 0x6440-010/SDO Reply/value_To_uint8[4]1" /begin REF_CHARACTERISTIC core_gp_xSwapBytes /end REF_CHARACTERISTIC /end GROUP
/begin GROUP S1417_SDO_Error_Reply "SC_KZQ_EV2274A_4_1/Main/CAN SDO/SDO  0x7C/Case 0x6440h(25664)/ Case 0x6440-011/SDO Reply/SDO Error Reply"
 /begin REF_CHARACTERISTIC core_gcp_u8CanSDOCmd_ErrReply core_gcp_u8CanSDOCmd_ErrReply_MainIndexMismatch core_gcp_u8CanSDOCmd_ErrReply_SubIndexMismatch core_gcp_u8CanSDOCmd_ErrReply_WrongCommand /end REF_CHARACTERISTIC
/end GROUP
/begin GROUP S1417_value_To_uint8_4_ "SC_KZQ_EV2274A_4_1/Main/CAN SDO/SDO  0x7C/Case 0x6440h(25664)/ Case 0x6440-011/SDO Reply/value_To_uint8[4]" /begin REF_CHARACTERISTIC core_gp_xSwapBytes /end REF_CHARACTERISTIC /end GROUP
/begin GROUP S1417_value_To_uint8_4_1 "SC_KZQ_EV2274A_4_1/Main/CAN SDO/SDO  0x7C/Case 0x6440h(25664)/ Case 0x6440-011/SDO Reply/value_To_uint8[4]1" /begin REF_CHARACTERISTIC core_gp_xSwapBytes /end REF_CHARACTERISTIC /end GROUP
/begin GROUP S1453_SDO_Error_Reply "SC_KZQ_EV2274A_4_1/Main/CAN SDO/SDO  0x7C/Case 0x6440h(25664)/ Case 0x6440-012/SDO Reply/SDO Error Reply"
 /begin REF_CHARACTERISTIC core_gcp_u8CanSDOCmd_ErrReply core_gcp_u8CanSDOCmd_ErrReply_MainIndexMismatch core_gcp_u8CanSDOCmd_ErrReply_SubIndexMismatch core_gcp_u8CanSDOCmd_ErrReply_WrongCommand /end REF_CHARACTERISTIC
/end GROUP
/begin GROUP S1453_value_To_uint8_4_ "SC_KZQ_EV2274A_4_1/Main/CAN SDO/SDO  0x7C/Case 0x6440h(25664)/ Case 0x6440-012/SDO Reply/value_To_uint8[4]" /begin REF_CHARACTERISTIC core_gp_xSwapBytes /end REF_CHARACTERISTIC /end GROUP
/begin GROUP S1453_value_To_uint8_4_1 "SC_KZQ_EV2274A_4_1/Main/CAN SDO/SDO  0x7C/Case 0x6440h(25664)/ Case 0x6440-012/SDO Reply/value_To_uint8[4]1" /begin REF_CHARACTERISTIC core_gp_xSwapBytes /end REF_CHARACTERISTIC /end GROUP
/begin GROUP S1489_SDO_Error_Reply "SC_KZQ_EV2274A_4_1/Main/CAN SDO/SDO  0x7C/Case 0x6440h(25664)/ Case 0x6440-013/SDO Reply/SDO Error Reply"
 /begin REF_CHARACTERISTIC core_gcp_u8CanSDOCmd_ErrReply core_gcp_u8CanSDOCmd_ErrReply_MainIndexMismatch core_gcp_u8CanSDOCmd_ErrReply_SubIndexMismatch core_gcp_u8CanSDOCmd_ErrReply_WrongCommand /end REF_CHARACTERISTIC
/end GROUP
/begin GROUP S1489_value_To_uint8_4_ "SC_KZQ_EV2274A_4_1/Main/CAN SDO/SDO  0x7C/Case 0x6440h(25664)/ Case 0x6440-013/SDO Reply/value_To_uint8[4]" /begin REF_CHARACTERISTIC core_gp_xSwapBytes /end REF_CHARACTERISTIC /end GROUP
/begin GROUP S1489_value_To_uint8_4_1 "SC_KZQ_EV2274A_4_1/Main/CAN SDO/SDO  0x7C/Case 0x6440h(25664)/ Case 0x6440-013/SDO Reply/value_To_uint8[4]1" /begin REF_CHARACTERISTIC core_gp_xSwapBytes /end REF_CHARACTERISTIC /end GROUP
/begin GROUP S1525_SDO_Error_Reply "SC_KZQ_EV2274A_4_1/Main/CAN SDO/SDO  0x7C/Case 0x6440h(25664)/ Case 0x6440-014/SDO Reply/SDO Error Reply"
 /begin REF_CHARACTERISTIC core_gcp_u8CanSDOCmd_ErrReply core_gcp_u8CanSDOCmd_ErrReply_MainIndexMismatch core_gcp_u8CanSDOCmd_ErrReply_SubIndexMismatch core_gcp_u8CanSDOCmd_ErrReply_WrongCommand /end REF_CHARACTERISTIC
/end GROUP
/begin GROUP S1525_value_To_uint8_4_ "SC_KZQ_EV2274A_4_1/Main/CAN SDO/SDO  0x7C/Case 0x6440h(25664)/ Case 0x6440-014/SDO Reply/value_To_uint8[4]" /begin REF_CHARACTERISTIC core_gp_xSwapBytes /end REF_CHARACTERISTIC /end GROUP
/begin GROUP S1525_value_To_uint8_4_1 "SC_KZQ_EV2274A_4_1/Main/CAN SDO/SDO  0x7C/Case 0x6440h(25664)/ Case 0x6440-014/SDO Reply/value_To_uint8[4]1" /begin REF_CHARACTERISTIC core_gp_xSwapBytes /end REF_CHARACTERISTIC /end GROUP
/begin GROUP S1561_SDO_Error_Reply "SC_KZQ_EV2274A_4_1/Main/CAN SDO/SDO  0x7C/Case 0x6440h(25664)/ Case 0x6440-015/SDO Reply/SDO Error Reply"
 /begin REF_CHARACTERISTIC core_gcp_u8CanSDOCmd_ErrReply core_gcp_u8CanSDOCmd_ErrReply_MainIndexMismatch core_gcp_u8CanSDOCmd_ErrReply_SubIndexMismatch core_gcp_u8CanSDOCmd_ErrReply_WrongCommand /end REF_CHARACTERISTIC
/end GROUP
/begin GROUP S1561_value_To_uint8_4_ "SC_KZQ_EV2274A_4_1/Main/CAN SDO/SDO  0x7C/Case 0x6440h(25664)/ Case 0x6440-015/SDO Reply/value_To_uint8[4]" /begin REF_CHARACTERISTIC core_gp_xSwapBytes /end REF_CHARACTERISTIC /end GROUP
/begin GROUP S1561_value_To_uint8_4_1 "SC_KZQ_EV2274A_4_1/Main/CAN SDO/SDO  0x7C/Case 0x6440h(25664)/ Case 0x6440-015/SDO Reply/value_To_uint8[4]1" /begin REF_CHARACTERISTIC core_gp_xSwapBytes /end REF_CHARACTERISTIC /end GROUP
/begin GROUP S1597_SDO_Error_Reply "SC_KZQ_EV2274A_4_1/Main/CAN SDO/SDO  0x7C/Case 0x6440h(25664)/ Case 0x6440-016/SDO Reply/SDO Error Reply"
 /begin REF_CHARACTERISTIC core_gcp_u8CanSDOCmd_ErrReply core_gcp_u8CanSDOCmd_ErrReply_MainIndexMismatch core_gcp_u8CanSDOCmd_ErrReply_SubIndexMismatch core_gcp_u8CanSDOCmd_ErrReply_WrongCommand /end REF_CHARACTERISTIC
/end GROUP
/begin GROUP S1597_value_To_uint8_4_ "SC_KZQ_EV2274A_4_1/Main/CAN SDO/SDO  0x7C/Case 0x6440h(25664)/ Case 0x6440-016/SDO Reply/value_To_uint8[4]" /begin REF_CHARACTERISTIC core_gp_xSwapBytes /end REF_CHARACTERISTIC /end GROUP
/begin GROUP S1597_value_To_uint8_4_1 "SC_KZQ_EV2274A_4_1/Main/CAN SDO/SDO  0x7C/Case 0x6440h(25664)/ Case 0x6440-016/SDO Reply/value_To_uint8[4]1" /begin REF_CHARACTERISTIC core_gp_xSwapBytes /end REF_CHARACTERISTIC /end GROUP
/begin GROUP S1671_SDO_Error_Reply "SC_KZQ_EV2274A_4_1/Main/CAN SDO/SDO  0x7C/Case 0x6443h/ Case 0x6443-001/SDO Reply/SDO Error Reply"
 /begin REF_CHARACTERISTIC core_gcp_u8CanSDOCmd_ErrReply core_gcp_u8CanSDOCmd_ErrReply_MainIndexMismatch core_gcp_u8CanSDOCmd_ErrReply_SubIndexMismatch core_gcp_u8CanSDOCmd_ErrReply_WrongCommand /end REF_CHARACTERISTIC
/end GROUP
/begin GROUP S1671_value_To_uint8_4_ "SC_KZQ_EV2274A_4_1/Main/CAN SDO/SDO  0x7C/Case 0x6443h/ Case 0x6443-001/SDO Reply/value_To_uint8[4]" /begin REF_CHARACTERISTIC core_gp_xSwapBytes /end REF_CHARACTERISTIC /end GROUP
/begin GROUP S1671_value_To_uint8_4_1 "SC_KZQ_EV2274A_4_1/Main/CAN SDO/SDO  0x7C/Case 0x6443h/ Case 0x6443-001/SDO Reply/value_To_uint8[4]1" /begin REF_CHARACTERISTIC core_gp_xSwapBytes /end REF_CHARACTERISTIC /end GROUP
/begin GROUP S1707_SDO_Error_Reply "SC_KZQ_EV2274A_4_1/Main/CAN SDO/SDO  0x7C/Case 0x6443h/ Case 0x6443-002/SDO Reply/SDO Error Reply"
 /begin REF_CHARACTERISTIC core_gcp_u8CanSDOCmd_ErrReply core_gcp_u8CanSDOCmd_ErrReply_MainIndexMismatch core_gcp_u8CanSDOCmd_ErrReply_SubIndexMismatch core_gcp_u8CanSDOCmd_ErrReply_WrongCommand /end REF_CHARACTERISTIC
/end GROUP
/begin GROUP S1707_value_To_uint8_4_ "SC_KZQ_EV2274A_4_1/Main/CAN SDO/SDO  0x7C/Case 0x6443h/ Case 0x6443-002/SDO Reply/value_To_uint8[4]" /begin REF_CHARACTERISTIC core_gp_xSwapBytes /end REF_CHARACTERISTIC /end GROUP
/begin GROUP S1707_value_To_uint8_4_1 "SC_KZQ_EV2274A_4_1/Main/CAN SDO/SDO  0x7C/Case 0x6443h/ Case 0x6443-002/SDO Reply/value_To_uint8[4]1" /begin REF_CHARACTERISTIC core_gp_xSwapBytes /end REF_CHARACTERISTIC /end GROUP
/begin GROUP S1743_SDO_Error_Reply "SC_KZQ_EV2274A_4_1/Main/CAN SDO/SDO  0x7C/Case 0x6443h/ Case 0x6443-003/SDO Reply/SDO Error Reply"
 /begin REF_CHARACTERISTIC core_gcp_u8CanSDOCmd_ErrReply core_gcp_u8CanSDOCmd_ErrReply_MainIndexMismatch core_gcp_u8CanSDOCmd_ErrReply_SubIndexMismatch core_gcp_u8CanSDOCmd_ErrReply_WrongCommand /end REF_CHARACTERISTIC
/end GROUP
/begin GROUP S1743_value_To_uint8_4_ "SC_KZQ_EV2274A_4_1/Main/CAN SDO/SDO  0x7C/Case 0x6443h/ Case 0x6443-003/SDO Reply/value_To_uint8[4]" /begin REF_CHARACTERISTIC core_gp_xSwapBytes /end REF_CHARACTERISTIC /end GROUP
/begin GROUP S1743_value_To_uint8_4_1 "SC_KZQ_EV2274A_4_1/Main/CAN SDO/SDO  0x7C/Case 0x6443h/ Case 0x6443-003/SDO Reply/value_To_uint8[4]1" /begin REF_CHARACTERISTIC core_gp_xSwapBytes /end REF_CHARACTERISTIC /end GROUP
/begin GROUP S1779_SDO_Error_Reply "SC_KZQ_EV2274A_4_1/Main/CAN SDO/SDO  0x7C/Case 0x6443h/ Case 0x6443-004/SDO Reply/SDO Error Reply"
 /begin REF_CHARACTERISTIC core_gcp_u8CanSDOCmd_ErrReply core_gcp_u8CanSDOCmd_ErrReply_MainIndexMismatch core_gcp_u8CanSDOCmd_ErrReply_SubIndexMismatch core_gcp_u8CanSDOCmd_ErrReply_WrongCommand /end REF_CHARACTERISTIC
/end GROUP
/begin GROUP S1779_value_To_uint8_4_ "SC_KZQ_EV2274A_4_1/Main/CAN SDO/SDO  0x7C/Case 0x6443h/ Case 0x6443-004/SDO Reply/value_To_uint8[4]" /begin REF_CHARACTERISTIC core_gp_xSwapBytes /end REF_CHARACTERISTIC /end GROUP
/begin GROUP S1779_value_To_uint8_4_1 "SC_KZQ_EV2274A_4_1/Main/CAN SDO/SDO  0x7C/Case 0x6443h/ Case 0x6443-004/SDO Reply/value_To_uint8[4]1" /begin REF_CHARACTERISTIC core_gp_xSwapBytes /end REF_CHARACTERISTIC /end GROUP
/begin GROUP S1815_SDO_Error_Reply "SC_KZQ_EV2274A_4_1/Main/CAN SDO/SDO  0x7C/Case 0x6443h/ Case 0x6443-005/SDO Reply/SDO Error Reply"
 /begin REF_CHARACTERISTIC core_gcp_u8CanSDOCmd_ErrReply core_gcp_u8CanSDOCmd_ErrReply_MainIndexMismatch core_gcp_u8CanSDOCmd_ErrReply_SubIndexMismatch core_gcp_u8CanSDOCmd_ErrReply_WrongCommand /end REF_CHARACTERISTIC
/end GROUP
/begin GROUP S1815_value_To_uint8_4_ "SC_KZQ_EV2274A_4_1/Main/CAN SDO/SDO  0x7C/Case 0x6443h/ Case 0x6443-005/SDO Reply/value_To_uint8[4]" /begin REF_CHARACTERISTIC core_gp_xSwapBytes /end REF_CHARACTERISTIC /end GROUP
/begin GROUP S1815_value_To_uint8_4_1 "SC_KZQ_EV2274A_4_1/Main/CAN SDO/SDO  0x7C/Case 0x6443h/ Case 0x6443-005/SDO Reply/value_To_uint8[4]1" /begin REF_CHARACTERISTIC core_gp_xSwapBytes /end REF_CHARACTERISTIC /end GROUP
/begin GROUP S1851_SDO_Error_Reply "SC_KZQ_EV2274A_4_1/Main/CAN SDO/SDO  0x7C/Case 0x6443h/ Case 0x6443-006/SDO Reply/SDO Error Reply"
 /begin REF_CHARACTERISTIC core_gcp_u8CanSDOCmd_ErrReply core_gcp_u8CanSDOCmd_ErrReply_MainIndexMismatch core_gcp_u8CanSDOCmd_ErrReply_SubIndexMismatch core_gcp_u8CanSDOCmd_ErrReply_WrongCommand /end REF_CHARACTERISTIC
/end GROUP
/begin GROUP S1851_value_To_uint8_4_ "SC_KZQ_EV2274A_4_1/Main/CAN SDO/SDO  0x7C/Case 0x6443h/ Case 0x6443-006/SDO Reply/value_To_uint8[4]" /begin REF_CHARACTERISTIC core_gp_xSwapBytes /end REF_CHARACTERISTIC /end GROUP
/begin GROUP S1851_value_To_uint8_4_1 "SC_KZQ_EV2274A_4_1/Main/CAN SDO/SDO  0x7C/Case 0x6443h/ Case 0x6443-006/SDO Reply/value_To_uint8[4]1" /begin REF_CHARACTERISTIC core_gp_xSwapBytes /end REF_CHARACTERISTIC /end GROUP
/begin GROUP S1887_SDO_Error_Reply "SC_KZQ_EV2274A_4_1/Main/CAN SDO/SDO  0x7C/Case 0x6443h/ Case 0x6443-007/SDO Reply/SDO Error Reply"
 /begin REF_CHARACTERISTIC core_gcp_u8CanSDOCmd_ErrReply core_gcp_u8CanSDOCmd_ErrReply_MainIndexMismatch core_gcp_u8CanSDOCmd_ErrReply_SubIndexMismatch core_gcp_u8CanSDOCmd_ErrReply_WrongCommand /end REF_CHARACTERISTIC
/end GROUP
/begin GROUP S1887_value_To_uint8_4_ "SC_KZQ_EV2274A_4_1/Main/CAN SDO/SDO  0x7C/Case 0x6443h/ Case 0x6443-007/SDO Reply/value_To_uint8[4]" /begin REF_CHARACTERISTIC core_gp_xSwapBytes /end REF_CHARACTERISTIC /end GROUP
/begin GROUP S1887_value_To_uint8_4_1 "SC_KZQ_EV2274A_4_1/Main/CAN SDO/SDO  0x7C/Case 0x6443h/ Case 0x6443-007/SDO Reply/value_To_uint8[4]1" /begin REF_CHARACTERISTIC core_gp_xSwapBytes /end REF_CHARACTERISTIC /end GROUP
/begin GROUP S1923_SDO_Error_Reply "SC_KZQ_EV2274A_4_1/Main/CAN SDO/SDO  0x7C/Case 0x6443h/ Case 0x6443-008/SDO Reply/SDO Error Reply"
 /begin REF_CHARACTERISTIC core_gcp_u8CanSDOCmd_ErrReply core_gcp_u8CanSDOCmd_ErrReply_MainIndexMismatch core_gcp_u8CanSDOCmd_ErrReply_SubIndexMismatch core_gcp_u8CanSDOCmd_ErrReply_WrongCommand /end REF_CHARACTERISTIC
/end GROUP
/begin GROUP S1923_value_To_uint8_4_ "SC_KZQ_EV2274A_4_1/Main/CAN SDO/SDO  0x7C/Case 0x6443h/ Case 0x6443-008/SDO Reply/value_To_uint8[4]" /begin REF_CHARACTERISTIC core_gp_xSwapBytes /end REF_CHARACTERISTIC /end GROUP
/begin GROUP S1923_value_To_uint8_4_1 "SC_KZQ_EV2274A_4_1/Main/CAN SDO/SDO  0x7C/Case 0x6443h/ Case 0x6443-008/SDO Reply/value_To_uint8[4]1" /begin REF_CHARACTERISTIC core_gp_xSwapBytes /end REF_CHARACTERISTIC /end GROUP
/begin GROUP S1959_SDO_Error_Reply "SC_KZQ_EV2274A_4_1/Main/CAN SDO/SDO  0x7C/Case 0x6443h/ Case 0x6443-009/SDO Reply/SDO Error Reply"
 /begin REF_CHARACTERISTIC core_gcp_u8CanSDOCmd_ErrReply core_gcp_u8CanSDOCmd_ErrReply_MainIndexMismatch core_gcp_u8CanSDOCmd_ErrReply_SubIndexMismatch core_gcp_u8CanSDOCmd_ErrReply_WrongCommand /end REF_CHARACTERISTIC
/end GROUP
/begin GROUP S1959_value_To_uint8_4_ "SC_KZQ_EV2274A_4_1/Main/CAN SDO/SDO  0x7C/Case 0x6443h/ Case 0x6443-009/SDO Reply/value_To_uint8[4]" /begin REF_CHARACTERISTIC core_gp_xSwapBytes /end REF_CHARACTERISTIC /end GROUP
/begin GROUP S1959_value_To_uint8_4_1 "SC_KZQ_EV2274A_4_1/Main/CAN SDO/SDO  0x7C/Case 0x6443h/ Case 0x6443-009/SDO Reply/value_To_uint8[4]1" /begin REF_CHARACTERISTIC core_gp_xSwapBytes /end REF_CHARACTERISTIC /end GROUP
/begin GROUP S1995_SDO_Error_Reply "SC_KZQ_EV2274A_4_1/Main/CAN SDO/SDO  0x7C/Case 0x6443h/ Case 0x6443-010/SDO Reply/SDO Error Reply"
 /begin REF_CHARACTERISTIC core_gcp_u8CanSDOCmd_ErrReply core_gcp_u8CanSDOCmd_ErrReply_MainIndexMismatch core_gcp_u8CanSDOCmd_ErrReply_SubIndexMismatch core_gcp_u8CanSDOCmd_ErrReply_WrongCommand /end REF_CHARACTERISTIC
/end GROUP
/begin GROUP S1995_value_To_uint8_4_ "SC_KZQ_EV2274A_4_1/Main/CAN SDO/SDO  0x7C/Case 0x6443h/ Case 0x6443-010/SDO Reply/value_To_uint8[4]" /begin REF_CHARACTERISTIC core_gp_xSwapBytes /end REF_CHARACTERISTIC /end GROUP
/begin GROUP S1995_value_To_uint8_4_1 "SC_KZQ_EV2274A_4_1/Main/CAN SDO/SDO  0x7C/Case 0x6443h/ Case 0x6443-010/SDO Reply/value_To_uint8[4]1" /begin REF_CHARACTERISTIC core_gp_xSwapBytes /end REF_CHARACTERISTIC /end GROUP
/begin GROUP S2031_SDO_Error_Reply "SC_KZQ_EV2274A_4_1/Main/CAN SDO/SDO  0x7C/Case 0x6443h/ Case 0x6443-011/SDO Reply/SDO Error Reply"
 /begin REF_CHARACTERISTIC core_gcp_u8CanSDOCmd_ErrReply core_gcp_u8CanSDOCmd_ErrReply_MainIndexMismatch core_gcp_u8CanSDOCmd_ErrReply_SubIndexMismatch core_gcp_u8CanSDOCmd_ErrReply_WrongCommand /end REF_CHARACTERISTIC
/end GROUP
/begin GROUP S2031_value_To_uint8_4_ "SC_KZQ_EV2274A_4_1/Main/CAN SDO/SDO  0x7C/Case 0x6443h/ Case 0x6443-011/SDO Reply/value_To_uint8[4]" /begin REF_CHARACTERISTIC core_gp_xSwapBytes /end REF_CHARACTERISTIC /end GROUP
/begin GROUP S2031_value_To_uint8_4_1 "SC_KZQ_EV2274A_4_1/Main/CAN SDO/SDO  0x7C/Case 0x6443h/ Case 0x6443-011/SDO Reply/value_To_uint8[4]1" /begin REF_CHARACTERISTIC core_gp_xSwapBytes /end REF_CHARACTERISTIC /end GROUP
/begin GROUP S2067_SDO_Error_Reply "SC_KZQ_EV2274A_4_1/Main/CAN SDO/SDO  0x7C/Case 0x6443h/ Case 0x6443-012/SDO Reply/SDO Error Reply"
 /begin REF_CHARACTERISTIC core_gcp_u8CanSDOCmd_ErrReply core_gcp_u8CanSDOCmd_ErrReply_MainIndexMismatch core_gcp_u8CanSDOCmd_ErrReply_SubIndexMismatch core_gcp_u8CanSDOCmd_ErrReply_WrongCommand /end REF_CHARACTERISTIC
/end GROUP
/begin GROUP S2067_value_To_uint8_4_ "SC_KZQ_EV2274A_4_1/Main/CAN SDO/SDO  0x7C/Case 0x6443h/ Case 0x6443-012/SDO Reply/value_To_uint8[4]" /begin REF_CHARACTERISTIC core_gp_xSwapBytes /end REF_CHARACTERISTIC /end GROUP
/begin GROUP S2067_value_To_uint8_4_1 "SC_KZQ_EV2274A_4_1/Main/CAN SDO/SDO  0x7C/Case 0x6443h/ Case 0x6443-012/SDO Reply/value_To_uint8[4]1" /begin REF_CHARACTERISTIC core_gp_xSwapBytes /end REF_CHARACTERISTIC /end GROUP
/begin GROUP S2103_SDO_Error_Reply "SC_KZQ_EV2274A_4_1/Main/CAN SDO/SDO  0x7C/Case 0x6443h/ Case 0x6443-013/SDO Reply/SDO Error Reply"
 /begin REF_CHARACTERISTIC core_gcp_u8CanSDOCmd_ErrReply core_gcp_u8CanSDOCmd_ErrReply_MainIndexMismatch core_gcp_u8CanSDOCmd_ErrReply_SubIndexMismatch core_gcp_u8CanSDOCmd_ErrReply_WrongCommand /end REF_CHARACTERISTIC
/end GROUP
/begin GROUP S2103_value_To_uint8_4_ "SC_KZQ_EV2274A_4_1/Main/CAN SDO/SDO  0x7C/Case 0x6443h/ Case 0x6443-013/SDO Reply/value_To_uint8[4]" /begin REF_CHARACTERISTIC core_gp_xSwapBytes /end REF_CHARACTERISTIC /end GROUP
/begin GROUP S2103_value_To_uint8_4_1 "SC_KZQ_EV2274A_4_1/Main/CAN SDO/SDO  0x7C/Case 0x6443h/ Case 0x6443-013/SDO Reply/value_To_uint8[4]1" /begin REF_CHARACTERISTIC core_gp_xSwapBytes /end REF_CHARACTERISTIC /end GROUP
/begin GROUP S2139_SDO_Error_Reply "SC_KZQ_EV2274A_4_1/Main/CAN SDO/SDO  0x7C/Case 0x6443h/ Case 0x6443-014/SDO Reply/SDO Error Reply"
 /begin REF_CHARACTERISTIC core_gcp_u8CanSDOCmd_ErrReply core_gcp_u8CanSDOCmd_ErrReply_MainIndexMismatch core_gcp_u8CanSDOCmd_ErrReply_SubIndexMismatch core_gcp_u8CanSDOCmd_ErrReply_WrongCommand /end REF_CHARACTERISTIC
/end GROUP
/begin GROUP S2139_value_To_uint8_4_ "SC_KZQ_EV2274A_4_1/Main/CAN SDO/SDO  0x7C/Case 0x6443h/ Case 0x6443-014/SDO Reply/value_To_uint8[4]" /begin REF_CHARACTERISTIC core_gp_xSwapBytes /end REF_CHARACTERISTIC /end GROUP
/begin GROUP S2139_value_To_uint8_4_1 "SC_KZQ_EV2274A_4_1/Main/CAN SDO/SDO  0x7C/Case 0x6443h/ Case 0x6443-014/SDO Reply/value_To_uint8[4]1" /begin REF_CHARACTERISTIC core_gp_xSwapBytes /end REF_CHARACTERISTIC /end GROUP
/begin GROUP S2175_SDO_Error_Reply "SC_KZQ_EV2274A_4_1/Main/CAN SDO/SDO  0x7C/Case 0x6443h/ Case 0x6443-015/SDO Reply/SDO Error Reply"
 /begin REF_CHARACTERISTIC core_gcp_u8CanSDOCmd_ErrReply core_gcp_u8CanSDOCmd_ErrReply_MainIndexMismatch core_gcp_u8CanSDOCmd_ErrReply_SubIndexMismatch core_gcp_u8CanSDOCmd_ErrReply_WrongCommand /end REF_CHARACTERISTIC
/end GROUP
/begin GROUP S2175_value_To_uint8_4_ "SC_KZQ_EV2274A_4_1/Main/CAN SDO/SDO  0x7C/Case 0x6443h/ Case 0x6443-015/SDO Reply/value_To_uint8[4]" /begin REF_CHARACTERISTIC core_gp_xSwapBytes /end REF_CHARACTERISTIC /end GROUP
/begin GROUP S2175_value_To_uint8_4_1 "SC_KZQ_EV2274A_4_1/Main/CAN SDO/SDO  0x7C/Case 0x6443h/ Case 0x6443-015/SDO Reply/value_To_uint8[4]1" /begin REF_CHARACTERISTIC core_gp_xSwapBytes /end REF_CHARACTERISTIC /end GROUP
/begin GROUP S2211_SDO_Error_Reply "SC_KZQ_EV2274A_4_1/Main/CAN SDO/SDO  0x7C/Case 0x6443h/ Case 0x6443-016/SDO Reply/SDO Error Reply"
 /begin REF_CHARACTERISTIC core_gcp_u8CanSDOCmd_ErrReply core_gcp_u8CanSDOCmd_ErrReply_MainIndexMismatch core_gcp_u8CanSDOCmd_ErrReply_SubIndexMismatch core_gcp_u8CanSDOCmd_ErrReply_WrongCommand /end REF_CHARACTERISTIC
/end GROUP
/begin GROUP S2211_value_To_uint8_4_ "SC_KZQ_EV2274A_4_1/Main/CAN SDO/SDO  0x7C/Case 0x6443h/ Case 0x6443-016/SDO Reply/value_To_uint8[4]" /begin REF_CHARACTERISTIC core_gp_xSwapBytes /end REF_CHARACTERISTIC /end GROUP
/begin GROUP S2211_value_To_uint8_4_1 "SC_KZQ_EV2274A_4_1/Main/CAN SDO/SDO  0x7C/Case 0x6443h/ Case 0x6443-016/SDO Reply/value_To_uint8[4]1" /begin REF_CHARACTERISTIC core_gp_xSwapBytes /end REF_CHARACTERISTIC /end GROUP
/begin GROUP S2247_SDO_Error_Reply "SC_KZQ_EV2274A_4_1/Main/CAN SDO/SDO  0x7C/Case 0x6443h/ Case 0x6443-017/SDO Reply/SDO Error Reply"
 /begin REF_CHARACTERISTIC core_gcp_u8CanSDOCmd_ErrReply core_gcp_u8CanSDOCmd_ErrReply_MainIndexMismatch core_gcp_u8CanSDOCmd_ErrReply_SubIndexMismatch core_gcp_u8CanSDOCmd_ErrReply_WrongCommand /end REF_CHARACTERISTIC
/end GROUP
/begin GROUP S2247_value_To_uint8_4_ "SC_KZQ_EV2274A_4_1/Main/CAN SDO/SDO  0x7C/Case 0x6443h/ Case 0x6443-017/SDO Reply/value_To_uint8[4]" /begin REF_CHARACTERISTIC core_gp_xSwapBytes /end REF_CHARACTERISTIC /end GROUP
/begin GROUP S2247_value_To_uint8_4_1 "SC_KZQ_EV2274A_4_1/Main/CAN SDO/SDO  0x7C/Case 0x6443h/ Case 0x6443-017/SDO Reply/value_To_uint8[4]1" /begin REF_CHARACTERISTIC core_gp_xSwapBytes /end REF_CHARACTERISTIC /end GROUP
/begin GROUP S2283_SDO_Error_Reply "SC_KZQ_EV2274A_4_1/Main/CAN SDO/SDO  0x7C/Case 0x6443h/ Case 0x6443-018/SDO Reply/SDO Error Reply"
 /begin REF_CHARACTERISTIC core_gcp_u8CanSDOCmd_ErrReply core_gcp_u8CanSDOCmd_ErrReply_MainIndexMismatch core_gcp_u8CanSDOCmd_ErrReply_SubIndexMismatch core_gcp_u8CanSDOCmd_ErrReply_WrongCommand /end REF_CHARACTERISTIC
/end GROUP
/begin GROUP S2283_value_To_uint8_4_ "SC_KZQ_EV2274A_4_1/Main/CAN SDO/SDO  0x7C/Case 0x6443h/ Case 0x6443-018/SDO Reply/value_To_uint8[4]" /begin REF_CHARACTERISTIC core_gp_xSwapBytes /end REF_CHARACTERISTIC /end GROUP
/begin GROUP S2283_value_To_uint8_4_1 "SC_KZQ_EV2274A_4_1/Main/CAN SDO/SDO  0x7C/Case 0x6443h/ Case 0x6443-018/SDO Reply/value_To_uint8[4]1" /begin REF_CHARACTERISTIC core_gp_xSwapBytes /end REF_CHARACTERISTIC /end GROUP
/begin GROUP S2319_SDO_Error_Reply "SC_KZQ_EV2274A_4_1/Main/CAN SDO/SDO  0x7C/Case 0x6443h/ Case 0x6443-019/SDO Reply/SDO Error Reply"
 /begin REF_CHARACTERISTIC core_gcp_u8CanSDOCmd_ErrReply core_gcp_u8CanSDOCmd_ErrReply_MainIndexMismatch core_gcp_u8CanSDOCmd_ErrReply_SubIndexMismatch core_gcp_u8CanSDOCmd_ErrReply_WrongCommand /end REF_CHARACTERISTIC
/end GROUP
/begin GROUP S2319_value_To_uint8_4_ "SC_KZQ_EV2274A_4_1/Main/CAN SDO/SDO  0x7C/Case 0x6443h/ Case 0x6443-019/SDO Reply/value_To_uint8[4]" /begin REF_CHARACTERISTIC core_gp_xSwapBytes /end REF_CHARACTERISTIC /end GROUP
/begin GROUP S2319_value_To_uint8_4_1 "SC_KZQ_EV2274A_4_1/Main/CAN SDO/SDO  0x7C/Case 0x6443h/ Case 0x6443-019/SDO Reply/value_To_uint8[4]1" /begin REF_CHARACTERISTIC core_gp_xSwapBytes /end REF_CHARACTERISTIC /end GROUP
/begin GROUP S2355_SDO_Error_Reply "SC_KZQ_EV2274A_4_1/Main/CAN SDO/SDO  0x7C/Case 0x6443h/ Case 0x6443-020/SDO Reply/SDO Error Reply"
 /begin REF_CHARACTERISTIC core_gcp_u8CanSDOCmd_ErrReply core_gcp_u8CanSDOCmd_ErrReply_MainIndexMismatch core_gcp_u8CanSDOCmd_ErrReply_SubIndexMismatch core_gcp_u8CanSDOCmd_ErrReply_WrongCommand /end REF_CHARACTERISTIC
/end GROUP
/begin GROUP S2355_value_To_uint8_4_ "SC_KZQ_EV2274A_4_1/Main/CAN SDO/SDO  0x7C/Case 0x6443h/ Case 0x6443-020/SDO Reply/value_To_uint8[4]" /begin REF_CHARACTERISTIC core_gp_xSwapBytes /end REF_CHARACTERISTIC /end GROUP
/begin GROUP S2355_value_To_uint8_4_1 "SC_KZQ_EV2274A_4_1/Main/CAN SDO/SDO  0x7C/Case 0x6443h/ Case 0x6443-020/SDO Reply/value_To_uint8[4]1" /begin REF_CHARACTERISTIC core_gp_xSwapBytes /end REF_CHARACTERISTIC /end GROUP
/begin GROUP S2391_SDO_Error_Reply "SC_KZQ_EV2274A_4_1/Main/CAN SDO/SDO  0x7C/Case 0x6443h/ Case 0x6443-021/SDO Reply/SDO Error Reply"
 /begin REF_CHARACTERISTIC core_gcp_u8CanSDOCmd_ErrReply core_gcp_u8CanSDOCmd_ErrReply_MainIndexMismatch core_gcp_u8CanSDOCmd_ErrReply_SubIndexMismatch core_gcp_u8CanSDOCmd_ErrReply_WrongCommand /end REF_CHARACTERISTIC
/end GROUP
/begin GROUP S2391_value_To_uint8_4_ "SC_KZQ_EV2274A_4_1/Main/CAN SDO/SDO  0x7C/Case 0x6443h/ Case 0x6443-021/SDO Reply/value_To_uint8[4]" /begin REF_CHARACTERISTIC core_gp_xSwapBytes /end REF_CHARACTERISTIC /end GROUP
/begin GROUP S2391_value_To_uint8_4_1 "SC_KZQ_EV2274A_4_1/Main/CAN SDO/SDO  0x7C/Case 0x6443h/ Case 0x6443-021/SDO Reply/value_To_uint8[4]1" /begin REF_CHARACTERISTIC core_gp_xSwapBytes /end REF_CHARACTERISTIC /end GROUP
/begin GROUP S2427_SDO_Error_Reply "SC_KZQ_EV2274A_4_1/Main/CAN SDO/SDO  0x7C/Case 0x6443h/ Case 0x6443-022/SDO Reply/SDO Error Reply"
 /begin REF_CHARACTERISTIC core_gcp_u8CanSDOCmd_ErrReply core_gcp_u8CanSDOCmd_ErrReply_MainIndexMismatch core_gcp_u8CanSDOCmd_ErrReply_SubIndexMismatch core_gcp_u8CanSDOCmd_ErrReply_WrongCommand /end REF_CHARACTERISTIC
/end GROUP
/begin GROUP S2427_value_To_uint8_4_ "SC_KZQ_EV2274A_4_1/Main/CAN SDO/SDO  0x7C/Case 0x6443h/ Case 0x6443-022/SDO Reply/value_To_uint8[4]" /begin REF_CHARACTERISTIC core_gp_xSwapBytes /end REF_CHARACTERISTIC /end GROUP
/begin GROUP S2427_value_To_uint8_4_1 "SC_KZQ_EV2274A_4_1/Main/CAN SDO/SDO  0x7C/Case 0x6443h/ Case 0x6443-022/SDO Reply/value_To_uint8[4]1" /begin REF_CHARACTERISTIC core_gp_xSwapBytes /end REF_CHARACTERISTIC /end GROUP
/begin GROUP S2463_SDO_Error_Reply "SC_KZQ_EV2274A_4_1/Main/CAN SDO/SDO  0x7C/Case 0x6443h/ Case 0x6443-023/SDO Reply/SDO Error Reply"
 /begin REF_CHARACTERISTIC core_gcp_u8CanSDOCmd_ErrReply core_gcp_u8CanSDOCmd_ErrReply_MainIndexMismatch core_gcp_u8CanSDOCmd_ErrReply_SubIndexMismatch core_gcp_u8CanSDOCmd_ErrReply_WrongCommand /end REF_CHARACTERISTIC
/end GROUP
/begin GROUP S2463_value_To_uint8_4_ "SC_KZQ_EV2274A_4_1/Main/CAN SDO/SDO  0x7C/Case 0x6443h/ Case 0x6443-023/SDO Reply/value_To_uint8[4]" /begin REF_CHARACTERISTIC core_gp_xSwapBytes /end REF_CHARACTERISTIC /end GROUP
/begin GROUP S2463_value_To_uint8_4_1 "SC_KZQ_EV2274A_4_1/Main/CAN SDO/SDO  0x7C/Case 0x6443h/ Case 0x6443-023/SDO Reply/value_To_uint8[4]1" /begin REF_CHARACTERISTIC core_gp_xSwapBytes /end REF_CHARACTERISTIC /end GROUP
/begin GROUP S2499_SDO_Error_Reply "SC_KZQ_EV2274A_4_1/Main/CAN SDO/SDO  0x7C/Case 0x6443h/ Case 0x6443-024/SDO Reply/SDO Error Reply"
 /begin REF_CHARACTERISTIC core_gcp_u8CanSDOCmd_ErrReply core_gcp_u8CanSDOCmd_ErrReply_MainIndexMismatch core_gcp_u8CanSDOCmd_ErrReply_SubIndexMismatch core_gcp_u8CanSDOCmd_ErrReply_WrongCommand /end REF_CHARACTERISTIC
/end GROUP
/begin GROUP S2499_value_To_uint8_4_ "SC_KZQ_EV2274A_4_1/Main/CAN SDO/SDO  0x7C/Case 0x6443h/ Case 0x6443-024/SDO Reply/value_To_uint8[4]" /begin REF_CHARACTERISTIC core_gp_xSwapBytes /end REF_CHARACTERISTIC /end GROUP
/begin GROUP S2499_value_To_uint8_4_1 "SC_KZQ_EV2274A_4_1/Main/CAN SDO/SDO  0x7C/Case 0x6443h/ Case 0x6443-024/SDO Reply/value_To_uint8[4]1" /begin REF_CHARACTERISTIC core_gp_xSwapBytes /end REF_CHARACTERISTIC /end GROUP
/begin GROUP S2535_SDO_Error_Reply "SC_KZQ_EV2274A_4_1/Main/CAN SDO/SDO  0x7C/Case 0x6443h/ Case 0x6443-025/SDO Reply/SDO Error Reply"
 /begin REF_CHARACTERISTIC core_gcp_u8CanSDOCmd_ErrReply core_gcp_u8CanSDOCmd_ErrReply_MainIndexMismatch core_gcp_u8CanSDOCmd_ErrReply_SubIndexMismatch core_gcp_u8CanSDOCmd_ErrReply_WrongCommand /end REF_CHARACTERISTIC
/end GROUP
/begin GROUP S2535_value_To_uint8_4_ "SC_KZQ_EV2274A_4_1/Main/CAN SDO/SDO  0x7C/Case 0x6443h/ Case 0x6443-025/SDO Reply/value_To_uint8[4]" /begin REF_CHARACTERISTIC core_gp_xSwapBytes /end REF_CHARACTERISTIC /end GROUP
/begin GROUP S2535_value_To_uint8_4_1 "SC_KZQ_EV2274A_4_1/Main/CAN SDO/SDO  0x7C/Case 0x6443h/ Case 0x6443-025/SDO Reply/value_To_uint8[4]1" /begin REF_CHARACTERISTIC core_gp_xSwapBytes /end REF_CHARACTERISTIC /end GROUP
/begin GROUP S2571_SDO_Error_Reply "SC_KZQ_EV2274A_4_1/Main/CAN SDO/SDO  0x7C/Case 0x6443h/ Case 0x6443-026/SDO Reply/SDO Error Reply"
 /begin REF_CHARACTERISTIC core_gcp_u8CanSDOCmd_ErrReply core_gcp_u8CanSDOCmd_ErrReply_MainIndexMismatch core_gcp_u8CanSDOCmd_ErrReply_SubIndexMismatch core_gcp_u8CanSDOCmd_ErrReply_WrongCommand /end REF_CHARACTERISTIC
/end GROUP
/begin GROUP S2571_value_To_uint8_4_ "SC_KZQ_EV2274A_4_1/Main/CAN SDO/SDO  0x7C/Case 0x6443h/ Case 0x6443-026/SDO Reply/value_To_uint8[4]" /begin REF_CHARACTERISTIC core_gp_xSwapBytes /end REF_CHARACTERISTIC /end GROUP
/begin GROUP S2571_value_To_uint8_4_1 "SC_KZQ_EV2274A_4_1/Main/CAN SDO/SDO  0x7C/Case 0x6443h/ Case 0x6443-026/SDO Reply/value_To_uint8[4]1" /begin REF_CHARACTERISTIC core_gp_xSwapBytes /end REF_CHARACTERISTIC /end GROUP
/begin GROUP S2607_SDO_Error_Reply "SC_KZQ_EV2274A_4_1/Main/CAN SDO/SDO  0x7C/Case 0x6443h/ Case 0x6443-027/SDO Reply/SDO Error Reply"
 /begin REF_CHARACTERISTIC core_gcp_u8CanSDOCmd_ErrReply core_gcp_u8CanSDOCmd_ErrReply_MainIndexMismatch core_gcp_u8CanSDOCmd_ErrReply_SubIndexMismatch core_gcp_u8CanSDOCmd_ErrReply_WrongCommand /end REF_CHARACTERISTIC
/end GROUP
/begin GROUP S2607_value_To_uint8_4_ "SC_KZQ_EV2274A_4_1/Main/CAN SDO/SDO  0x7C/Case 0x6443h/ Case 0x6443-027/SDO Reply/value_To_uint8[4]" /begin REF_CHARACTERISTIC core_gp_xSwapBytes /end REF_CHARACTERISTIC /end GROUP
/begin GROUP S2607_value_To_uint8_4_1 "SC_KZQ_EV2274A_4_1/Main/CAN SDO/SDO  0x7C/Case 0x6443h/ Case 0x6443-027/SDO Reply/value_To_uint8[4]1" /begin REF_CHARACTERISTIC core_gp_xSwapBytes /end REF_CHARACTERISTIC /end GROUP
/begin GROUP S2643_SDO_Error_Reply "SC_KZQ_EV2274A_4_1/Main/CAN SDO/SDO  0x7C/Case 0x6443h/ Case 0x6443-028/SDO Reply/SDO Error Reply"
 /begin REF_CHARACTERISTIC core_gcp_u8CanSDOCmd_ErrReply core_gcp_u8CanSDOCmd_ErrReply_MainIndexMismatch core_gcp_u8CanSDOCmd_ErrReply_SubIndexMismatch core_gcp_u8CanSDOCmd_ErrReply_WrongCommand /end REF_CHARACTERISTIC
/end GROUP
/begin GROUP S2643_value_To_uint8_4_ "SC_KZQ_EV2274A_4_1/Main/CAN SDO/SDO  0x7C/Case 0x6443h/ Case 0x6443-028/SDO Reply/value_To_uint8[4]" /begin REF_CHARACTERISTIC core_gp_xSwapBytes /end REF_CHARACTERISTIC /end GROUP
/begin GROUP S2643_value_To_uint8_4_1 "SC_KZQ_EV2274A_4_1/Main/CAN SDO/SDO  0x7C/Case 0x6443h/ Case 0x6443-028/SDO Reply/value_To_uint8[4]1" /begin REF_CHARACTERISTIC core_gp_xSwapBytes /end REF_CHARACTERISTIC /end GROUP
/begin GROUP S2679_SDO_Error_Reply "SC_KZQ_EV2274A_4_1/Main/CAN SDO/SDO  0x7C/Case 0x6443h/ Case 0x6443-029/SDO Reply/SDO Error Reply"
 /begin REF_CHARACTERISTIC core_gcp_u8CanSDOCmd_ErrReply core_gcp_u8CanSDOCmd_ErrReply_MainIndexMismatch core_gcp_u8CanSDOCmd_ErrReply_SubIndexMismatch core_gcp_u8CanSDOCmd_ErrReply_WrongCommand /end REF_CHARACTERISTIC
/end GROUP
/begin GROUP S2679_value_To_uint8_4_ "SC_KZQ_EV2274A_4_1/Main/CAN SDO/SDO  0x7C/Case 0x6443h/ Case 0x6443-029/SDO Reply/value_To_uint8[4]" /begin REF_CHARACTERISTIC core_gp_xSwapBytes /end REF_CHARACTERISTIC /end GROUP
/begin GROUP S2679_value_To_uint8_4_1 "SC_KZQ_EV2274A_4_1/Main/CAN SDO/SDO  0x7C/Case 0x6443h/ Case 0x6443-029/SDO Reply/value_To_uint8[4]1" /begin REF_CHARACTERISTIC core_gp_xSwapBytes /end REF_CHARACTERISTIC /end GROUP
/begin GROUP S2715_SDO_Error_Reply "SC_KZQ_EV2274A_4_1/Main/CAN SDO/SDO  0x7C/Case 0x6443h/ Case 0x6443-030/SDO Reply/SDO Error Reply"
 /begin REF_CHARACTERISTIC core_gcp_u8CanSDOCmd_ErrReply core_gcp_u8CanSDOCmd_ErrReply_MainIndexMismatch core_gcp_u8CanSDOCmd_ErrReply_SubIndexMismatch core_gcp_u8CanSDOCmd_ErrReply_WrongCommand /end REF_CHARACTERISTIC
/end GROUP
/begin GROUP S2715_value_To_uint8_4_ "SC_KZQ_EV2274A_4_1/Main/CAN SDO/SDO  0x7C/Case 0x6443h/ Case 0x6443-030/SDO Reply/value_To_uint8[4]" /begin REF_CHARACTERISTIC core_gp_xSwapBytes /end REF_CHARACTERISTIC /end GROUP
/begin GROUP S2715_value_To_uint8_4_1 "SC_KZQ_EV2274A_4_1/Main/CAN SDO/SDO  0x7C/Case 0x6443h/ Case 0x6443-030/SDO Reply/value_To_uint8[4]1" /begin REF_CHARACTERISTIC core_gp_xSwapBytes /end REF_CHARACTERISTIC /end GROUP
/begin GROUP S2751_SDO_Error_Reply "SC_KZQ_EV2274A_4_1/Main/CAN SDO/SDO  0x7C/Case 0x6443h/ Case 0x6443-031/SDO Reply/SDO Error Reply"
 /begin REF_CHARACTERISTIC core_gcp_u8CanSDOCmd_ErrReply core_gcp_u8CanSDOCmd_ErrReply_MainIndexMismatch core_gcp_u8CanSDOCmd_ErrReply_SubIndexMismatch core_gcp_u8CanSDOCmd_ErrReply_WrongCommand /end REF_CHARACTERISTIC
/end GROUP
/begin GROUP S2751_value_To_uint8_4_ "SC_KZQ_EV2274A_4_1/Main/CAN SDO/SDO  0x7C/Case 0x6443h/ Case 0x6443-031/SDO Reply/value_To_uint8[4]" /begin REF_CHARACTERISTIC core_gp_xSwapBytes /end REF_CHARACTERISTIC /end GROUP
/begin GROUP S2751_value_To_uint8_4_1 "SC_KZQ_EV2274A_4_1/Main/CAN SDO/SDO  0x7C/Case 0x6443h/ Case 0x6443-031/SDO Reply/value_To_uint8[4]1" /begin REF_CHARACTERISTIC core_gp_xSwapBytes /end REF_CHARACTERISTIC /end GROUP
/begin GROUP S2787_SDO_Error_Reply "SC_KZQ_EV2274A_4_1/Main/CAN SDO/SDO  0x7C/Case 0x6443h/ Case 0x6443-032/SDO Reply/SDO Error Reply"
 /begin REF_CHARACTERISTIC core_gcp_u8CanSDOCmd_ErrReply core_gcp_u8CanSDOCmd_ErrReply_MainIndexMismatch core_gcp_u8CanSDOCmd_ErrReply_SubIndexMismatch core_gcp_u8CanSDOCmd_ErrReply_WrongCommand /end REF_CHARACTERISTIC
/end GROUP
/begin GROUP S2787_value_To_uint8_4_ "SC_KZQ_EV2274A_4_1/Main/CAN SDO/SDO  0x7C/Case 0x6443h/ Case 0x6443-032/SDO Reply/value_To_uint8[4]" /begin REF_CHARACTERISTIC core_gp_xSwapBytes /end REF_CHARACTERISTIC /end GROUP
/begin GROUP S2787_value_To_uint8_4_1 "SC_KZQ_EV2274A_4_1/Main/CAN SDO/SDO  0x7C/Case 0x6443h/ Case 0x6443-032/SDO Reply/value_To_uint8[4]1" /begin REF_CHARACTERISTIC core_gp_xSwapBytes /end REF_CHARACTERISTIC /end GROUP
/begin GROUP S2851_SDO_Error_Reply "SC_KZQ_EV2274A_4_1/Main/CAN SDO/SDO  0x7C/Case 0x6445h/ Case 0x6445-001/SDO Reply/SDO Error Reply"
 /begin REF_CHARACTERISTIC core_gcp_u8CanSDOCmd_ErrReply core_gcp_u8CanSDOCmd_ErrReply_MainIndexMismatch core_gcp_u8CanSDOCmd_ErrReply_SubIndexMismatch core_gcp_u8CanSDOCmd_ErrReply_WrongCommand /end REF_CHARACTERISTIC
/end GROUP
/begin GROUP S2851_value_To_uint8_4_ "SC_KZQ_EV2274A_4_1/Main/CAN SDO/SDO  0x7C/Case 0x6445h/ Case 0x6445-001/SDO Reply/value_To_uint8[4]" /begin REF_CHARACTERISTIC core_gp_xSwapBytes /end REF_CHARACTERISTIC /end GROUP
/begin GROUP S2851_value_To_uint8_4_1 "SC_KZQ_EV2274A_4_1/Main/CAN SDO/SDO  0x7C/Case 0x6445h/ Case 0x6445-001/SDO Reply/value_To_uint8[4]1" /begin REF_CHARACTERISTIC core_gp_xSwapBytes /end REF_CHARACTERISTIC /end GROUP
/begin GROUP S2887_SDO_Error_Reply "SC_KZQ_EV2274A_4_1/Main/CAN SDO/SDO  0x7C/Case 0x6445h/ Case 0x6445-002/SDO Reply/SDO Error Reply"
 /begin REF_CHARACTERISTIC core_gcp_u8CanSDOCmd_ErrReply core_gcp_u8CanSDOCmd_ErrReply_MainIndexMismatch core_gcp_u8CanSDOCmd_ErrReply_SubIndexMismatch core_gcp_u8CanSDOCmd_ErrReply_WrongCommand /end REF_CHARACTERISTIC
/end GROUP
/begin GROUP S2887_value_To_uint8_4_ "SC_KZQ_EV2274A_4_1/Main/CAN SDO/SDO  0x7C/Case 0x6445h/ Case 0x6445-002/SDO Reply/value_To_uint8[4]" /begin REF_CHARACTERISTIC core_gp_xSwapBytes /end REF_CHARACTERISTIC /end GROUP
/begin GROUP S2887_value_To_uint8_4_1 "SC_KZQ_EV2274A_4_1/Main/CAN SDO/SDO  0x7C/Case 0x6445h/ Case 0x6445-002/SDO Reply/value_To_uint8[4]1" /begin REF_CHARACTERISTIC core_gp_xSwapBytes /end REF_CHARACTERISTIC /end GROUP
/begin GROUP S2923_SDO_Error_Reply "SC_KZQ_EV2274A_4_1/Main/CAN SDO/SDO  0x7C/Case 0x6445h/ Case 0x6445-003/SDO Reply/SDO Error Reply"
 /begin REF_CHARACTERISTIC core_gcp_u8CanSDOCmd_ErrReply core_gcp_u8CanSDOCmd_ErrReply_MainIndexMismatch core_gcp_u8CanSDOCmd_ErrReply_SubIndexMismatch core_gcp_u8CanSDOCmd_ErrReply_WrongCommand /end REF_CHARACTERISTIC
/end GROUP
/begin GROUP S2923_value_To_uint8_4_ "SC_KZQ_EV2274A_4_1/Main/CAN SDO/SDO  0x7C/Case 0x6445h/ Case 0x6445-003/SDO Reply/value_To_uint8[4]" /begin REF_CHARACTERISTIC core_gp_xSwapBytes /end REF_CHARACTERISTIC /end GROUP
/begin GROUP S2923_value_To_uint8_4_1 "SC_KZQ_EV2274A_4_1/Main/CAN SDO/SDO  0x7C/Case 0x6445h/ Case 0x6445-003/SDO Reply/value_To_uint8[4]1" /begin REF_CHARACTERISTIC core_gp_xSwapBytes /end REF_CHARACTERISTIC /end GROUP
/begin GROUP S2959_SDO_Error_Reply "SC_KZQ_EV2274A_4_1/Main/CAN SDO/SDO  0x7C/Case 0x6445h/ Case 0x6445-004/SDO Reply/SDO Error Reply"
 /begin REF_CHARACTERISTIC core_gcp_u8CanSDOCmd_ErrReply core_gcp_u8CanSDOCmd_ErrReply_MainIndexMismatch core_gcp_u8CanSDOCmd_ErrReply_SubIndexMismatch core_gcp_u8CanSDOCmd_ErrReply_WrongCommand /end REF_CHARACTERISTIC
/end GROUP
/begin GROUP S2959_value_To_uint8_4_ "SC_KZQ_EV2274A_4_1/Main/CAN SDO/SDO  0x7C/Case 0x6445h/ Case 0x6445-004/SDO Reply/value_To_uint8[4]" /begin REF_CHARACTERISTIC core_gp_xSwapBytes /end REF_CHARACTERISTIC /end GROUP
/begin GROUP S2959_value_To_uint8_4_1 "SC_KZQ_EV2274A_4_1/Main/CAN SDO/SDO  0x7C/Case 0x6445h/ Case 0x6445-004/SDO Reply/value_To_uint8[4]1" /begin REF_CHARACTERISTIC core_gp_xSwapBytes /end REF_CHARACTERISTIC /end GROUP
/begin GROUP S2995_SDO_Error_Reply "SC_KZQ_EV2274A_4_1/Main/CAN SDO/SDO  0x7C/Case 0x6445h/ Case 0x6445-030/SDO Reply/SDO Error Reply"
 /begin REF_CHARACTERISTIC core_gcp_u8CanSDOCmd_ErrReply core_gcp_u8CanSDOCmd_ErrReply_MainIndexMismatch core_gcp_u8CanSDOCmd_ErrReply_SubIndexMismatch core_gcp_u8CanSDOCmd_ErrReply_WrongCommand /end REF_CHARACTERISTIC
/end GROUP
/begin GROUP S2995_value_To_uint8_4_ "SC_KZQ_EV2274A_4_1/Main/CAN SDO/SDO  0x7C/Case 0x6445h/ Case 0x6445-030/SDO Reply/value_To_uint8[4]" /begin REF_CHARACTERISTIC core_gp_xSwapBytes /end REF_CHARACTERISTIC /end GROUP
/begin GROUP S2995_value_To_uint8_4_1 "SC_KZQ_EV2274A_4_1/Main/CAN SDO/SDO  0x7C/Case 0x6445h/ Case 0x6445-030/SDO Reply/value_To_uint8[4]1" /begin REF_CHARACTERISTIC core_gp_xSwapBytes /end REF_CHARACTERISTIC /end GROUP
/begin GROUP S3031_SDO_Error_Reply "SC_KZQ_EV2274A_4_1/Main/CAN SDO/SDO  0x7C/Case 0x6445h/ Case 0x6445-040/SDO Reply/SDO Error Reply"
 /begin REF_CHARACTERISTIC core_gcp_u8CanSDOCmd_ErrReply core_gcp_u8CanSDOCmd_ErrReply_MainIndexMismatch core_gcp_u8CanSDOCmd_ErrReply_SubIndexMismatch core_gcp_u8CanSDOCmd_ErrReply_WrongCommand /end REF_CHARACTERISTIC
/end GROUP
/begin GROUP S3031_value_To_uint8_4_ "SC_KZQ_EV2274A_4_1/Main/CAN SDO/SDO  0x7C/Case 0x6445h/ Case 0x6445-040/SDO Reply/value_To_uint8[4]" /begin REF_CHARACTERISTIC core_gp_xSwapBytes /end REF_CHARACTERISTIC /end GROUP
/begin GROUP S3031_value_To_uint8_4_1 "SC_KZQ_EV2274A_4_1/Main/CAN SDO/SDO  0x7C/Case 0x6445h/ Case 0x6445-040/SDO Reply/value_To_uint8[4]1" /begin REF_CHARACTERISTIC core_gp_xSwapBytes /end REF_CHARACTERISTIC /end GROUP
/begin GROUP S3067_SDO_Error_Reply "SC_KZQ_EV2274A_4_1/Main/CAN SDO/SDO  0x7C/Case 0x6445h/ Case 0x6445-041/SDO Reply/SDO Error Reply"
 /begin REF_CHARACTERISTIC core_gcp_u8CanSDOCmd_ErrReply core_gcp_u8CanSDOCmd_ErrReply_MainIndexMismatch core_gcp_u8CanSDOCmd_ErrReply_SubIndexMismatch core_gcp_u8CanSDOCmd_ErrReply_WrongCommand /end REF_CHARACTERISTIC
/end GROUP
/begin GROUP S3067_value_To_uint8_4_ "SC_KZQ_EV2274A_4_1/Main/CAN SDO/SDO  0x7C/Case 0x6445h/ Case 0x6445-041/SDO Reply/value_To_uint8[4]" /begin REF_CHARACTERISTIC core_gp_xSwapBytes /end REF_CHARACTERISTIC /end GROUP
/begin GROUP S3067_value_To_uint8_4_1 "SC_KZQ_EV2274A_4_1/Main/CAN SDO/SDO  0x7C/Case 0x6445h/ Case 0x6445-041/SDO Reply/value_To_uint8[4]1" /begin REF_CHARACTERISTIC core_gp_xSwapBytes /end REF_CHARACTERISTIC /end GROUP
/begin GROUP S3103_SDO_Error_Reply "SC_KZQ_EV2274A_4_1/Main/CAN SDO/SDO  0x7C/Case 0x6445h/ Case 0x6445-042/SDO Reply/SDO Error Reply"
 /begin REF_CHARACTERISTIC core_gcp_u8CanSDOCmd_ErrReply core_gcp_u8CanSDOCmd_ErrReply_MainIndexMismatch core_gcp_u8CanSDOCmd_ErrReply_SubIndexMismatch core_gcp_u8CanSDOCmd_ErrReply_WrongCommand /end REF_CHARACTERISTIC
/end GROUP
/begin GROUP S3103_value_To_uint8_4_ "SC_KZQ_EV2274A_4_1/Main/CAN SDO/SDO  0x7C/Case 0x6445h/ Case 0x6445-042/SDO Reply/value_To_uint8[4]" /begin REF_CHARACTERISTIC core_gp_xSwapBytes /end REF_CHARACTERISTIC /end GROUP
/begin GROUP S3103_value_To_uint8_4_1 "SC_KZQ_EV2274A_4_1/Main/CAN SDO/SDO  0x7C/Case 0x6445h/ Case 0x6445-042/SDO Reply/value_To_uint8[4]1" /begin REF_CHARACTERISTIC core_gp_xSwapBytes /end REF_CHARACTERISTIC /end GROUP
/begin GROUP S3139_SDO_Error_Reply "SC_KZQ_EV2274A_4_1/Main/CAN SDO/SDO  0x7C/Case 0x6445h/ Case 0x6445-043/SDO Reply/SDO Error Reply"
 /begin REF_CHARACTERISTIC core_gcp_u8CanSDOCmd_ErrReply core_gcp_u8CanSDOCmd_ErrReply_MainIndexMismatch core_gcp_u8CanSDOCmd_ErrReply_SubIndexMismatch core_gcp_u8CanSDOCmd_ErrReply_WrongCommand /end REF_CHARACTERISTIC
/end GROUP
/begin GROUP S3139_value_To_uint8_4_ "SC_KZQ_EV2274A_4_1/Main/CAN SDO/SDO  0x7C/Case 0x6445h/ Case 0x6445-043/SDO Reply/value_To_uint8[4]" /begin REF_CHARACTERISTIC core_gp_xSwapBytes /end REF_CHARACTERISTIC /end GROUP
/begin GROUP S3139_value_To_uint8_4_1 "SC_KZQ_EV2274A_4_1/Main/CAN SDO/SDO  0x7C/Case 0x6445h/ Case 0x6445-043/SDO Reply/value_To_uint8[4]1" /begin REF_CHARACTERISTIC core_gp_xSwapBytes /end REF_CHARACTERISTIC /end GROUP
/begin GROUP S3175_SDO_Error_Reply "SC_KZQ_EV2274A_4_1/Main/CAN SDO/SDO  0x7C/Case 0x6445h/ Case 0x6445-044/SDO Reply/SDO Error Reply"
 /begin REF_CHARACTERISTIC core_gcp_u8CanSDOCmd_ErrReply core_gcp_u8CanSDOCmd_ErrReply_MainIndexMismatch core_gcp_u8CanSDOCmd_ErrReply_SubIndexMismatch core_gcp_u8CanSDOCmd_ErrReply_WrongCommand /end REF_CHARACTERISTIC
/end GROUP
/begin GROUP S3175_value_To_uint8_4_ "SC_KZQ_EV2274A_4_1/Main/CAN SDO/SDO  0x7C/Case 0x6445h/ Case 0x6445-044/SDO Reply/value_To_uint8[4]" /begin REF_CHARACTERISTIC core_gp_xSwapBytes /end REF_CHARACTERISTIC /end GROUP
/begin GROUP S3175_value_To_uint8_4_1 "SC_KZQ_EV2274A_4_1/Main/CAN SDO/SDO  0x7C/Case 0x6445h/ Case 0x6445-044/SDO Reply/value_To_uint8[4]1" /begin REF_CHARACTERISTIC core_gp_xSwapBytes /end REF_CHARACTERISTIC /end GROUP
/begin GROUP S3211_SDO_Error_Reply "SC_KZQ_EV2274A_4_1/Main/CAN SDO/SDO  0x7C/Case 0x6445h/ Case 0x6445-045/SDO Reply/SDO Error Reply"
 /begin REF_CHARACTERISTIC core_gcp_u8CanSDOCmd_ErrReply core_gcp_u8CanSDOCmd_ErrReply_MainIndexMismatch core_gcp_u8CanSDOCmd_ErrReply_SubIndexMismatch core_gcp_u8CanSDOCmd_ErrReply_WrongCommand /end REF_CHARACTERISTIC
/end GROUP
/begin GROUP S3211_value_To_uint8_4_ "SC_KZQ_EV2274A_4_1/Main/CAN SDO/SDO  0x7C/Case 0x6445h/ Case 0x6445-045/SDO Reply/value_To_uint8[4]" /begin REF_CHARACTERISTIC core_gp_xSwapBytes /end REF_CHARACTERISTIC /end GROUP
/begin GROUP S3211_value_To_uint8_4_1 "SC_KZQ_EV2274A_4_1/Main/CAN SDO/SDO  0x7C/Case 0x6445h/ Case 0x6445-045/SDO Reply/value_To_uint8[4]1" /begin REF_CHARACTERISTIC core_gp_xSwapBytes /end REF_CHARACTERISTIC /end GROUP
/begin GROUP S3247_SDO_Error_Reply "SC_KZQ_EV2274A_4_1/Main/CAN SDO/SDO  0x7C/Case 0x6445h/ Case 0x6445-046/SDO Reply/SDO Error Reply"
 /begin REF_CHARACTERISTIC core_gcp_u8CanSDOCmd_ErrReply core_gcp_u8CanSDOCmd_ErrReply_MainIndexMismatch core_gcp_u8CanSDOCmd_ErrReply_SubIndexMismatch core_gcp_u8CanSDOCmd_ErrReply_WrongCommand /end REF_CHARACTERISTIC
/end GROUP
/begin GROUP S3247_value_To_uint8_4_ "SC_KZQ_EV2274A_4_1/Main/CAN SDO/SDO  0x7C/Case 0x6445h/ Case 0x6445-046/SDO Reply/value_To_uint8[4]" /begin REF_CHARACTERISTIC core_gp_xSwapBytes /end REF_CHARACTERISTIC /end GROUP
/begin GROUP S3247_value_To_uint8_4_1 "SC_KZQ_EV2274A_4_1/Main/CAN SDO/SDO  0x7C/Case 0x6445h/ Case 0x6445-046/SDO Reply/value_To_uint8[4]1" /begin REF_CHARACTERISTIC core_gp_xSwapBytes /end REF_CHARACTERISTIC /end GROUP
/begin GROUP S3283_SDO_Error_Reply "SC_KZQ_EV2274A_4_1/Main/CAN SDO/SDO  0x7C/Case 0x6445h/ Case 0x6445-060/SDO Reply/SDO Error Reply"
 /begin REF_CHARACTERISTIC core_gcp_u8CanSDOCmd_ErrReply core_gcp_u8CanSDOCmd_ErrReply_MainIndexMismatch core_gcp_u8CanSDOCmd_ErrReply_SubIndexMismatch core_gcp_u8CanSDOCmd_ErrReply_WrongCommand /end REF_CHARACTERISTIC
/end GROUP
/begin GROUP S3283_value_To_uint8_4_ "SC_KZQ_EV2274A_4_1/Main/CAN SDO/SDO  0x7C/Case 0x6445h/ Case 0x6445-060/SDO Reply/value_To_uint8[4]" /begin REF_CHARACTERISTIC core_gp_xSwapBytes /end REF_CHARACTERISTIC /end GROUP
/begin GROUP S3283_value_To_uint8_4_1 "SC_KZQ_EV2274A_4_1/Main/CAN SDO/SDO  0x7C/Case 0x6445h/ Case 0x6445-060/SDO Reply/value_To_uint8[4]1" /begin REF_CHARACTERISTIC core_gp_xSwapBytes /end REF_CHARACTERISTIC /end GROUP
/begin GROUP S3319_SDO_Error_Reply "SC_KZQ_EV2274A_4_1/Main/CAN SDO/SDO  0x7C/Case 0x6445h/ Case 0x6445-061/SDO Reply/SDO Error Reply"
 /begin REF_CHARACTERISTIC core_gcp_u8CanSDOCmd_ErrReply core_gcp_u8CanSDOCmd_ErrReply_MainIndexMismatch core_gcp_u8CanSDOCmd_ErrReply_SubIndexMismatch core_gcp_u8CanSDOCmd_ErrReply_WrongCommand /end REF_CHARACTERISTIC
/end GROUP
/begin GROUP S3319_value_To_uint8_4_ "SC_KZQ_EV2274A_4_1/Main/CAN SDO/SDO  0x7C/Case 0x6445h/ Case 0x6445-061/SDO Reply/value_To_uint8[4]" /begin REF_CHARACTERISTIC core_gp_xSwapBytes /end REF_CHARACTERISTIC /end GROUP
/begin GROUP S3319_value_To_uint8_4_1 "SC_KZQ_EV2274A_4_1/Main/CAN SDO/SDO  0x7C/Case 0x6445h/ Case 0x6445-061/SDO Reply/value_To_uint8[4]1" /begin REF_CHARACTERISTIC core_gp_xSwapBytes /end REF_CHARACTERISTIC /end GROUP
/begin GROUP S3355_SDO_Error_Reply "SC_KZQ_EV2274A_4_1/Main/CAN SDO/SDO  0x7C/Case 0x6445h/ Case 0x6445-062/SDO Reply/SDO Error Reply"
 /begin REF_CHARACTERISTIC core_gcp_u8CanSDOCmd_ErrReply core_gcp_u8CanSDOCmd_ErrReply_MainIndexMismatch core_gcp_u8CanSDOCmd_ErrReply_SubIndexMismatch core_gcp_u8CanSDOCmd_ErrReply_WrongCommand /end REF_CHARACTERISTIC
/end GROUP
/begin GROUP S3355_value_To_uint8_4_ "SC_KZQ_EV2274A_4_1/Main/CAN SDO/SDO  0x7C/Case 0x6445h/ Case 0x6445-062/SDO Reply/value_To_uint8[4]" /begin REF_CHARACTERISTIC core_gp_xSwapBytes /end REF_CHARACTERISTIC /end GROUP
/begin GROUP S3355_value_To_uint8_4_1 "SC_KZQ_EV2274A_4_1/Main/CAN SDO/SDO  0x7C/Case 0x6445h/ Case 0x6445-062/SDO Reply/value_To_uint8[4]1" /begin REF_CHARACTERISTIC core_gp_xSwapBytes /end REF_CHARACTERISTIC /end GROUP
/begin GROUP S3391_SDO_Error_Reply "SC_KZQ_EV2274A_4_1/Main/CAN SDO/SDO  0x7C/Case 0x6445h/ Case 0x6445-080/SDO Reply/SDO Error Reply"
 /begin REF_CHARACTERISTIC core_gcp_u8CanSDOCmd_ErrReply core_gcp_u8CanSDOCmd_ErrReply_MainIndexMismatch core_gcp_u8CanSDOCmd_ErrReply_SubIndexMismatch core_gcp_u8CanSDOCmd_ErrReply_WrongCommand /end REF_CHARACTERISTIC
/end GROUP
/begin GROUP S3391_value_To_uint8_4_ "SC_KZQ_EV2274A_4_1/Main/CAN SDO/SDO  0x7C/Case 0x6445h/ Case 0x6445-080/SDO Reply/value_To_uint8[4]" /begin REF_CHARACTERISTIC core_gp_xSwapBytes /end REF_CHARACTERISTIC /end GROUP
/begin GROUP S3391_value_To_uint8_4_1 "SC_KZQ_EV2274A_4_1/Main/CAN SDO/SDO  0x7C/Case 0x6445h/ Case 0x6445-080/SDO Reply/value_To_uint8[4]1" /begin REF_CHARACTERISTIC core_gp_xSwapBytes /end REF_CHARACTERISTIC /end GROUP
/begin GROUP S3427_SDO_Error_Reply "SC_KZQ_EV2274A_4_1/Main/CAN SDO/SDO  0x7C/Case 0x6445h/ Case 0x6445-081/SDO Reply/SDO Error Reply"
 /begin REF_CHARACTERISTIC core_gcp_u8CanSDOCmd_ErrReply core_gcp_u8CanSDOCmd_ErrReply_MainIndexMismatch core_gcp_u8CanSDOCmd_ErrReply_SubIndexMismatch core_gcp_u8CanSDOCmd_ErrReply_WrongCommand /end REF_CHARACTERISTIC
/end GROUP
/begin GROUP S3427_value_To_uint8_4_ "SC_KZQ_EV2274A_4_1/Main/CAN SDO/SDO  0x7C/Case 0x6445h/ Case 0x6445-081/SDO Reply/value_To_uint8[4]" /begin REF_CHARACTERISTIC core_gp_xSwapBytes /end REF_CHARACTERISTIC /end GROUP
/begin GROUP S3427_value_To_uint8_4_1 "SC_KZQ_EV2274A_4_1/Main/CAN SDO/SDO  0x7C/Case 0x6445h/ Case 0x6445-081/SDO Reply/value_To_uint8[4]1" /begin REF_CHARACTERISTIC core_gp_xSwapBytes /end REF_CHARACTERISTIC /end GROUP
/begin GROUP S3463_SDO_Error_Reply "SC_KZQ_EV2274A_4_1/Main/CAN SDO/SDO  0x7C/Case 0x6445h/ Case 0x6445-090/SDO Reply/SDO Error Reply"
 /begin REF_CHARACTERISTIC core_gcp_u8CanSDOCmd_ErrReply core_gcp_u8CanSDOCmd_ErrReply_MainIndexMismatch core_gcp_u8CanSDOCmd_ErrReply_SubIndexMismatch core_gcp_u8CanSDOCmd_ErrReply_WrongCommand /end REF_CHARACTERISTIC
/end GROUP
/begin GROUP S3463_value_To_uint8_4_ "SC_KZQ_EV2274A_4_1/Main/CAN SDO/SDO  0x7C/Case 0x6445h/ Case 0x6445-090/SDO Reply/value_To_uint8[4]" /begin REF_CHARACTERISTIC core_gp_xSwapBytes /end REF_CHARACTERISTIC /end GROUP
/begin GROUP S3463_value_To_uint8_4_1 "SC_KZQ_EV2274A_4_1/Main/CAN SDO/SDO  0x7C/Case 0x6445h/ Case 0x6445-090/SDO Reply/value_To_uint8[4]1" /begin REF_CHARACTERISTIC core_gp_xSwapBytes /end REF_CHARACTERISTIC /end GROUP
/begin GROUP S3499_SDO_Error_Reply "SC_KZQ_EV2274A_4_1/Main/CAN SDO/SDO  0x7C/Case 0x6445h/ Case 0x6445-091/SDO Reply/SDO Error Reply"
 /begin REF_CHARACTERISTIC core_gcp_u8CanSDOCmd_ErrReply core_gcp_u8CanSDOCmd_ErrReply_MainIndexMismatch core_gcp_u8CanSDOCmd_ErrReply_SubIndexMismatch core_gcp_u8CanSDOCmd_ErrReply_WrongCommand /end REF_CHARACTERISTIC
/end GROUP
/begin GROUP S3499_value_To_uint8_4_ "SC_KZQ_EV2274A_4_1/Main/CAN SDO/SDO  0x7C/Case 0x6445h/ Case 0x6445-091/SDO Reply/value_To_uint8[4]" /begin REF_CHARACTERISTIC core_gp_xSwapBytes /end REF_CHARACTERISTIC /end GROUP
/begin GROUP S3499_value_To_uint8_4_1 "SC_KZQ_EV2274A_4_1/Main/CAN SDO/SDO  0x7C/Case 0x6445h/ Case 0x6445-091/SDO Reply/value_To_uint8[4]1" /begin REF_CHARACTERISTIC core_gp_xSwapBytes /end REF_CHARACTERISTIC /end GROUP
/begin GROUP S3535_SDO_Error_Reply "SC_KZQ_EV2274A_4_1/Main/CAN SDO/SDO  0x7C/Case 0x6445h/ Case 0x6445-092/SDO Reply/SDO Error Reply"
 /begin REF_CHARACTERISTIC core_gcp_u8CanSDOCmd_ErrReply core_gcp_u8CanSDOCmd_ErrReply_MainIndexMismatch core_gcp_u8CanSDOCmd_ErrReply_SubIndexMismatch core_gcp_u8CanSDOCmd_ErrReply_WrongCommand /end REF_CHARACTERISTIC
/end GROUP
/begin GROUP S3535_value_To_uint8_4_ "SC_KZQ_EV2274A_4_1/Main/CAN SDO/SDO  0x7C/Case 0x6445h/ Case 0x6445-092/SDO Reply/value_To_uint8[4]" /begin REF_CHARACTERISTIC core_gp_xSwapBytes /end REF_CHARACTERISTIC /end GROUP
/begin GROUP S3535_value_To_uint8_4_1 "SC_KZQ_EV2274A_4_1/Main/CAN SDO/SDO  0x7C/Case 0x6445h/ Case 0x6445-092/SDO Reply/value_To_uint8[4]1" /begin REF_CHARACTERISTIC core_gp_xSwapBytes /end REF_CHARACTERISTIC /end GROUP
/begin GROUP S3571_SDO_Error_Reply "SC_KZQ_EV2274A_4_1/Main/CAN SDO/SDO  0x7C/Case 0x6445h/ Case 0x6445-093/SDO Reply/SDO Error Reply"
 /begin REF_CHARACTERISTIC core_gcp_u8CanSDOCmd_ErrReply core_gcp_u8CanSDOCmd_ErrReply_MainIndexMismatch core_gcp_u8CanSDOCmd_ErrReply_SubIndexMismatch core_gcp_u8CanSDOCmd_ErrReply_WrongCommand /end REF_CHARACTERISTIC
/end GROUP
/begin GROUP S3571_value_To_uint8_4_ "SC_KZQ_EV2274A_4_1/Main/CAN SDO/SDO  0x7C/Case 0x6445h/ Case 0x6445-093/SDO Reply/value_To_uint8[4]" /begin REF_CHARACTERISTIC core_gp_xSwapBytes /end REF_CHARACTERISTIC /end GROUP
/begin GROUP S3571_value_To_uint8_4_1 "SC_KZQ_EV2274A_4_1/Main/CAN SDO/SDO  0x7C/Case 0x6445h/ Case 0x6445-093/SDO Reply/value_To_uint8[4]1" /begin REF_CHARACTERISTIC core_gp_xSwapBytes /end REF_CHARACTERISTIC /end GROUP
/begin GROUP S3607_SDO_Error_Reply "SC_KZQ_EV2274A_4_1/Main/CAN SDO/SDO  0x7C/Case 0x6445h/ Case 0x6445-180/SDO Reply/SDO Error Reply"
 /begin REF_CHARACTERISTIC core_gcp_u8CanSDOCmd_ErrReply core_gcp_u8CanSDOCmd_ErrReply_MainIndexMismatch core_gcp_u8CanSDOCmd_ErrReply_SubIndexMismatch core_gcp_u8CanSDOCmd_ErrReply_WrongCommand /end REF_CHARACTERISTIC
/end GROUP
/begin GROUP S3607_value_To_uint8_4_ "SC_KZQ_EV2274A_4_1/Main/CAN SDO/SDO  0x7C/Case 0x6445h/ Case 0x6445-180/SDO Reply/value_To_uint8[4]" /begin REF_CHARACTERISTIC core_gp_xSwapBytes /end REF_CHARACTERISTIC /end GROUP
/begin GROUP S3607_value_To_uint8_4_1 "SC_KZQ_EV2274A_4_1/Main/CAN SDO/SDO  0x7C/Case 0x6445h/ Case 0x6445-180/SDO Reply/value_To_uint8[4]1" /begin REF_CHARACTERISTIC core_gp_xSwapBytes /end REF_CHARACTERISTIC /end GROUP
/begin GROUP S3671_SDO_Error_Reply "SC_KZQ_EV2274A_4_1/Main/CAN SDO/SDO  0x7C/Case 0x6447h/ Case 0x6447-001/SDO Reply/SDO Error Reply"
 /begin REF_CHARACTERISTIC core_gcp_u8CanSDOCmd_ErrReply core_gcp_u8CanSDOCmd_ErrReply_MainIndexMismatch core_gcp_u8CanSDOCmd_ErrReply_SubIndexMismatch core_gcp_u8CanSDOCmd_ErrReply_WrongCommand /end REF_CHARACTERISTIC
/end GROUP
/begin GROUP S3671_value_To_uint8_4_ "SC_KZQ_EV2274A_4_1/Main/CAN SDO/SDO  0x7C/Case 0x6447h/ Case 0x6447-001/SDO Reply/value_To_uint8[4]" /begin REF_CHARACTERISTIC core_gp_xSwapBytes /end REF_CHARACTERISTIC /end GROUP
/begin GROUP S3671_value_To_uint8_4_1 "SC_KZQ_EV2274A_4_1/Main/CAN SDO/SDO  0x7C/Case 0x6447h/ Case 0x6447-001/SDO Reply/value_To_uint8[4]1" /begin REF_CHARACTERISTIC core_gp_xSwapBytes /end REF_CHARACTERISTIC /end GROUP
/begin GROUP S3707_SDO_Error_Reply "SC_KZQ_EV2274A_4_1/Main/CAN SDO/SDO  0x7C/Case 0x6447h/ Case 0x6447-002/SDO Reply/SDO Error Reply"
 /begin REF_CHARACTERISTIC core_gcp_u8CanSDOCmd_ErrReply core_gcp_u8CanSDOCmd_ErrReply_MainIndexMismatch core_gcp_u8CanSDOCmd_ErrReply_SubIndexMismatch core_gcp_u8CanSDOCmd_ErrReply_WrongCommand /end REF_CHARACTERISTIC
/end GROUP
/begin GROUP S3707_value_To_uint8_4_ "SC_KZQ_EV2274A_4_1/Main/CAN SDO/SDO  0x7C/Case 0x6447h/ Case 0x6447-002/SDO Reply/value_To_uint8[4]" /begin REF_CHARACTERISTIC core_gp_xSwapBytes /end REF_CHARACTERISTIC /end GROUP
/begin GROUP S3707_value_To_uint8_4_1 "SC_KZQ_EV2274A_4_1/Main/CAN SDO/SDO  0x7C/Case 0x6447h/ Case 0x6447-002/SDO Reply/value_To_uint8[4]1" /begin REF_CHARACTERISTIC core_gp_xSwapBytes /end REF_CHARACTERISTIC /end GROUP
/begin GROUP S3743_SDO_Error_Reply "SC_KZQ_EV2274A_4_1/Main/CAN SDO/SDO  0x7C/Case 0x6447h/ Case 0x6447-003/SDO Reply/SDO Error Reply"
 /begin REF_CHARACTERISTIC core_gcp_u8CanSDOCmd_ErrReply core_gcp_u8CanSDOCmd_ErrReply_MainIndexMismatch core_gcp_u8CanSDOCmd_ErrReply_SubIndexMismatch core_gcp_u8CanSDOCmd_ErrReply_WrongCommand /end REF_CHARACTERISTIC
/end GROUP
/begin GROUP S3743_value_To_uint8_4_ "SC_KZQ_EV2274A_4_1/Main/CAN SDO/SDO  0x7C/Case 0x6447h/ Case 0x6447-003/SDO Reply/value_To_uint8[4]" /begin REF_CHARACTERISTIC core_gp_xSwapBytes /end REF_CHARACTERISTIC /end GROUP
/begin GROUP S3743_value_To_uint8_4_1 "SC_KZQ_EV2274A_4_1/Main/CAN SDO/SDO  0x7C/Case 0x6447h/ Case 0x6447-003/SDO Reply/value_To_uint8[4]1" /begin REF_CHARACTERISTIC core_gp_xSwapBytes /end REF_CHARACTERISTIC /end GROUP
/begin GROUP S3779_SDO_Error_Reply "SC_KZQ_EV2274A_4_1/Main/CAN SDO/SDO  0x7C/Case 0x6447h/ Case 0x6447-004/SDO Reply/SDO Error Reply"
 /begin REF_CHARACTERISTIC core_gcp_u8CanSDOCmd_ErrReply core_gcp_u8CanSDOCmd_ErrReply_MainIndexMismatch core_gcp_u8CanSDOCmd_ErrReply_SubIndexMismatch core_gcp_u8CanSDOCmd_ErrReply_WrongCommand /end REF_CHARACTERISTIC
/end GROUP
/begin GROUP S3779_value_To_uint8_4_ "SC_KZQ_EV2274A_4_1/Main/CAN SDO/SDO  0x7C/Case 0x6447h/ Case 0x6447-004/SDO Reply/value_To_uint8[4]" /begin REF_CHARACTERISTIC core_gp_xSwapBytes /end REF_CHARACTERISTIC /end GROUP
/begin GROUP S3779_value_To_uint8_4_1 "SC_KZQ_EV2274A_4_1/Main/CAN SDO/SDO  0x7C/Case 0x6447h/ Case 0x6447-004/SDO Reply/value_To_uint8[4]1" /begin REF_CHARACTERISTIC core_gp_xSwapBytes /end REF_CHARACTERISTIC /end GROUP
/begin GROUP S3815_SDO_Error_Reply "SC_KZQ_EV2274A_4_1/Main/CAN SDO/SDO  0x7C/Case 0x6447h/ Case 0x6447-005/SDO Reply/SDO Error Reply"
 /begin REF_CHARACTERISTIC core_gcp_u8CanSDOCmd_ErrReply core_gcp_u8CanSDOCmd_ErrReply_MainIndexMismatch core_gcp_u8CanSDOCmd_ErrReply_SubIndexMismatch core_gcp_u8CanSDOCmd_ErrReply_WrongCommand /end REF_CHARACTERISTIC
/end GROUP
/begin GROUP S3815_value_To_uint8_4_ "SC_KZQ_EV2274A_4_1/Main/CAN SDO/SDO  0x7C/Case 0x6447h/ Case 0x6447-005/SDO Reply/value_To_uint8[4]" /begin REF_CHARACTERISTIC core_gp_xSwapBytes /end REF_CHARACTERISTIC /end GROUP
/begin GROUP S3815_value_To_uint8_4_1 "SC_KZQ_EV2274A_4_1/Main/CAN SDO/SDO  0x7C/Case 0x6447h/ Case 0x6447-005/SDO Reply/value_To_uint8[4]1" /begin REF_CHARACTERISTIC core_gp_xSwapBytes /end REF_CHARACTERISTIC /end GROUP
/begin GROUP S3851_SDO_Error_Reply "SC_KZQ_EV2274A_4_1/Main/CAN SDO/SDO  0x7C/Case 0x6447h/ Case 0x6447-006/SDO Reply/SDO Error Reply"
 /begin REF_CHARACTERISTIC core_gcp_u8CanSDOCmd_ErrReply core_gcp_u8CanSDOCmd_ErrReply_MainIndexMismatch core_gcp_u8CanSDOCmd_ErrReply_SubIndexMismatch core_gcp_u8CanSDOCmd_ErrReply_WrongCommand /end REF_CHARACTERISTIC
/end GROUP
/begin GROUP S3851_value_To_uint8_4_ "SC_KZQ_EV2274A_4_1/Main/CAN SDO/SDO  0x7C/Case 0x6447h/ Case 0x6447-006/SDO Reply/value_To_uint8[4]" /begin REF_CHARACTERISTIC core_gp_xSwapBytes /end REF_CHARACTERISTIC /end GROUP
/begin GROUP S3851_value_To_uint8_4_1 "SC_KZQ_EV2274A_4_1/Main/CAN SDO/SDO  0x7C/Case 0x6447h/ Case 0x6447-006/SDO Reply/value_To_uint8[4]1" /begin REF_CHARACTERISTIC core_gp_xSwapBytes /end REF_CHARACTERISTIC /end GROUP
/begin GROUP S3887_SDO_Error_Reply "SC_KZQ_EV2274A_4_1/Main/CAN SDO/SDO  0x7C/Case 0x6447h/ Case 0x6447-031/SDO Reply/SDO Error Reply"
 /begin REF_CHARACTERISTIC core_gcp_u8CanSDOCmd_ErrReply core_gcp_u8CanSDOCmd_ErrReply_MainIndexMismatch core_gcp_u8CanSDOCmd_ErrReply_SubIndexMismatch core_gcp_u8CanSDOCmd_ErrReply_WrongCommand /end REF_CHARACTERISTIC
/end GROUP
/begin GROUP S3887_value_To_uint8_4_ "SC_KZQ_EV2274A_4_1/Main/CAN SDO/SDO  0x7C/Case 0x6447h/ Case 0x6447-031/SDO Reply/value_To_uint8[4]" /begin REF_CHARACTERISTIC core_gp_xSwapBytes /end REF_CHARACTERISTIC /end GROUP
/begin GROUP S3887_value_To_uint8_4_1 "SC_KZQ_EV2274A_4_1/Main/CAN SDO/SDO  0x7C/Case 0x6447h/ Case 0x6447-031/SDO Reply/value_To_uint8[4]1" /begin REF_CHARACTERISTIC core_gp_xSwapBytes /end REF_CHARACTERISTIC /end GROUP
/begin GROUP S3923_SDO_Error_Reply "SC_KZQ_EV2274A_4_1/Main/CAN SDO/SDO  0x7C/Case 0x6447h/ Case 0x6447-034/SDO Reply/SDO Error Reply"
 /begin REF_CHARACTERISTIC core_gcp_u8CanSDOCmd_ErrReply core_gcp_u8CanSDOCmd_ErrReply_MainIndexMismatch core_gcp_u8CanSDOCmd_ErrReply_SubIndexMismatch core_gcp_u8CanSDOCmd_ErrReply_WrongCommand /end REF_CHARACTERISTIC
/end GROUP
/begin GROUP S3923_value_To_uint8_4_ "SC_KZQ_EV2274A_4_1/Main/CAN SDO/SDO  0x7C/Case 0x6447h/ Case 0x6447-034/SDO Reply/value_To_uint8[4]" /begin REF_CHARACTERISTIC core_gp_xSwapBytes /end REF_CHARACTERISTIC /end GROUP
/begin GROUP S3923_value_To_uint8_4_1 "SC_KZQ_EV2274A_4_1/Main/CAN SDO/SDO  0x7C/Case 0x6447h/ Case 0x6447-034/SDO Reply/value_To_uint8[4]1" /begin REF_CHARACTERISTIC core_gp_xSwapBytes /end REF_CHARACTERISTIC /end GROUP
/begin GROUP S3959_SDO_Error_Reply "SC_KZQ_EV2274A_4_1/Main/CAN SDO/SDO  0x7C/Case 0x6447h/ Case 0x6447-061/SDO Reply/SDO Error Reply"
 /begin REF_CHARACTERISTIC core_gcp_u8CanSDOCmd_ErrReply core_gcp_u8CanSDOCmd_ErrReply_MainIndexMismatch core_gcp_u8CanSDOCmd_ErrReply_SubIndexMismatch core_gcp_u8CanSDOCmd_ErrReply_WrongCommand /end REF_CHARACTERISTIC
/end GROUP
/begin GROUP S3959_value_To_uint8_4_ "SC_KZQ_EV2274A_4_1/Main/CAN SDO/SDO  0x7C/Case 0x6447h/ Case 0x6447-061/SDO Reply/value_To_uint8[4]" /begin REF_CHARACTERISTIC core_gp_xSwapBytes /end REF_CHARACTERISTIC /end GROUP
/begin GROUP S3959_value_To_uint8_4_1 "SC_KZQ_EV2274A_4_1/Main/CAN SDO/SDO  0x7C/Case 0x6447h/ Case 0x6447-061/SDO Reply/value_To_uint8[4]1" /begin REF_CHARACTERISTIC core_gp_xSwapBytes /end REF_CHARACTERISTIC /end GROUP
/begin GROUP S3995_SDO_Error_Reply "SC_KZQ_EV2274A_4_1/Main/CAN SDO/SDO  0x7C/Case 0x6447h/ Case 0x6447-064/SDO Reply/SDO Error Reply"
 /begin REF_CHARACTERISTIC core_gcp_u8CanSDOCmd_ErrReply core_gcp_u8CanSDOCmd_ErrReply_MainIndexMismatch core_gcp_u8CanSDOCmd_ErrReply_SubIndexMismatch core_gcp_u8CanSDOCmd_ErrReply_WrongCommand /end REF_CHARACTERISTIC
/end GROUP
/begin GROUP S3995_value_To_uint8_4_ "SC_KZQ_EV2274A_4_1/Main/CAN SDO/SDO  0x7C/Case 0x6447h/ Case 0x6447-064/SDO Reply/value_To_uint8[4]" /begin REF_CHARACTERISTIC core_gp_xSwapBytes /end REF_CHARACTERISTIC /end GROUP
/begin GROUP S3995_value_To_uint8_4_1 "SC_KZQ_EV2274A_4_1/Main/CAN SDO/SDO  0x7C/Case 0x6447h/ Case 0x6447-064/SDO Reply/value_To_uint8[4]1" /begin REF_CHARACTERISTIC core_gp_xSwapBytes /end REF_CHARACTERISTIC /end GROUP
/begin GROUP S4031_SDO_Error_Reply "SC_KZQ_EV2274A_4_1/Main/CAN SDO/SDO  0x7C/Case 0x6447h/ Case 0x6447-067/SDO Reply/SDO Error Reply"
 /begin REF_CHARACTERISTIC core_gcp_u8CanSDOCmd_ErrReply core_gcp_u8CanSDOCmd_ErrReply_MainIndexMismatch core_gcp_u8CanSDOCmd_ErrReply_SubIndexMismatch core_gcp_u8CanSDOCmd_ErrReply_WrongCommand /end REF_CHARACTERISTIC
/end GROUP
/begin GROUP S4031_value_To_uint8_4_ "SC_KZQ_EV2274A_4_1/Main/CAN SDO/SDO  0x7C/Case 0x6447h/ Case 0x6447-067/SDO Reply/value_To_uint8[4]" /begin REF_CHARACTERISTIC core_gp_xSwapBytes /end REF_CHARACTERISTIC /end GROUP
/begin GROUP S4031_value_To_uint8_4_1 "SC_KZQ_EV2274A_4_1/Main/CAN SDO/SDO  0x7C/Case 0x6447h/ Case 0x6447-067/SDO Reply/value_To_uint8[4]1" /begin REF_CHARACTERISTIC core_gp_xSwapBytes /end REF_CHARACTERISTIC /end GROUP
/begin GROUP S4067_SDO_Error_Reply "SC_KZQ_EV2274A_4_1/Main/CAN SDO/SDO  0x7C/Case 0x6447h/ Case 0x6447-070/SDO Reply/SDO Error Reply"
 /begin REF_CHARACTERISTIC core_gcp_u8CanSDOCmd_ErrReply core_gcp_u8CanSDOCmd_ErrReply_MainIndexMismatch core_gcp_u8CanSDOCmd_ErrReply_SubIndexMismatch core_gcp_u8CanSDOCmd_ErrReply_WrongCommand /end REF_CHARACTERISTIC
/end GROUP
/begin GROUP S4067_value_To_uint8_4_ "SC_KZQ_EV2274A_4_1/Main/CAN SDO/SDO  0x7C/Case 0x6447h/ Case 0x6447-070/SDO Reply/value_To_uint8[4]" /begin REF_CHARACTERISTIC core_gp_xSwapBytes /end REF_CHARACTERISTIC /end GROUP
/begin GROUP S4067_value_To_uint8_4_1 "SC_KZQ_EV2274A_4_1/Main/CAN SDO/SDO  0x7C/Case 0x6447h/ Case 0x6447-070/SDO Reply/value_To_uint8[4]1" /begin REF_CHARACTERISTIC core_gp_xSwapBytes /end REF_CHARACTERISTIC /end GROUP
/begin GROUP S4103_SDO_Error_Reply "SC_KZQ_EV2274A_4_1/Main/CAN SDO/SDO  0x7C/Case 0x6447h/ Case 0x6447-073/SDO Reply/SDO Error Reply"
 /begin REF_CHARACTERISTIC core_gcp_u8CanSDOCmd_ErrReply core_gcp_u8CanSDOCmd_ErrReply_MainIndexMismatch core_gcp_u8CanSDOCmd_ErrReply_SubIndexMismatch core_gcp_u8CanSDOCmd_ErrReply_WrongCommand /end REF_CHARACTERISTIC
/end GROUP
/begin GROUP S4103_value_To_uint8_4_ "SC_KZQ_EV2274A_4_1/Main/CAN SDO/SDO  0x7C/Case 0x6447h/ Case 0x6447-073/SDO Reply/value_To_uint8[4]" /begin REF_CHARACTERISTIC core_gp_xSwapBytes /end REF_CHARACTERISTIC /end GROUP
/begin GROUP S4103_value_To_uint8_4_1 "SC_KZQ_EV2274A_4_1/Main/CAN SDO/SDO  0x7C/Case 0x6447h/ Case 0x6447-073/SDO Reply/value_To_uint8[4]1" /begin REF_CHARACTERISTIC core_gp_xSwapBytes /end REF_CHARACTERISTIC /end GROUP
/begin GROUP S4139_SDO_Error_Reply "SC_KZQ_EV2274A_4_1/Main/CAN SDO/SDO  0x7C/Case 0x6447h/ Case 0x6447-076/SDO Reply/SDO Error Reply"
 /begin REF_CHARACTERISTIC core_gcp_u8CanSDOCmd_ErrReply core_gcp_u8CanSDOCmd_ErrReply_MainIndexMismatch core_gcp_u8CanSDOCmd_ErrReply_SubIndexMismatch core_gcp_u8CanSDOCmd_ErrReply_WrongCommand /end REF_CHARACTERISTIC
/end GROUP
/begin GROUP S4139_value_To_uint8_4_ "SC_KZQ_EV2274A_4_1/Main/CAN SDO/SDO  0x7C/Case 0x6447h/ Case 0x6447-076/SDO Reply/value_To_uint8[4]" /begin REF_CHARACTERISTIC core_gp_xSwapBytes /end REF_CHARACTERISTIC /end GROUP
/begin GROUP S4139_value_To_uint8_4_1 "SC_KZQ_EV2274A_4_1/Main/CAN SDO/SDO  0x7C/Case 0x6447h/ Case 0x6447-076/SDO Reply/value_To_uint8[4]1" /begin REF_CHARACTERISTIC core_gp_xSwapBytes /end REF_CHARACTERISTIC /end GROUP
/begin GROUP S4175_SDO_Error_Reply "SC_KZQ_EV2274A_4_1/Main/CAN SDO/SDO  0x7C/Case 0x6447h/ Case 0x6447-097/SDO Reply/SDO Error Reply"
 /begin REF_CHARACTERISTIC core_gcp_u8CanSDOCmd_ErrReply core_gcp_u8CanSDOCmd_ErrReply_MainIndexMismatch core_gcp_u8CanSDOCmd_ErrReply_SubIndexMismatch core_gcp_u8CanSDOCmd_ErrReply_WrongCommand /end REF_CHARACTERISTIC
/end GROUP
/begin GROUP S4175_value_To_uint8_4_ "SC_KZQ_EV2274A_4_1/Main/CAN SDO/SDO  0x7C/Case 0x6447h/ Case 0x6447-097/SDO Reply/value_To_uint8[4]" /begin REF_CHARACTERISTIC core_gp_xSwapBytes /end REF_CHARACTERISTIC /end GROUP
/begin GROUP S4175_value_To_uint8_4_1 "SC_KZQ_EV2274A_4_1/Main/CAN SDO/SDO  0x7C/Case 0x6447h/ Case 0x6447-097/SDO Reply/value_To_uint8[4]1" /begin REF_CHARACTERISTIC core_gp_xSwapBytes /end REF_CHARACTERISTIC /end GROUP
/begin GROUP S4211_SDO_Error_Reply "SC_KZQ_EV2274A_4_1/Main/CAN SDO/SDO  0x7C/Case 0x6447h/ Case 0x6447-100/SDO Reply/SDO Error Reply"
 /begin REF_CHARACTERISTIC core_gcp_u8CanSDOCmd_ErrReply core_gcp_u8CanSDOCmd_ErrReply_MainIndexMismatch core_gcp_u8CanSDOCmd_ErrReply_SubIndexMismatch core_gcp_u8CanSDOCmd_ErrReply_WrongCommand /end REF_CHARACTERISTIC
/end GROUP
/begin GROUP S4211_value_To_uint8_4_ "SC_KZQ_EV2274A_4_1/Main/CAN SDO/SDO  0x7C/Case 0x6447h/ Case 0x6447-100/SDO Reply/value_To_uint8[4]" /begin REF_CHARACTERISTIC core_gp_xSwapBytes /end REF_CHARACTERISTIC /end GROUP
/begin GROUP S4211_value_To_uint8_4_1 "SC_KZQ_EV2274A_4_1/Main/CAN SDO/SDO  0x7C/Case 0x6447h/ Case 0x6447-100/SDO Reply/value_To_uint8[4]1" /begin REF_CHARACTERISTIC core_gp_xSwapBytes /end REF_CHARACTERISTIC /end GROUP
/begin GROUP S4247_SDO_Error_Reply "SC_KZQ_EV2274A_4_1/Main/CAN SDO/SDO  0x7C/Case 0x6447h/ Case 0x6447-103/SDO Reply/SDO Error Reply"
 /begin REF_CHARACTERISTIC core_gcp_u8CanSDOCmd_ErrReply core_gcp_u8CanSDOCmd_ErrReply_MainIndexMismatch core_gcp_u8CanSDOCmd_ErrReply_SubIndexMismatch core_gcp_u8CanSDOCmd_ErrReply_WrongCommand /end REF_CHARACTERISTIC
/end GROUP
/begin GROUP S4247_value_To_uint8_4_ "SC_KZQ_EV2274A_4_1/Main/CAN SDO/SDO  0x7C/Case 0x6447h/ Case 0x6447-103/SDO Reply/value_To_uint8[4]" /begin REF_CHARACTERISTIC core_gp_xSwapBytes /end REF_CHARACTERISTIC /end GROUP
/begin GROUP S4247_value_To_uint8_4_1 "SC_KZQ_EV2274A_4_1/Main/CAN SDO/SDO  0x7C/Case 0x6447h/ Case 0x6447-103/SDO Reply/value_To_uint8[4]1" /begin REF_CHARACTERISTIC core_gp_xSwapBytes /end REF_CHARACTERISTIC /end GROUP
/begin GROUP S4283_SDO_Error_Reply "SC_KZQ_EV2274A_4_1/Main/CAN SDO/SDO  0x7C/Case 0x6447h/ Case 0x6447-106/SDO Reply/SDO Error Reply"
 /begin REF_CHARACTERISTIC core_gcp_u8CanSDOCmd_ErrReply core_gcp_u8CanSDOCmd_ErrReply_MainIndexMismatch core_gcp_u8CanSDOCmd_ErrReply_SubIndexMismatch core_gcp_u8CanSDOCmd_ErrReply_WrongCommand /end REF_CHARACTERISTIC
/end GROUP
/begin GROUP S4283_value_To_uint8_4_ "SC_KZQ_EV2274A_4_1/Main/CAN SDO/SDO  0x7C/Case 0x6447h/ Case 0x6447-106/SDO Reply/value_To_uint8[4]" /begin REF_CHARACTERISTIC core_gp_xSwapBytes /end REF_CHARACTERISTIC /end GROUP
/begin GROUP S4283_value_To_uint8_4_1 "SC_KZQ_EV2274A_4_1/Main/CAN SDO/SDO  0x7C/Case 0x6447h/ Case 0x6447-106/SDO Reply/value_To_uint8[4]1" /begin REF_CHARACTERISTIC core_gp_xSwapBytes /end REF_CHARACTERISTIC /end GROUP
/begin GROUP S4319_SDO_Error_Reply "SC_KZQ_EV2274A_4_1/Main/CAN SDO/SDO  0x7C/Case 0x6447h/ Case 0x6447-151/SDO Reply/SDO Error Reply"
 /begin REF_CHARACTERISTIC core_gcp_u8CanSDOCmd_ErrReply core_gcp_u8CanSDOCmd_ErrReply_MainIndexMismatch core_gcp_u8CanSDOCmd_ErrReply_SubIndexMismatch core_gcp_u8CanSDOCmd_ErrReply_WrongCommand /end REF_CHARACTERISTIC
/end GROUP
/begin GROUP S4319_value_To_uint8_4_ "SC_KZQ_EV2274A_4_1/Main/CAN SDO/SDO  0x7C/Case 0x6447h/ Case 0x6447-151/SDO Reply/value_To_uint8[4]" /begin REF_CHARACTERISTIC core_gp_xSwapBytes /end REF_CHARACTERISTIC /end GROUP
/begin GROUP S4319_value_To_uint8_4_1 "SC_KZQ_EV2274A_4_1/Main/CAN SDO/SDO  0x7C/Case 0x6447h/ Case 0x6447-151/SDO Reply/value_To_uint8[4]1" /begin REF_CHARACTERISTIC core_gp_xSwapBytes /end REF_CHARACTERISTIC /end GROUP
/begin GROUP S4355_SDO_Error_Reply "SC_KZQ_EV2274A_4_1/Main/CAN SDO/SDO  0x7C/Case 0x6447h/ Case 0x6447-154/SDO Reply/SDO Error Reply"
 /begin REF_CHARACTERISTIC core_gcp_u8CanSDOCmd_ErrReply core_gcp_u8CanSDOCmd_ErrReply_MainIndexMismatch core_gcp_u8CanSDOCmd_ErrReply_SubIndexMismatch core_gcp_u8CanSDOCmd_ErrReply_WrongCommand /end REF_CHARACTERISTIC
/end GROUP
/begin GROUP S4355_value_To_uint8_4_ "SC_KZQ_EV2274A_4_1/Main/CAN SDO/SDO  0x7C/Case 0x6447h/ Case 0x6447-154/SDO Reply/value_To_uint8[4]" /begin REF_CHARACTERISTIC core_gp_xSwapBytes /end REF_CHARACTERISTIC /end GROUP
/begin GROUP S4355_value_To_uint8_4_1 "SC_KZQ_EV2274A_4_1/Main/CAN SDO/SDO  0x7C/Case 0x6447h/ Case 0x6447-154/SDO Reply/value_To_uint8[4]1" /begin REF_CHARACTERISTIC core_gp_xSwapBytes /end REF_CHARACTERISTIC /end GROUP
/begin GROUP S4391_SDO_Error_Reply "SC_KZQ_EV2274A_4_1/Main/CAN SDO/SDO  0x7C/Case 0x6447h/ Case 0x6447-37/SDO Reply/SDO Error Reply"
 /begin REF_CHARACTERISTIC core_gcp_u8CanSDOCmd_ErrReply core_gcp_u8CanSDOCmd_ErrReply_MainIndexMismatch core_gcp_u8CanSDOCmd_ErrReply_SubIndexMismatch core_gcp_u8CanSDOCmd_ErrReply_WrongCommand /end REF_CHARACTERISTIC
/end GROUP
/begin GROUP S4391_value_To_uint8_4_ "SC_KZQ_EV2274A_4_1/Main/CAN SDO/SDO  0x7C/Case 0x6447h/ Case 0x6447-37/SDO Reply/value_To_uint8[4]" /begin REF_CHARACTERISTIC core_gp_xSwapBytes /end REF_CHARACTERISTIC /end GROUP
/begin GROUP S4391_value_To_uint8_4_1 "SC_KZQ_EV2274A_4_1/Main/CAN SDO/SDO  0x7C/Case 0x6447h/ Case 0x6447-37/SDO Reply/value_To_uint8[4]1" /begin REF_CHARACTERISTIC core_gp_xSwapBytes /end REF_CHARACTERISTIC /end GROUP
/begin GROUP S4427_SDO_Error_Reply "SC_KZQ_EV2274A_4_1/Main/CAN SDO/SDO  0x7C/Case 0x6447h/ Case 0x6447-38/SDO Reply/SDO Error Reply"
 /begin REF_CHARACTERISTIC core_gcp_u8CanSDOCmd_ErrReply core_gcp_u8CanSDOCmd_ErrReply_MainIndexMismatch core_gcp_u8CanSDOCmd_ErrReply_SubIndexMismatch core_gcp_u8CanSDOCmd_ErrReply_WrongCommand /end REF_CHARACTERISTIC
/end GROUP
/begin GROUP S4427_value_To_uint8_4_ "SC_KZQ_EV2274A_4_1/Main/CAN SDO/SDO  0x7C/Case 0x6447h/ Case 0x6447-38/SDO Reply/value_To_uint8[4]" /begin REF_CHARACTERISTIC core_gp_xSwapBytes /end REF_CHARACTERISTIC /end GROUP
/begin GROUP S4427_value_To_uint8_4_1 "SC_KZQ_EV2274A_4_1/Main/CAN SDO/SDO  0x7C/Case 0x6447h/ Case 0x6447-38/SDO Reply/value_To_uint8[4]1" /begin REF_CHARACTERISTIC core_gp_xSwapBytes /end REF_CHARACTERISTIC /end GROUP
/begin GROUP S4472_SDO_Error_Reply "SC_KZQ_EV2274A_4_1/Main/CAN SDO/SDO  0x7C/Case 0x6508h/ Case 0x6508-001/SDO Reply/SDO Error Reply"
 /begin REF_CHARACTERISTIC core_gcp_u8CanSDOCmd_ErrReply core_gcp_u8CanSDOCmd_ErrReply_MainIndexMismatch core_gcp_u8CanSDOCmd_ErrReply_SubIndexMismatch core_gcp_u8CanSDOCmd_ErrReply_WrongCommand /end REF_CHARACTERISTIC
/end GROUP
/begin GROUP S4472_value_To_uint8_4_ "SC_KZQ_EV2274A_4_1/Main/CAN SDO/SDO  0x7C/Case 0x6508h/ Case 0x6508-001/SDO Reply/value_To_uint8[4]" /begin REF_CHARACTERISTIC core_gp_xSwapBytes /end REF_CHARACTERISTIC /end GROUP
/begin GROUP S4472_value_To_uint8_4_1 "SC_KZQ_EV2274A_4_1/Main/CAN SDO/SDO  0x7C/Case 0x6508h/ Case 0x6508-001/SDO Reply/value_To_uint8[4]1" /begin REF_CHARACTERISTIC core_gp_xSwapBytes /end REF_CHARACTERISTIC /end GROUP
/begin GROUP S4508_SDO_Error_Reply "SC_KZQ_EV2274A_4_1/Main/CAN SDO/SDO  0x7C/Case 0x6508h/ Case 0x6508-010/SDO Reply/SDO Error Reply"
 /begin REF_CHARACTERISTIC core_gcp_u8CanSDOCmd_ErrReply core_gcp_u8CanSDOCmd_ErrReply_MainIndexMismatch core_gcp_u8CanSDOCmd_ErrReply_SubIndexMismatch core_gcp_u8CanSDOCmd_ErrReply_WrongCommand /end REF_CHARACTERISTIC
/end GROUP
/begin GROUP S4508_value_To_uint8_4_ "SC_KZQ_EV2274A_4_1/Main/CAN SDO/SDO  0x7C/Case 0x6508h/ Case 0x6508-010/SDO Reply/value_To_uint8[4]" /begin REF_CHARACTERISTIC core_gp_xSwapBytes /end REF_CHARACTERISTIC /end GROUP
/begin GROUP S4508_value_To_uint8_4_1 "SC_KZQ_EV2274A_4_1/Main/CAN SDO/SDO  0x7C/Case 0x6508h/ Case 0x6508-010/SDO Reply/value_To_uint8[4]1" /begin REF_CHARACTERISTIC core_gp_xSwapBytes /end REF_CHARACTERISTIC /end GROUP
/begin GROUP S4544_SDO_Error_Reply "SC_KZQ_EV2274A_4_1/Main/CAN SDO/SDO  0x7C/Case 0x6508h/ Case 0x6508-020/SDO Reply/SDO Error Reply"
 /begin REF_CHARACTERISTIC core_gcp_u8CanSDOCmd_ErrReply core_gcp_u8CanSDOCmd_ErrReply_MainIndexMismatch core_gcp_u8CanSDOCmd_ErrReply_SubIndexMismatch core_gcp_u8CanSDOCmd_ErrReply_WrongCommand /end REF_CHARACTERISTIC
/end GROUP
/begin GROUP S4544_value_To_uint8_4_ "SC_KZQ_EV2274A_4_1/Main/CAN SDO/SDO  0x7C/Case 0x6508h/ Case 0x6508-020/SDO Reply/value_To_uint8[4]" /begin REF_CHARACTERISTIC core_gp_xSwapBytes /end REF_CHARACTERISTIC /end GROUP
/begin GROUP S4544_value_To_uint8_4_1 "SC_KZQ_EV2274A_4_1/Main/CAN SDO/SDO  0x7C/Case 0x6508h/ Case 0x6508-020/SDO Reply/value_To_uint8[4]1" /begin REF_CHARACTERISTIC core_gp_xSwapBytes /end REF_CHARACTERISTIC /end GROUP
/begin GROUP S4588_SDO_Error_Reply "SC_KZQ_EV2274A_4_1/Main/CAN SDO/SDO  0x7C/Case 0x6510h/ Case 0x6510-001/SDO Reply/SDO Error Reply"
 /begin REF_CHARACTERISTIC core_gcp_u8CanSDOCmd_ErrReply core_gcp_u8CanSDOCmd_ErrReply_MainIndexMismatch core_gcp_u8CanSDOCmd_ErrReply_SubIndexMismatch core_gcp_u8CanSDOCmd_ErrReply_WrongCommand /end REF_CHARACTERISTIC
/end GROUP
/begin GROUP S4588_value_To_uint8_4_ "SC_KZQ_EV2274A_4_1/Main/CAN SDO/SDO  0x7C/Case 0x6510h/ Case 0x6510-001/SDO Reply/value_To_uint8[4]" /begin REF_CHARACTERISTIC core_gp_xSwapBytes /end REF_CHARACTERISTIC /end GROUP
/begin GROUP S4588_value_To_uint8_4_1 "SC_KZQ_EV2274A_4_1/Main/CAN SDO/SDO  0x7C/Case 0x6510h/ Case 0x6510-001/SDO Reply/value_To_uint8[4]1" /begin REF_CHARACTERISTIC core_gp_xSwapBytes /end REF_CHARACTERISTIC /end GROUP
/begin GROUP S4624_SDO_Error_Reply "SC_KZQ_EV2274A_4_1/Main/CAN SDO/SDO  0x7C/Case 0x6510h/ Case 0x6510-002/SDO Reply/SDO Error Reply"
 /begin REF_CHARACTERISTIC core_gcp_u8CanSDOCmd_ErrReply core_gcp_u8CanSDOCmd_ErrReply_MainIndexMismatch core_gcp_u8CanSDOCmd_ErrReply_SubIndexMismatch core_gcp_u8CanSDOCmd_ErrReply_WrongCommand /end REF_CHARACTERISTIC
/end GROUP
/begin GROUP S4624_value_To_uint8_4_ "SC_KZQ_EV2274A_4_1/Main/CAN SDO/SDO  0x7C/Case 0x6510h/ Case 0x6510-002/SDO Reply/value_To_uint8[4]" /begin REF_CHARACTERISTIC core_gp_xSwapBytes /end REF_CHARACTERISTIC /end GROUP
/begin GROUP S4624_value_To_uint8_4_1 "SC_KZQ_EV2274A_4_1/Main/CAN SDO/SDO  0x7C/Case 0x6510h/ Case 0x6510-002/SDO Reply/value_To_uint8[4]1" /begin REF_CHARACTERISTIC core_gp_xSwapBytes /end REF_CHARACTERISTIC /end GROUP
/begin GROUP S4885_SDO_Error_Reply "SC_KZQ_EV2274A_4_1/Main/GPS /SDO  0x7B/Case 0x6520h(25888)/ Case 0x6520-001/SDO Reply/SDO Error Reply"
 /begin REF_CHARACTERISTIC core_gcp_u8CanSDOCmd_ErrReply core_gcp_u8CanSDOCmd_ErrReply_MainIndexMismatch core_gcp_u8CanSDOCmd_ErrReply_SubIndexMismatch core_gcp_u8CanSDOCmd_ErrReply_WrongCommand /end REF_CHARACTERISTIC
/end GROUP
/begin GROUP S4885_value_To_uint8_4_ "SC_KZQ_EV2274A_4_1/Main/GPS /SDO  0x7B/Case 0x6520h(25888)/ Case 0x6520-001/SDO Reply/value_To_uint8[4]" /begin REF_CHARACTERISTIC core_gp_xSwapBytes /end REF_CHARACTERISTIC /end GROUP
/begin GROUP S4885_value_To_uint8_4_1 "SC_KZQ_EV2274A_4_1/Main/GPS /SDO  0x7B/Case 0x6520h(25888)/ Case 0x6520-001/SDO Reply/value_To_uint8[4]1" /begin REF_CHARACTERISTIC core_gp_xSwapBytes /end REF_CHARACTERISTIC /end GROUP
/begin GROUP S4921_SDO_Error_Reply "SC_KZQ_EV2274A_4_1/Main/GPS /SDO  0x7B/Case 0x6520h(25888)/ Case 0x6520-002/SDO Reply/SDO Error Reply"
 /begin REF_CHARACTERISTIC core_gcp_u8CanSDOCmd_ErrReply core_gcp_u8CanSDOCmd_ErrReply_MainIndexMismatch core_gcp_u8CanSDOCmd_ErrReply_SubIndexMismatch core_gcp_u8CanSDOCmd_ErrReply_WrongCommand /end REF_CHARACTERISTIC
/end GROUP
/begin GROUP S4921_value_To_uint8_4_ "SC_KZQ_EV2274A_4_1/Main/GPS /SDO  0x7B/Case 0x6520h(25888)/ Case 0x6520-002/SDO Reply/value_To_uint8[4]" /begin REF_CHARACTERISTIC core_gp_xSwapBytes /end REF_CHARACTERISTIC /end GROUP
/begin GROUP S4921_value_To_uint8_4_1 "SC_KZQ_EV2274A_4_1/Main/GPS /SDO  0x7B/Case 0x6520h(25888)/ Case 0x6520-002/SDO Reply/value_To_uint8[4]1" /begin REF_CHARACTERISTIC core_gp_xSwapBytes /end REF_CHARACTERISTIC /end GROUP
/begin GROUP S4957_SDO_Error_Reply "SC_KZQ_EV2274A_4_1/Main/GPS /SDO  0x7B/Case 0x6520h(25888)/ Case 0x6520-003/SDO Reply/SDO Error Reply"
 /begin REF_CHARACTERISTIC core_gcp_u8CanSDOCmd_ErrReply core_gcp_u8CanSDOCmd_ErrReply_MainIndexMismatch core_gcp_u8CanSDOCmd_ErrReply_SubIndexMismatch core_gcp_u8CanSDOCmd_ErrReply_WrongCommand /end REF_CHARACTERISTIC
/end GROUP
/begin GROUP S4957_value_To_uint8_4_ "SC_KZQ_EV2274A_4_1/Main/GPS /SDO  0x7B/Case 0x6520h(25888)/ Case 0x6520-003/SDO Reply/value_To_uint8[4]" /begin REF_CHARACTERISTIC core_gp_xSwapBytes /end REF_CHARACTERISTIC /end GROUP
/begin GROUP S4957_value_To_uint8_4_1 "SC_KZQ_EV2274A_4_1/Main/GPS /SDO  0x7B/Case 0x6520h(25888)/ Case 0x6520-003/SDO Reply/value_To_uint8[4]1" /begin REF_CHARACTERISTIC core_gp_xSwapBytes /end REF_CHARACTERISTIC /end GROUP
/begin GROUP S4993_SDO_Error_Reply "SC_KZQ_EV2274A_4_1/Main/GPS /SDO  0x7B/Case 0x6520h(25888)/ Case 0x6520-004/SDO Reply/SDO Error Reply"
 /begin REF_CHARACTERISTIC core_gcp_u8CanSDOCmd_ErrReply core_gcp_u8CanSDOCmd_ErrReply_MainIndexMismatch core_gcp_u8CanSDOCmd_ErrReply_SubIndexMismatch core_gcp_u8CanSDOCmd_ErrReply_WrongCommand /end REF_CHARACTERISTIC
/end GROUP
/begin GROUP S4993_value_To_uint8_4_ "SC_KZQ_EV2274A_4_1/Main/GPS /SDO  0x7B/Case 0x6520h(25888)/ Case 0x6520-004/SDO Reply/value_To_uint8[4]" /begin REF_CHARACTERISTIC core_gp_xSwapBytes /end REF_CHARACTERISTIC /end GROUP
/begin GROUP S4993_value_To_uint8_4_1 "SC_KZQ_EV2274A_4_1/Main/GPS /SDO  0x7B/Case 0x6520h(25888)/ Case 0x6520-004/SDO Reply/value_To_uint8[4]1" /begin REF_CHARACTERISTIC core_gp_xSwapBytes /end REF_CHARACTERISTIC /end GROUP
/begin GROUP S5029_SDO_Error_Reply "SC_KZQ_EV2274A_4_1/Main/GPS /SDO  0x7B/Case 0x6520h(25888)/ Case 0x6520-005/SDO Reply/SDO Error Reply"
 /begin REF_CHARACTERISTIC core_gcp_u8CanSDOCmd_ErrReply core_gcp_u8CanSDOCmd_ErrReply_MainIndexMismatch core_gcp_u8CanSDOCmd_ErrReply_SubIndexMismatch core_gcp_u8CanSDOCmd_ErrReply_WrongCommand /end REF_CHARACTERISTIC
/end GROUP
/begin GROUP S5029_value_To_uint8_4_ "SC_KZQ_EV2274A_4_1/Main/GPS /SDO  0x7B/Case 0x6520h(25888)/ Case 0x6520-005/SDO Reply/value_To_uint8[4]" /begin REF_CHARACTERISTIC core_gp_xSwapBytes /end REF_CHARACTERISTIC /end GROUP
/begin GROUP S5029_value_To_uint8_4_1 "SC_KZQ_EV2274A_4_1/Main/GPS /SDO  0x7B/Case 0x6520h(25888)/ Case 0x6520-005/SDO Reply/value_To_uint8[4]1" /begin REF_CHARACTERISTIC core_gp_xSwapBytes /end REF_CHARACTERISTIC /end GROUP
/begin GROUP S5065_SDO_Error_Reply "SC_KZQ_EV2274A_4_1/Main/GPS /SDO  0x7B/Case 0x6520h(25888)/ Case 0x6520-010/SDO Reply/SDO Error Reply"
 /begin REF_CHARACTERISTIC core_gcp_u8CanSDOCmd_ErrReply core_gcp_u8CanSDOCmd_ErrReply_MainIndexMismatch core_gcp_u8CanSDOCmd_ErrReply_SubIndexMismatch core_gcp_u8CanSDOCmd_ErrReply_WrongCommand /end REF_CHARACTERISTIC
/end GROUP
/begin GROUP S5065_value_To_uint8_4_ "SC_KZQ_EV2274A_4_1/Main/GPS /SDO  0x7B/Case 0x6520h(25888)/ Case 0x6520-010/SDO Reply/value_To_uint8[4]" /begin REF_CHARACTERISTIC core_gp_xSwapBytes /end REF_CHARACTERISTIC /end GROUP
/begin GROUP S5065_value_To_uint8_4_1 "SC_KZQ_EV2274A_4_1/Main/GPS /SDO  0x7B/Case 0x6520h(25888)/ Case 0x6520-010/SDO Reply/value_To_uint8[4]1" /begin REF_CHARACTERISTIC core_gp_xSwapBytes /end REF_CHARACTERISTIC /end GROUP
/begin GROUP S5102_SDO_Error_Reply "SC_KZQ_EV2274A_4_1/Main/GPS /SDO  0x7B/Case 0x6520h(25888)/ Case 0x6520-011/SDO Reply/SDO Error Reply"
 /begin REF_CHARACTERISTIC core_gcp_u8CanSDOCmd_ErrReply core_gcp_u8CanSDOCmd_ErrReply_MainIndexMismatch core_gcp_u8CanSDOCmd_ErrReply_SubIndexMismatch core_gcp_u8CanSDOCmd_ErrReply_WrongCommand /end REF_CHARACTERISTIC
/end GROUP
/begin GROUP S5102_value_To_uint8_4_ "SC_KZQ_EV2274A_4_1/Main/GPS /SDO  0x7B/Case 0x6520h(25888)/ Case 0x6520-011/SDO Reply/value_To_uint8[4]" /begin REF_CHARACTERISTIC core_gp_xSwapBytes /end REF_CHARACTERISTIC /end GROUP
/begin GROUP S5102_value_To_uint8_4_1 "SC_KZQ_EV2274A_4_1/Main/GPS /SDO  0x7B/Case 0x6520h(25888)/ Case 0x6520-011/SDO Reply/value_To_uint8[4]1" /begin REF_CHARACTERISTIC core_gp_xSwapBytes /end REF_CHARACTERISTIC /end GROUP
/end MODULE
/end PROJECT
