ASAP2_VERSION 1 31
/begin PROJECT ProjectName "Project Comment Goes Here"
/begin HEADER "Header Comments go here" /end HEADER
/begin MODULE ModuleName "Module Comment Goes Here"
/begin MOD_COMMON "" /* Comment */ ALIGNMENT_BYTE 1 ALIGNMENT_WORD 1 ALIGNMENT_LONG 1 ALIGNMENT_FLOAT32_IEEE 1 ALIGNMENT_FLOAT64_IEEE 1 BYTE_ORDER MSB_FIRST DEPOSIT ABSOLUTE /end MOD_COMMON
/begin RECORD_LAYOUT Scalar_BOOLEAN FNC_VALUES 1 UBYTE COLUMN_DIR DIRECT /end RECORD_LAYOUT
/begin RECORD_LAYOUT Scalar_UBYTE FNC_VALUES 1 UBYTE COLUMN_DIR DIRECT /end RECORD_LAYOUT
/begin RECORD_LAYOUT Lookup1D_X_BOOLEAN AXIS_PTS_X 1 UBYTE INDEX_INCR DIRECT /end RECORD_LAYOUT
/begin RECORD_LAYOUT Lookup1D_BYTE FNC_VALUES 1 SBYTE COLUMN_DIR DIRECT /end RECORD_LAYOUT
/begin RECORD_LAYOUT Lookup1D_X_BYTE AXIS_PTS_X 1 SBYTE INDEX_INCR DIRECT /end RECORD_LAYOUT
/begin RECORD_LAYOUT Lookup1D_UBYTE FNC_VALUES 1 UBYTE COLUMN_DIR DIRECT /end RECORD_LAYOUT
/begin RECORD_LAYOUT Lookup1D_X_UBYTE AXIS_PTS_X 1 UBYTE INDEX_INCR DIRECT /end RECORD_LAYOUT
/begin RECORD_LAYOUT Lookup1D_UWORD FNC_VALUES 1 UWORD COLUMN_DIR DIRECT /end RECORD_LAYOUT
/begin RECORD_LAYOUT Lookup1D_X_UWORD AXIS_PTS_X 1 UWORD INDEX_INCR DIRECT /end RECORD_LAYOUT
/begin RECORD_LAYOUT Lookup1D_WORD FNC_VALUES 1 SWORD COLUMN_DIR DIRECT /end RECORD_LAYOUT
/begin RECORD_LAYOUT Lookup1D_X_WORD AXIS_PTS_X 1 SWORD INDEX_INCR DIRECT /end RECORD_LAYOUT
/begin RECORD_LAYOUT Lookup1D_ULONG FNC_VALUES 1 ULONG COLUMN_DIR DIRECT /end RECORD_LAYOUT
/begin RECORD_LAYOUT Lookup1D_X_ULONG AXIS_PTS_X 1 ULONG INDEX_INCR DIRECT /end RECORD_LAYOUT
/begin RECORD_LAYOUT Lookup1D_SLONG FNC_VALUES 1 SLONG COLUMN_DIR DIRECT /end RECORD_LAYOUT
/begin RECORD_LAYOUT Lookup1D_X_LONG AXIS_PTS_X 1 SLONG INDEX_INCR DIRECT /end RECORD_LAYOUT
/begin RECORD_LAYOUT Lookup1D_FLOAT32_IEEE FNC_VALUES 1 FLOAT32_IEEE COLUMN_DIR DIRECT /end RECORD_LAYOUT
/begin RECORD_LAYOUT Lookup1D_X_FLOAT32_IEEE AXIS_PTS_X 1 FLOAT32_IEEE INDEX_INCR DIRECT /end RECORD_LAYOUT
/begin RECORD_LAYOUT Lookup1D_FLOAT64_IEEE FNC_VALUES 1 FLOAT64_IEEE COLUMN_DIR DIRECT /end RECORD_LAYOUT
/begin RECORD_LAYOUT Lookup1D_X_FLOAT64_IEEE AXIS_PTS_X 1 FLOAT64_IEEE INDEX_INCR DIRECT /end RECORD_LAYOUT
/begin RECORD_LAYOUT Lookup2D_BOOLEAN FNC_VALUES 1 UBYTE COLUMN_DIR DIRECT /end RECORD_LAYOUT
/begin RECORD_LAYOUT Lookup2D_X_BOOLEAN AXIS_PTS_X 1 UBYTE INDEX_INCR DIRECT /end RECORD_LAYOUT
/begin RECORD_LAYOUT Lookup2D_UBYTE FNC_VALUES 1 UBYTE COLUMN_DIR DIRECT /end RECORD_LAYOUT
/begin RECORD_LAYOUT Lookup2D_X_UBYTE AXIS_PTS_X 1 UBYTE INDEX_INCR DIRECT /end RECORD_LAYOUT
/begin RECORD_LAYOUT Lookup2D_BYTE FNC_VALUES 1 SBYTE COLUMN_DIR DIRECT /end RECORD_LAYOUT
/begin RECORD_LAYOUT Lookup2D_X_BYTE AXIS_PTS_X 1 SBYTE INDEX_INCR DIRECT /end RECORD_LAYOUT
/begin RECORD_LAYOUT Lookup2D_UWORD FNC_VALUES 1 UWORD COLUMN_DIR DIRECT /end RECORD_LAYOUT
/begin RECORD_LAYOUT Lookup2D_X_UWORD AXIS_PTS_X 1 UWORD INDEX_INCR DIRECT /end RECORD_LAYOUT
/begin RECORD_LAYOUT Lookup2D_WORD FNC_VALUES 1 SWORD COLUMN_DIR DIRECT /end RECORD_LAYOUT
/begin RECORD_LAYOUT Lookup2D_X_WORD AXIS_PTS_X 1 SWORD INDEX_INCR DIRECT /end RECORD_LAYOUT
/begin RECORD_LAYOUT Lookup2D_ULONG FNC_VALUES 1 ULONG COLUMN_DIR DIRECT /end RECORD_LAYOUT
/begin RECORD_LAYOUT Lookup2D_X_ULONG AXIS_PTS_X 1 ULONG INDEX_INCR DIRECT /end RECORD_LAYOUT
/begin RECORD_LAYOUT Lookup2D_LONG FNC_VALUES 1 SLONG COLUMN_DIR DIRECT /end RECORD_LAYOUT
/begin RECORD_LAYOUT Lookup2D_X_LONG AXIS_PTS_X 1 SLONG INDEX_INCR DIRECT /end RECORD_LAYOUT
/begin RECORD_LAYOUT Lookup2D_FLOAT32_IEEE FNC_VALUES 1 FLOAT32_IEEE COLUMN_DIR DIRECT /end RECORD_LAYOUT
/begin RECORD_LAYOUT Lookup2D_X_FLOAT32_IEEE AXIS_PTS_X 1 FLOAT32_IEEE INDEX_INCR DIRECT /end RECORD_LAYOUT
/begin RECORD_LAYOUT Lookup2D_FLOAT64_IEEE FNC_VALUES 1 FLOAT64_IEEE COLUMN_DIR DIRECT /end RECORD_LAYOUT
/begin RECORD_LAYOUT Lookup2D_X_FLOAT64_IEEE AXIS_PTS_X 1 FLOAT64_IEEE INDEX_INCR DIRECT /end RECORD_LAYOUT
/begin CHARACTERISTIC gcp_M1External_TopGear315KW_arPeakSpeed "特百佳315KW电机，峰值外特性的转矩" CURVE 0xfd167c /* @ECU_Address@gcp_M1External_TopGear315KW_arPeakSpeed@ */ Lookup1D_FLOAT32_IEEE 0 SC_KZQ_EV2274A_4_1_CM_single_rpm -3.4E+38 3.4E+38
 /begin AXIS_DESCR COM_AXIS NO_INPUT_QUANTITY SC_KZQ_EV2274A_4_1_CM_single_N_m 10 -3.4E+38 3.4E+38 AXIS_PTS_REF gcp_M1External_TopGear315KW_arPeakTroque /end AXIS_DESCR
/end CHARACTERISTIC
/begin CHARACTERISTIC gcp_M1Eff_TopGear315KW_aarEff "效率，为数据，m(转矩)*n（转速）的矩阵" MAP 0xfd11ec /* @ECU_Address@gcp_M1Eff_TopGear315KW_aarEff@ */ Lookup2D_FLOAT32_IEEE 0 SC_KZQ_EV2274A_4_1_CM_single____ -3.4E+38 3.4E+38
 /begin AXIS_DESCR COM_AXIS NO_INPUT_QUANTITY SC_KZQ_EV2274A_4_1_CM_single_rpm 10 -3.4E+38 3.4E+38 AXIS_PTS_REF gcp_M1Eff_TopGear315KW_arSpeed /end AXIS_DESCR
 /begin AXIS_DESCR COM_AXIS NO_INPUT_QUANTITY SC_KZQ_EV2274A_4_1_CM_single_N_m 20 -3.4E+38 3.4E+38 AXIS_PTS_REF gcp_M1Eff_TopGear315KW_arTorque /end AXIS_DESCR
/end CHARACTERISTIC
/begin CHARACTERISTIC core_gp_xSwapBytes "" VALUE 0xfd0014 /* @ECU_Address@core_gp_xSwapBytes@ */ Scalar_BOOLEAN 0 SC_KZQ_EV2274A_4_1_CM_boolean 0 1 /end CHARACTERISTIC
/begin CHARACTERISTIC core_gcp_u8CanSDOCmd_ErrReply "0x80" VALUE 0xfd0009 /* @ECU_Address@core_gcp_u8CanSDOCmd_ErrReply@ */ Scalar_UBYTE 0 SC_KZQ_EV2274A_4_1_CM_uint8 0 255 /end CHARACTERISTIC
/begin CHARACTERISTIC core_gcp_u8CanSDOCmd_ErrReply_MainIndexMismatch "0x02" VALUE 0xfd000a /* @ECU_Address@core_gcp_u8CanSDOCmd_ErrReply_MainIndexMismatch@ */ Scalar_UBYTE 0 SC_KZQ_EV2274A_4_1_CM_uint8 0 255 /end CHARACTERISTIC
/begin CHARACTERISTIC core_gcp_u8CanSDOCmd_ErrReply_SubIndexMismatch "0x03" VALUE 0xfd000b /* @ECU_Address@core_gcp_u8CanSDOCmd_ErrReply_SubIndexMismatch@ */ Scalar_UBYTE 0 SC_KZQ_EV2274A_4_1_CM_uint8 0 255 /end CHARACTERISTIC
/begin CHARACTERISTIC core_gcp_u8CanSDOCmd_ErrReply_WrongCommand "0x01" VALUE 0xfd000c /* @ECU_Address@core_gcp_u8CanSDOCmd_ErrReply_WrongCommand@ */ Scalar_UBYTE 0 SC_KZQ_EV2274A_4_1_CM_uint8 0 255 /end CHARACTERISTIC
/begin CHARACTERISTIC core_gcp_u8CanSDOCmd_QuickWrite "0x20" VALUE 0xfd000d /* @ECU_Address@core_gcp_u8CanSDOCmd_QuickWrite@ */ Scalar_UBYTE 0 SC_KZQ_EV2274A_4_1_CM_uint8 0 255 /end CHARACTERISTIC
/begin CHARACTERISTIC core_gcp_u8CanSDOCmd_Write "0x23" VALUE 0xfd000e /* @ECU_Address@core_gcp_u8CanSDOCmd_Write@ */ Scalar_UBYTE 0 SC_KZQ_EV2274A_4_1_CM_uint8 0 255 /end CHARACTERISTIC
/begin AXIS_PTS gcp_M1External_TopGear315KW_arPeakTroque "特百佳315KW电机，峰值外特性的转矩" 0xfd16a4 /* @ECU_Address@gcp_M1External_TopGear315KW_arPeakTroque@ */ NO_INPUT_QUANTITY Lookup1D_X_FLOAT32_IEEE 0 SC_KZQ_EV2274A_4_1_CM_single_N_m 10 -3.4E+38 3.4E+38 /end AXIS_PTS
/begin AXIS_PTS gcp_M1Eff_TopGear315KW_arTorque "转矩，N.m，为Y轴，即行变量，m行，breakpoints 1" 0xfd1534 /* @ECU_Address@gcp_M1Eff_TopGear315KW_arTorque@ */ NO_INPUT_QUANTITY Lookup2D_X_FLOAT32_IEEE 0 SC_KZQ_EV2274A_4_1_CM_single_N_m 20 -3.4E+38 3.4E+38 /end AXIS_PTS
/begin AXIS_PTS gcp_M1Eff_TopGear315KW_arSpeed "转速，rpm，为X轴，即列变量，n列，breakpoints 2" 0xfd150c /* @ECU_Address@gcp_M1Eff_TopGear315KW_arSpeed@ */ NO_INPUT_QUANTITY Lookup2D_X_FLOAT32_IEEE 0 SC_KZQ_EV2274A_4_1_CM_single_rpm 10 -3.4E+38 3.4E+38 /end AXIS_PTS
/begin COMPU_METHOD SC_KZQ_EV2274A_4_1_CM_single_rpm "Q = V" RAT_FUNC "%8.6" "rpm" COEFFS 0 1 0 0 0 1 /end COMPU_METHOD
/begin COMPU_METHOD SC_KZQ_EV2274A_4_1_CM_single_N_m "Q = V" RAT_FUNC "%8.6" "N.m" COEFFS 0 1 0 0 0 1 /end COMPU_METHOD
/begin COMPU_METHOD SC_KZQ_EV2274A_4_1_CM_single____ "Q = V" RAT_FUNC "%8.6" "无单位" COEFFS 0 1 0 0 0 1 /end COMPU_METHOD
/begin COMPU_METHOD SC_KZQ_EV2274A_4_1_CM_boolean "Q = V" RAT_FUNC "%1.0" "" COEFFS 0 1 0 0 0 1 /end COMPU_METHOD
/begin COMPU_METHOD SC_KZQ_EV2274A_4_1_CM_uint8 "Q = V" RAT_FUNC "%3.0" "" COEFFS 0 1 0 0 0 1 /end COMPU_METHOD
/begin GROUP S8_Retain_Variables "SC_KZQ_EV2274A_4_1/Simulation Binding/Retain Variables" /begin SUB_GROUP S5186_Triggered_Retain_Store /end SUB_GROUP /end GROUP
/begin GROUP S63_Model_XJ1100_0101 "SC_KZQ_EV2274A_4_1/Main/ XJ Model Link /Model XJ1100_0101" /begin SUB_GROUP S76_Model_RetainInit_Subsystem /end SUB_GROUP /end GROUP
/begin GROUP S63_Model_XJ1350_0101 "SC_KZQ_EV2274A_4_1/Main/ XJ Model Link /Model XJ1350_0101" /begin SUB_GROUP S77_Model_RetainInit_Subsystem /end SUB_GROUP /end GROUP
/begin GROUP S63_Model_XJ1600_0101 "SC_KZQ_EV2274A_4_1/Main/ XJ Model Link /Model XJ1600_0101" /begin SUB_GROUP S78_Model_RetainInit_Subsystem /end SUB_GROUP /end GROUP
/begin GROUP S63_Model_XJ900_0101 "SC_KZQ_EV2274A_4_1/Main/ XJ Model Link /Model XJ900_0101" /begin SUB_GROUP S79_Model_RetainInit_Subsystem /end SUB_GROUP /end GROUP
/begin GROUP S63_Model_XJ900_0201 "SC_KZQ_EV2274A_4_1/Main/ XJ Model Link /Model XJ900_0201" /begin SUB_GROUP S80_Model_RetainInit_Subsystem /end SUB_GROUP /end GROUP
/begin GROUP S63_Model_XJ900_0301 "SC_KZQ_EV2274A_4_1/Main/ XJ Model Link /Model XJ900_0301" /begin SUB_GROUP S81_Model_RetainInit_Subsystem /end SUB_GROUP /end GROUP
/begin GROUP S66_SDO__0x7C "SC_KZQ_EV2274A_4_1/Main/CAN SDO/SDO  0x7C"
 /begin SUB_GROUP S1042_Case_0x6440h_25664_ S1042_Case_0x6443h S1042_Case_0x6445h S1042_Case_0x6447h S1042_Case_0x6508h S1042_Case_0x6510h S1042_SDO_Error_Reply /end SUB_GROUP
/end GROUP
/begin GROUP S67_value_To_uint8_4_1 "SC_KZQ_EV2274A_4_1/Main/CAN Status/value_To_uint8[4]1" /begin REF_CHARACTERISTIC core_gp_xSwapBytes /end REF_CHARACTERISTIC /end GROUP
/begin GROUP S67_value_To_uint8_4_2 "SC_KZQ_EV2274A_4_1/Main/CAN Status/value_To_uint8[4]2" /begin REF_CHARACTERISTIC core_gp_xSwapBytes /end REF_CHARACTERISTIC /end GROUP
/begin GROUP S68_fbM1Contol "SC_KZQ_EV2274A_4_1/Main/Control Layer/fbM1Contol"
 /begin REF_CHARACTERISTIC gcp_M1Eff_TopGear315KW_aarEff gcp_M1External_TopGear315KW_arPeakSpeed /end REF_CHARACTERISTIC
/end GROUP
/begin GROUP S70_SDO__0x7B "SC_KZQ_EV2274A_4_1/Main/GPS /SDO  0x7B" /begin SUB_GROUP S4875_Case_0x6520h_25888_ S4875_SDO_Error_Reply /end SUB_GROUP /end GROUP
/begin GROUP S70_value_To_uint8_4_ "SC_KZQ_EV2274A_4_1/Main/GPS /value_To_uint8[4]" /begin REF_CHARACTERISTIC core_gp_xSwapBytes /end REF_CHARACTERISTIC /end GROUP
/begin GROUP S70_value_To_uint8_4_1 "SC_KZQ_EV2274A_4_1/Main/GPS /value_To_uint8[4]1" /begin REF_CHARACTERISTIC core_gp_xSwapBytes /end REF_CHARACTERISTIC /end GROUP
/begin GROUP S70_value_To_uint8_4_2 "SC_KZQ_EV2274A_4_1/Main/GPS /value_To_uint8[4]2" /begin REF_CHARACTERISTIC core_gp_xSwapBytes /end REF_CHARACTERISTIC /end GROUP
/begin GROUP S70_value_To_uint8_4_3 "SC_KZQ_EV2274A_4_1/Main/GPS /value_To_uint8[4]3" /begin REF_CHARACTERISTIC core_gp_xSwapBytes /end REF_CHARACTERISTIC /end GROUP
/begin GROUP S70_value_To_uint8_4_4 "SC_KZQ_EV2274A_4_1/Main/GPS /value_To_uint8[4]4" /begin REF_CHARACTERISTIC core_gp_xSwapBytes /end REF_CHARACTERISTIC /end GROUP
/begin GROUP S70_value_To_uint8_4_5 "SC_KZQ_EV2274A_4_1/Main/GPS /value_To_uint8[4]5" /begin REF_CHARACTERISTIC core_gp_xSwapBytes /end REF_CHARACTERISTIC /end GROUP
/begin GROUP S1042_Case_0x6440h_25664_ "SC_KZQ_EV2274A_4_1/Main/CAN SDO/SDO  0x7C/Case 0x6440h(25664)"
 /begin SUB_GROUP S1050_SDO_Error_Reply S1050__Case_0x6440_001 S1050__Case_0x6440_002 S1050__Case_0x6440_003 S1050__Case_0x6440_004 S1050__Case_0x6440_005 S1050__Case_0x6440_006 S1050__Case_0x6440_007 S1050__Case_0x6440_008 S1050__Case_0x6440_009 S1050__Case_0x6440_010 S1050__Case_0x6440_011 S1050__Case_0x6440_012 S1050__Case_0x6440_013 S1050__Case_0x6440_014 S1050__Case_0x6440_015 S1050__Case_0x6440_016 /end SUB_GROUP
/end GROUP
/begin GROUP S1042_Case_0x6443h "SC_KZQ_EV2274A_4_1/Main/CAN SDO/SDO  0x7C/Case 0x6443h"
 /begin SUB_GROUP S1051_SDO_Error_Reply S1051__Case_0x6443_001 S1051__Case_0x6443_002 S1051__Case_0x6443_003 S1051__Case_0x6443_004 S1051__Case_0x6443_005 S1051__Case_0x6443_006 S1051__Case_0x6443_007 S1051__Case_0x6443_008 S1051__Case_0x6443_009 S1051__Case_0x6443_010 S1051__Case_0x6443_011 S1051__Case_0x6443_012 S1051__Case_0x6443_013 S1051__Case_0x6443_014 S1051__Case_0x6443_015 S1051__Case_0x6443_016 S1051__Case_0x6443_017 S1051__Case_0x6443_018 S1051__Case_0x6443_019 S1051__Case_0x6443_020 S1051__Case_0x6443_021 S1051__Case_0x6443_022 S1051__Case_0x6443_023 S1051__Case_0x6443_024 S1051__Case_0x6443_025 S1051__Case_0x6443_026 S1051__Case_0x6443_027 S1051__Case_0x6443_028 S1051__Case_0x6443_029 S1051__Case_0x6443_030 S1051__Case_0x6443_031 S1051__Case_0x6443_032 /end SUB_GROUP
/end GROUP
/begin GROUP S1042_Case_0x6445h "SC_KZQ_EV2274A_4_1/Main/CAN SDO/SDO  0x7C/Case 0x6445h"
 /begin SUB_GROUP S1052_SDO_Error_Reply S1052__Case_0x6445_001 S1052__Case_0x6445_002 S1052__Case_0x6445_003 S1052__Case_0x6445_004 S1052__Case_0x6445_030 S1052__Case_0x6445_040 S1052__Case_0x6445_041 S1052__Case_0x6445_042 S1052__Case_0x6445_043 S1052__Case_0x6445_044 S1052__Case_0x6445_045 S1052__Case_0x6445_046 S1052__Case_0x6445_060 S1052__Case_0x6445_061 S1052__Case_0x6445_062 S1052__Case_0x6445_080 S1052__Case_0x6445_081 S1052__Case_0x6445_090 S1052__Case_0x6445_091 S1052__Case_0x6445_092 S1052__Case_0x6445_093 S1052__Case_0x6445_180 /end SUB_GROUP
/end GROUP
/begin GROUP S1042_Case_0x6447h "SC_KZQ_EV2274A_4_1/Main/CAN SDO/SDO  0x7C/Case 0x6447h"
 /begin SUB_GROUP S1053_SDO_Error_Reply S1053__Case_0x6447_001 S1053__Case_0x6447_002 S1053__Case_0x6447_003 S1053__Case_0x6447_004 S1053__Case_0x6447_005 S1053__Case_0x6447_006 S1053__Case_0x6447_031 S1053__Case_0x6447_034 S1053__Case_0x6447_061 S1053__Case_0x6447_064 S1053__Case_0x6447_067 S1053__Case_0x6447_070 S1053__Case_0x6447_073 S1053__Case_0x6447_076 S1053__Case_0x6447_097 S1053__Case_0x6447_100 S1053__Case_0x6447_103 S1053__Case_0x6447_106 S1053__Case_0x6447_151 S1053__Case_0x6447_154 S1053__Case_0x6447_37 S1053__Case_0x6447_38 /end SUB_GROUP
/end GROUP
/begin GROUP S1042_Case_0x6508h "SC_KZQ_EV2274A_4_1/Main/CAN SDO/SDO  0x7C/Case 0x6508h"
 /begin SUB_GROUP S1054_SDO_Error_Reply S1054__Case_0x6508_001 S1054__Case_0x6508_010 S1054__Case_0x6508_020 /end SUB_GROUP
/end GROUP
/begin GROUP S1042_Case_0x6510h "SC_KZQ_EV2274A_4_1/Main/CAN SDO/SDO  0x7C/Case 0x6510h"
 /begin SUB_GROUP S1055_SDO_Error_Reply S1055__Case_0x6510_001 S1055__Case_0x6510_002 /end SUB_GROUP
/end GROUP
/begin GROUP S1042_SDO_Error_Reply "SC_KZQ_EV2274A_4_1/Main/CAN SDO/SDO  0x7C/SDO Error Reply"
 /begin REF_CHARACTERISTIC core_gcp_u8CanSDOCmd_ErrReply core_gcp_u8CanSDOCmd_ErrReply_MainIndexMismatch core_gcp_u8CanSDOCmd_ErrReply_SubIndexMismatch core_gcp_u8CanSDOCmd_ErrReply_WrongCommand /end REF_CHARACTERISTIC
/end GROUP
/begin GROUP S4875_Case_0x6520h_25888_ "SC_KZQ_EV2274A_4_1/Main/GPS /SDO  0x7B/Case 0x6520h(25888)"
 /begin SUB_GROUP S4892_SDO_Error_Reply S4892__Case_0x6520_001 S4892__Case_0x6520_002 S4892__Case_0x6520_003 S4892__Case_0x6520_004 S4892__Case_0x6520_005 S4892__Case_0x6520_010 S4892__Case_0x6520_011 /end SUB_GROUP
/end GROUP
/begin GROUP S4875_SDO_Error_Reply "SC_KZQ_EV2274A_4_1/Main/GPS /SDO  0x7B/SDO Error Reply"
 /begin REF_CHARACTERISTIC core_gcp_u8CanSDOCmd_ErrReply core_gcp_u8CanSDOCmd_ErrReply_MainIndexMismatch core_gcp_u8CanSDOCmd_ErrReply_SubIndexMismatch core_gcp_u8CanSDOCmd_ErrReply_WrongCommand /end REF_CHARACTERISTIC
/end GROUP
/begin GROUP S1050__Case_0x6440_001 "SC_KZQ_EV2274A_4_1/Main/CAN SDO/SDO  0x7C/Case 0x6440h(25664)/ Case 0x6440-001" /begin SUB_GROUP S1058_SDO_Reply /end SUB_GROUP /end GROUP
/begin GROUP S1050__Case_0x6440_002 "SC_KZQ_EV2274A_4_1/Main/CAN SDO/SDO  0x7C/Case 0x6440h(25664)/ Case 0x6440-002" /begin SUB_GROUP S1059_SDO_Reply /end SUB_GROUP /end GROUP
/begin GROUP S1050__Case_0x6440_003 "SC_KZQ_EV2274A_4_1/Main/CAN SDO/SDO  0x7C/Case 0x6440h(25664)/ Case 0x6440-003" /begin SUB_GROUP S1060_SDO_Reply /end SUB_GROUP /end GROUP
/begin GROUP S1050__Case_0x6440_004 "SC_KZQ_EV2274A_4_1/Main/CAN SDO/SDO  0x7C/Case 0x6440h(25664)/ Case 0x6440-004" /begin SUB_GROUP S1061_SDO_Reply /end SUB_GROUP /end GROUP
/begin GROUP S1050__Case_0x6440_005 "SC_KZQ_EV2274A_4_1/Main/CAN SDO/SDO  0x7C/Case 0x6440h(25664)/ Case 0x6440-005" /begin SUB_GROUP S1062_SDO_Reply /end SUB_GROUP /end GROUP
/begin GROUP S1050__Case_0x6440_006 "SC_KZQ_EV2274A_4_1/Main/CAN SDO/SDO  0x7C/Case 0x6440h(25664)/ Case 0x6440-006" /begin SUB_GROUP S1063_SDO_Reply /end SUB_GROUP /end GROUP
/begin GROUP S1050__Case_0x6440_007 "SC_KZQ_EV2274A_4_1/Main/CAN SDO/SDO  0x7C/Case 0x6440h(25664)/ Case 0x6440-007" /begin SUB_GROUP S1064_SDO_Reply /end SUB_GROUP /end GROUP
/begin GROUP S1050__Case_0x6440_008 "SC_KZQ_EV2274A_4_1/Main/CAN SDO/SDO  0x7C/Case 0x6440h(25664)/ Case 0x6440-008" /begin SUB_GROUP S1065_SDO_Reply /end SUB_GROUP /end GROUP
/begin GROUP S1050__Case_0x6440_009 "SC_KZQ_EV2274A_4_1/Main/CAN SDO/SDO  0x7C/Case 0x6440h(25664)/ Case 0x6440-009" /begin SUB_GROUP S1066_SDO_Reply /end SUB_GROUP /end GROUP
/begin GROUP S1050__Case_0x6440_010 "SC_KZQ_EV2274A_4_1/Main/CAN SDO/SDO  0x7C/Case 0x6440h(25664)/ Case 0x6440-010" /begin SUB_GROUP S1067_SDO_Reply /end SUB_GROUP /end GROUP
/begin GROUP S1050__Case_0x6440_011 "SC_KZQ_EV2274A_4_1/Main/CAN SDO/SDO  0x7C/Case 0x6440h(25664)/ Case 0x6440-011" /begin SUB_GROUP S1068_SDO_Reply /end SUB_GROUP /end GROUP
/begin GROUP S1050__Case_0x6440_012 "SC_KZQ_EV2274A_4_1/Main/CAN SDO/SDO  0x7C/Case 0x6440h(25664)/ Case 0x6440-012" /begin SUB_GROUP S1069_SDO_Reply /end SUB_GROUP /end GROUP
/begin GROUP S1050__Case_0x6440_013 "SC_KZQ_EV2274A_4_1/Main/CAN SDO/SDO  0x7C/Case 0x6440h(25664)/ Case 0x6440-013" /begin SUB_GROUP S1070_SDO_Reply /end SUB_GROUP /end GROUP
/begin GROUP S1050__Case_0x6440_014 "SC_KZQ_EV2274A_4_1/Main/CAN SDO/SDO  0x7C/Case 0x6440h(25664)/ Case 0x6440-014" /begin SUB_GROUP S1071_SDO_Reply /end SUB_GROUP /end GROUP
/begin GROUP S1050__Case_0x6440_015 "SC_KZQ_EV2274A_4_1/Main/CAN SDO/SDO  0x7C/Case 0x6440h(25664)/ Case 0x6440-015" /begin SUB_GROUP S1072_SDO_Reply /end SUB_GROUP /end GROUP
/begin GROUP S1050__Case_0x6440_016 "SC_KZQ_EV2274A_4_1/Main/CAN SDO/SDO  0x7C/Case 0x6440h(25664)/ Case 0x6440-016" /begin SUB_GROUP S1073_SDO_Reply /end SUB_GROUP /end GROUP
/begin GROUP S1050_SDO_Error_Reply "SC_KZQ_EV2274A_4_1/Main/CAN SDO/SDO  0x7C/Case 0x6440h(25664)/SDO Error Reply"
 /begin REF_CHARACTERISTIC core_gcp_u8CanSDOCmd_ErrReply core_gcp_u8CanSDOCmd_ErrReply_MainIndexMismatch core_gcp_u8CanSDOCmd_ErrReply_SubIndexMismatch core_gcp_u8CanSDOCmd_ErrReply_WrongCommand /end REF_CHARACTERISTIC
/end GROUP
/begin GROUP S1051__Case_0x6443_001 "SC_KZQ_EV2274A_4_1/Main/CAN SDO/SDO  0x7C/Case 0x6443h/ Case 0x6443-001" /begin SUB_GROUP S1656_SDO_Reply /end SUB_GROUP /end GROUP
/begin GROUP S1051__Case_0x6443_002 "SC_KZQ_EV2274A_4_1/Main/CAN SDO/SDO  0x7C/Case 0x6443h/ Case 0x6443-002" /begin SUB_GROUP S1657_SDO_Reply /end SUB_GROUP /end GROUP
/begin GROUP S1051__Case_0x6443_003 "SC_KZQ_EV2274A_4_1/Main/CAN SDO/SDO  0x7C/Case 0x6443h/ Case 0x6443-003" /begin SUB_GROUP S1658_SDO_Reply /end SUB_GROUP /end GROUP
/begin GROUP S1051__Case_0x6443_004 "SC_KZQ_EV2274A_4_1/Main/CAN SDO/SDO  0x7C/Case 0x6443h/ Case 0x6443-004" /begin SUB_GROUP S1659_SDO_Reply /end SUB_GROUP /end GROUP
/begin GROUP S1051__Case_0x6443_005 "SC_KZQ_EV2274A_4_1/Main/CAN SDO/SDO  0x7C/Case 0x6443h/ Case 0x6443-005" /begin SUB_GROUP S1660_SDO_Reply /end SUB_GROUP /end GROUP
/begin GROUP S1051__Case_0x6443_006 "SC_KZQ_EV2274A_4_1/Main/CAN SDO/SDO  0x7C/Case 0x6443h/ Case 0x6443-006" /begin SUB_GROUP S1661_SDO_Reply /end SUB_GROUP /end GROUP
/begin GROUP S1051__Case_0x6443_007 "SC_KZQ_EV2274A_4_1/Main/CAN SDO/SDO  0x7C/Case 0x6443h/ Case 0x6443-007" /begin SUB_GROUP S1662_SDO_Reply /end SUB_GROUP /end GROUP
/begin GROUP S1051__Case_0x6443_008 "SC_KZQ_EV2274A_4_1/Main/CAN SDO/SDO  0x7C/Case 0x6443h/ Case 0x6443-008" /begin SUB_GROUP S1663_SDO_Reply /end SUB_GROUP /end GROUP
/begin GROUP S1051__Case_0x6443_009 "SC_KZQ_EV2274A_4_1/Main/CAN SDO/SDO  0x7C/Case 0x6443h/ Case 0x6443-009" /begin SUB_GROUP S1664_SDO_Reply /end SUB_GROUP /end GROUP
/begin GROUP S1051__Case_0x6443_010 "SC_KZQ_EV2274A_4_1/Main/CAN SDO/SDO  0x7C/Case 0x6443h/ Case 0x6443-010" /begin SUB_GROUP S1665_SDO_Reply /end SUB_GROUP /end GROUP
/begin GROUP S1051__Case_0x6443_011 "SC_KZQ_EV2274A_4_1/Main/CAN SDO/SDO  0x7C/Case 0x6443h/ Case 0x6443-011" /begin SUB_GROUP S1666_SDO_Reply /end SUB_GROUP /end GROUP
/begin GROUP S1051__Case_0x6443_012 "SC_KZQ_EV2274A_4_1/Main/CAN SDO/SDO  0x7C/Case 0x6443h/ Case 0x6443-012" /begin SUB_GROUP S1667_SDO_Reply /end SUB_GROUP /end GROUP
/begin GROUP S1051__Case_0x6443_013 "SC_KZQ_EV2274A_4_1/Main/CAN SDO/SDO  0x7C/Case 0x6443h/ Case 0x6443-013" /begin SUB_GROUP S1668_SDO_Reply /end SUB_GROUP /end GROUP
/begin GROUP S1051__Case_0x6443_014 "SC_KZQ_EV2274A_4_1/Main/CAN SDO/SDO  0x7C/Case 0x6443h/ Case 0x6443-014" /begin SUB_GROUP S1669_SDO_Reply /end SUB_GROUP /end GROUP
/begin GROUP S1051__Case_0x6443_015 "SC_KZQ_EV2274A_4_1/Main/CAN SDO/SDO  0x7C/Case 0x6443h/ Case 0x6443-015" /begin SUB_GROUP S1670_SDO_Reply /end SUB_GROUP /end GROUP
/begin GROUP S1051__Case_0x6443_016 "SC_KZQ_EV2274A_4_1/Main/CAN SDO/SDO  0x7C/Case 0x6443h/ Case 0x6443-016" /begin SUB_GROUP S1671_SDO_Reply /end SUB_GROUP /end GROUP
/begin GROUP S1051__Case_0x6443_017 "SC_KZQ_EV2274A_4_1/Main/CAN SDO/SDO  0x7C/Case 0x6443h/ Case 0x6443-017" /begin SUB_GROUP S1672_SDO_Reply /end SUB_GROUP /end GROUP
/begin GROUP S1051__Case_0x6443_018 "SC_KZQ_EV2274A_4_1/Main/CAN SDO/SDO  0x7C/Case 0x6443h/ Case 0x6443-018" /begin SUB_GROUP S1673_SDO_Reply /end SUB_GROUP /end GROUP
/begin GROUP S1051__Case_0x6443_019 "SC_KZQ_EV2274A_4_1/Main/CAN SDO/SDO  0x7C/Case 0x6443h/ Case 0x6443-019" /begin SUB_GROUP S1674_SDO_Reply /end SUB_GROUP /end GROUP
/begin GROUP S1051__Case_0x6443_020 "SC_KZQ_EV2274A_4_1/Main/CAN SDO/SDO  0x7C/Case 0x6443h/ Case 0x6443-020" /begin SUB_GROUP S1675_SDO_Reply /end SUB_GROUP /end GROUP
/begin GROUP S1051__Case_0x6443_021 "SC_KZQ_EV2274A_4_1/Main/CAN SDO/SDO  0x7C/Case 0x6443h/ Case 0x6443-021" /begin SUB_GROUP S1676_SDO_Reply /end SUB_GROUP /end GROUP
/begin GROUP S1051__Case_0x6443_022 "SC_KZQ_EV2274A_4_1/Main/CAN SDO/SDO  0x7C/Case 0x6443h/ Case 0x6443-022" /begin SUB_GROUP S1677_SDO_Reply /end SUB_GROUP /end GROUP
/begin GROUP S1051__Case_0x6443_023 "SC_KZQ_EV2274A_4_1/Main/CAN SDO/SDO  0x7C/Case 0x6443h/ Case 0x6443-023" /begin SUB_GROUP S1678_SDO_Reply /end SUB_GROUP /end GROUP
/begin GROUP S1051__Case_0x6443_024 "SC_KZQ_EV2274A_4_1/Main/CAN SDO/SDO  0x7C/Case 0x6443h/ Case 0x6443-024" /begin SUB_GROUP S1679_SDO_Reply /end SUB_GROUP /end GROUP
/begin GROUP S1051__Case_0x6443_025 "SC_KZQ_EV2274A_4_1/Main/CAN SDO/SDO  0x7C/Case 0x6443h/ Case 0x6443-025" /begin SUB_GROUP S1680_SDO_Reply /end SUB_GROUP /end GROUP
/begin GROUP S1051__Case_0x6443_026 "SC_KZQ_EV2274A_4_1/Main/CAN SDO/SDO  0x7C/Case 0x6443h/ Case 0x6443-026" /begin SUB_GROUP S1681_SDO_Reply /end SUB_GROUP /end GROUP
/begin GROUP S1051__Case_0x6443_027 "SC_KZQ_EV2274A_4_1/Main/CAN SDO/SDO  0x7C/Case 0x6443h/ Case 0x6443-027" /begin SUB_GROUP S1682_SDO_Reply /end SUB_GROUP /end GROUP
/begin GROUP S1051__Case_0x6443_028 "SC_KZQ_EV2274A_4_1/Main/CAN SDO/SDO  0x7C/Case 0x6443h/ Case 0x6443-028" /begin SUB_GROUP S1683_SDO_Reply /end SUB_GROUP /end GROUP
/begin GROUP S1051__Case_0x6443_029 "SC_KZQ_EV2274A_4_1/Main/CAN SDO/SDO  0x7C/Case 0x6443h/ Case 0x6443-029" /begin SUB_GROUP S1684_SDO_Reply /end SUB_GROUP /end GROUP
/begin GROUP S1051__Case_0x6443_030 "SC_KZQ_EV2274A_4_1/Main/CAN SDO/SDO  0x7C/Case 0x6443h/ Case 0x6443-030" /begin SUB_GROUP S1685_SDO_Reply /end SUB_GROUP /end GROUP
/begin GROUP S1051__Case_0x6443_031 "SC_KZQ_EV2274A_4_1/Main/CAN SDO/SDO  0x7C/Case 0x6443h/ Case 0x6443-031" /begin SUB_GROUP S1686_SDO_Reply /end SUB_GROUP /end GROUP
/begin GROUP S1051__Case_0x6443_032 "SC_KZQ_EV2274A_4_1/Main/CAN SDO/SDO  0x7C/Case 0x6443h/ Case 0x6443-032" /begin SUB_GROUP S1687_SDO_Reply /end SUB_GROUP /end GROUP
/begin GROUP S1051_SDO_Error_Reply "SC_KZQ_EV2274A_4_1/Main/CAN SDO/SDO  0x7C/Case 0x6443h/SDO Error Reply"
 /begin REF_CHARACTERISTIC core_gcp_u8CanSDOCmd_ErrReply core_gcp_u8CanSDOCmd_ErrReply_MainIndexMismatch core_gcp_u8CanSDOCmd_ErrReply_SubIndexMismatch core_gcp_u8CanSDOCmd_ErrReply_WrongCommand /end REF_CHARACTERISTIC
/end GROUP
/begin GROUP S1052__Case_0x6445_001 "SC_KZQ_EV2274A_4_1/Main/CAN SDO/SDO  0x7C/Case 0x6445h/ Case 0x6445-001" /begin SUB_GROUP S2846_SDO_Reply /end SUB_GROUP /end GROUP
/begin GROUP S1052__Case_0x6445_002 "SC_KZQ_EV2274A_4_1/Main/CAN SDO/SDO  0x7C/Case 0x6445h/ Case 0x6445-002" /begin SUB_GROUP S2847_SDO_Reply /end SUB_GROUP /end GROUP
/begin GROUP S1052__Case_0x6445_003 "SC_KZQ_EV2274A_4_1/Main/CAN SDO/SDO  0x7C/Case 0x6445h/ Case 0x6445-003" /begin SUB_GROUP S2848_SDO_Reply /end SUB_GROUP /end GROUP
/begin GROUP S1052__Case_0x6445_004 "SC_KZQ_EV2274A_4_1/Main/CAN SDO/SDO  0x7C/Case 0x6445h/ Case 0x6445-004" /begin SUB_GROUP S2849_SDO_Reply /end SUB_GROUP /end GROUP
/begin GROUP S1052__Case_0x6445_030 "SC_KZQ_EV2274A_4_1/Main/CAN SDO/SDO  0x7C/Case 0x6445h/ Case 0x6445-030" /begin SUB_GROUP S2850_SDO_Reply /end SUB_GROUP /end GROUP
/begin GROUP S1052__Case_0x6445_040 "SC_KZQ_EV2274A_4_1/Main/CAN SDO/SDO  0x7C/Case 0x6445h/ Case 0x6445-040" /begin SUB_GROUP S2851_SDO_Reply /end SUB_GROUP /end GROUP
/begin GROUP S1052__Case_0x6445_041 "SC_KZQ_EV2274A_4_1/Main/CAN SDO/SDO  0x7C/Case 0x6445h/ Case 0x6445-041" /begin SUB_GROUP S2852_SDO_Reply /end SUB_GROUP /end GROUP
/begin GROUP S1052__Case_0x6445_042 "SC_KZQ_EV2274A_4_1/Main/CAN SDO/SDO  0x7C/Case 0x6445h/ Case 0x6445-042" /begin SUB_GROUP S2853_SDO_Reply /end SUB_GROUP /end GROUP
/begin GROUP S1052__Case_0x6445_043 "SC_KZQ_EV2274A_4_1/Main/CAN SDO/SDO  0x7C/Case 0x6445h/ Case 0x6445-043" /begin SUB_GROUP S2854_SDO_Reply /end SUB_GROUP /end GROUP
/begin GROUP S1052__Case_0x6445_044 "SC_KZQ_EV2274A_4_1/Main/CAN SDO/SDO  0x7C/Case 0x6445h/ Case 0x6445-044" /begin SUB_GROUP S2855_SDO_Reply /end SUB_GROUP /end GROUP
/begin GROUP S1052__Case_0x6445_045 "SC_KZQ_EV2274A_4_1/Main/CAN SDO/SDO  0x7C/Case 0x6445h/ Case 0x6445-045" /begin SUB_GROUP S2856_SDO_Reply /end SUB_GROUP /end GROUP
/begin GROUP S1052__Case_0x6445_046 "SC_KZQ_EV2274A_4_1/Main/CAN SDO/SDO  0x7C/Case 0x6445h/ Case 0x6445-046" /begin SUB_GROUP S2857_SDO_Reply /end SUB_GROUP /end GROUP
/begin GROUP S1052__Case_0x6445_060 "SC_KZQ_EV2274A_4_1/Main/CAN SDO/SDO  0x7C/Case 0x6445h/ Case 0x6445-060" /begin SUB_GROUP S2858_SDO_Reply /end SUB_GROUP /end GROUP
/begin GROUP S1052__Case_0x6445_061 "SC_KZQ_EV2274A_4_1/Main/CAN SDO/SDO  0x7C/Case 0x6445h/ Case 0x6445-061" /begin SUB_GROUP S2859_SDO_Reply /end SUB_GROUP /end GROUP
/begin GROUP S1052__Case_0x6445_062 "SC_KZQ_EV2274A_4_1/Main/CAN SDO/SDO  0x7C/Case 0x6445h/ Case 0x6445-062" /begin SUB_GROUP S2860_SDO_Reply /end SUB_GROUP /end GROUP
/begin GROUP S1052__Case_0x6445_080 "SC_KZQ_EV2274A_4_1/Main/CAN SDO/SDO  0x7C/Case 0x6445h/ Case 0x6445-080" /begin SUB_GROUP S2861_SDO_Reply /end SUB_GROUP /end GROUP
/begin GROUP S1052__Case_0x6445_081 "SC_KZQ_EV2274A_4_1/Main/CAN SDO/SDO  0x7C/Case 0x6445h/ Case 0x6445-081" /begin SUB_GROUP S2862_SDO_Reply /end SUB_GROUP /end GROUP
/begin GROUP S1052__Case_0x6445_090 "SC_KZQ_EV2274A_4_1/Main/CAN SDO/SDO  0x7C/Case 0x6445h/ Case 0x6445-090" /begin SUB_GROUP S2863_SDO_Reply /end SUB_GROUP /end GROUP
/begin GROUP S1052__Case_0x6445_091 "SC_KZQ_EV2274A_4_1/Main/CAN SDO/SDO  0x7C/Case 0x6445h/ Case 0x6445-091" /begin SUB_GROUP S2864_SDO_Reply /end SUB_GROUP /end GROUP
/begin GROUP S1052__Case_0x6445_092 "SC_KZQ_EV2274A_4_1/Main/CAN SDO/SDO  0x7C/Case 0x6445h/ Case 0x6445-092" /begin SUB_GROUP S2865_SDO_Reply /end SUB_GROUP /end GROUP
/begin GROUP S1052__Case_0x6445_093 "SC_KZQ_EV2274A_4_1/Main/CAN SDO/SDO  0x7C/Case 0x6445h/ Case 0x6445-093" /begin SUB_GROUP S2866_SDO_Reply /end SUB_GROUP /end GROUP
/begin GROUP S1052__Case_0x6445_180 "SC_KZQ_EV2274A_4_1/Main/CAN SDO/SDO  0x7C/Case 0x6445h/ Case 0x6445-180" /begin SUB_GROUP S2867_SDO_Reply /end SUB_GROUP /end GROUP
/begin GROUP S1052_SDO_Error_Reply "SC_KZQ_EV2274A_4_1/Main/CAN SDO/SDO  0x7C/Case 0x6445h/SDO Error Reply"
 /begin REF_CHARACTERISTIC core_gcp_u8CanSDOCmd_ErrReply core_gcp_u8CanSDOCmd_ErrReply_MainIndexMismatch core_gcp_u8CanSDOCmd_ErrReply_SubIndexMismatch core_gcp_u8CanSDOCmd_ErrReply_WrongCommand /end REF_CHARACTERISTIC
/end GROUP
/begin GROUP S1053__Case_0x6447_001 "SC_KZQ_EV2274A_4_1/Main/CAN SDO/SDO  0x7C/Case 0x6447h/ Case 0x6447-001" /begin SUB_GROUP S3666_SDO_Reply /end SUB_GROUP /end GROUP
/begin GROUP S1053__Case_0x6447_002 "SC_KZQ_EV2274A_4_1/Main/CAN SDO/SDO  0x7C/Case 0x6447h/ Case 0x6447-002" /begin SUB_GROUP S3667_SDO_Reply /end SUB_GROUP /end GROUP
/begin GROUP S1053__Case_0x6447_003 "SC_KZQ_EV2274A_4_1/Main/CAN SDO/SDO  0x7C/Case 0x6447h/ Case 0x6447-003" /begin SUB_GROUP S3668_SDO_Reply /end SUB_GROUP /end GROUP
/begin GROUP S1053__Case_0x6447_004 "SC_KZQ_EV2274A_4_1/Main/CAN SDO/SDO  0x7C/Case 0x6447h/ Case 0x6447-004" /begin SUB_GROUP S3669_SDO_Reply /end SUB_GROUP /end GROUP
/begin GROUP S1053__Case_0x6447_005 "SC_KZQ_EV2274A_4_1/Main/CAN SDO/SDO  0x7C/Case 0x6447h/ Case 0x6447-005" /begin SUB_GROUP S3670_SDO_Reply /end SUB_GROUP /end GROUP
/begin GROUP S1053__Case_0x6447_006 "SC_KZQ_EV2274A_4_1/Main/CAN SDO/SDO  0x7C/Case 0x6447h/ Case 0x6447-006" /begin SUB_GROUP S3671_SDO_Reply /end SUB_GROUP /end GROUP
/begin GROUP S1053__Case_0x6447_031 "SC_KZQ_EV2274A_4_1/Main/CAN SDO/SDO  0x7C/Case 0x6447h/ Case 0x6447-031" /begin SUB_GROUP S3672_SDO_Reply /end SUB_GROUP /end GROUP
/begin GROUP S1053__Case_0x6447_034 "SC_KZQ_EV2274A_4_1/Main/CAN SDO/SDO  0x7C/Case 0x6447h/ Case 0x6447-034" /begin SUB_GROUP S3673_SDO_Reply /end SUB_GROUP /end GROUP
/begin GROUP S1053__Case_0x6447_061 "SC_KZQ_EV2274A_4_1/Main/CAN SDO/SDO  0x7C/Case 0x6447h/ Case 0x6447-061" /begin SUB_GROUP S3674_SDO_Reply /end SUB_GROUP /end GROUP
/begin GROUP S1053__Case_0x6447_064 "SC_KZQ_EV2274A_4_1/Main/CAN SDO/SDO  0x7C/Case 0x6447h/ Case 0x6447-064" /begin SUB_GROUP S3675_SDO_Reply /end SUB_GROUP /end GROUP
/begin GROUP S1053__Case_0x6447_067 "SC_KZQ_EV2274A_4_1/Main/CAN SDO/SDO  0x7C/Case 0x6447h/ Case 0x6447-067" /begin SUB_GROUP S3676_SDO_Reply /end SUB_GROUP /end GROUP
/begin GROUP S1053__Case_0x6447_070 "SC_KZQ_EV2274A_4_1/Main/CAN SDO/SDO  0x7C/Case 0x6447h/ Case 0x6447-070" /begin SUB_GROUP S3677_SDO_Reply /end SUB_GROUP /end GROUP
/begin GROUP S1053__Case_0x6447_073 "SC_KZQ_EV2274A_4_1/Main/CAN SDO/SDO  0x7C/Case 0x6447h/ Case 0x6447-073" /begin SUB_GROUP S3678_SDO_Reply /end SUB_GROUP /end GROUP
/begin GROUP S1053__Case_0x6447_076 "SC_KZQ_EV2274A_4_1/Main/CAN SDO/SDO  0x7C/Case 0x6447h/ Case 0x6447-076" /begin SUB_GROUP S3679_SDO_Reply /end SUB_GROUP /end GROUP
/begin GROUP S1053__Case_0x6447_097 "SC_KZQ_EV2274A_4_1/Main/CAN SDO/SDO  0x7C/Case 0x6447h/ Case 0x6447-097" /begin SUB_GROUP S3680_SDO_Reply /end SUB_GROUP /end GROUP
/begin GROUP S1053__Case_0x6447_100 "SC_KZQ_EV2274A_4_1/Main/CAN SDO/SDO  0x7C/Case 0x6447h/ Case 0x6447-100" /begin SUB_GROUP S3681_SDO_Reply /end SUB_GROUP /end GROUP
/begin GROUP S1053__Case_0x6447_103 "SC_KZQ_EV2274A_4_1/Main/CAN SDO/SDO  0x7C/Case 0x6447h/ Case 0x6447-103" /begin SUB_GROUP S3682_SDO_Reply /end SUB_GROUP /end GROUP
/begin GROUP S1053__Case_0x6447_106 "SC_KZQ_EV2274A_4_1/Main/CAN SDO/SDO  0x7C/Case 0x6447h/ Case 0x6447-106" /begin SUB_GROUP S3683_SDO_Reply /end SUB_GROUP /end GROUP
/begin GROUP S1053__Case_0x6447_151 "SC_KZQ_EV2274A_4_1/Main/CAN SDO/SDO  0x7C/Case 0x6447h/ Case 0x6447-151" /begin SUB_GROUP S3684_SDO_Reply /end SUB_GROUP /end GROUP
/begin GROUP S1053__Case_0x6447_154 "SC_KZQ_EV2274A_4_1/Main/CAN SDO/SDO  0x7C/Case 0x6447h/ Case 0x6447-154" /begin SUB_GROUP S3685_SDO_Reply /end SUB_GROUP /end GROUP
/begin GROUP S1053__Case_0x6447_37 "SC_KZQ_EV2274A_4_1/Main/CAN SDO/SDO  0x7C/Case 0x6447h/ Case 0x6447-37" /begin SUB_GROUP S3686_SDO_Reply /end SUB_GROUP /end GROUP
/begin GROUP S1053__Case_0x6447_38 "SC_KZQ_EV2274A_4_1/Main/CAN SDO/SDO  0x7C/Case 0x6447h/ Case 0x6447-38" /begin SUB_GROUP S3687_SDO_Reply /end SUB_GROUP /end GROUP
/begin GROUP S1053_SDO_Error_Reply "SC_KZQ_EV2274A_4_1/Main/CAN SDO/SDO  0x7C/Case 0x6447h/SDO Error Reply"
 /begin REF_CHARACTERISTIC core_gcp_u8CanSDOCmd_ErrReply core_gcp_u8CanSDOCmd_ErrReply_MainIndexMismatch core_gcp_u8CanSDOCmd_ErrReply_SubIndexMismatch core_gcp_u8CanSDOCmd_ErrReply_WrongCommand /end REF_CHARACTERISTIC
/end GROUP
/begin GROUP S1054__Case_0x6508_001 "SC_KZQ_EV2274A_4_1/Main/CAN SDO/SDO  0x7C/Case 0x6508h/ Case 0x6508-001" /begin SUB_GROUP S4486_SDO_Reply /end SUB_GROUP /end GROUP
/begin GROUP S1054__Case_0x6508_010 "SC_KZQ_EV2274A_4_1/Main/CAN SDO/SDO  0x7C/Case 0x6508h/ Case 0x6508-010" /begin SUB_GROUP S4487_SDO_Reply /end SUB_GROUP /end GROUP
/begin GROUP S1054__Case_0x6508_020 "SC_KZQ_EV2274A_4_1/Main/CAN SDO/SDO  0x7C/Case 0x6508h/ Case 0x6508-020" /begin SUB_GROUP S4488_SDO_Reply /end SUB_GROUP /end GROUP
/begin GROUP S1054_SDO_Error_Reply "SC_KZQ_EV2274A_4_1/Main/CAN SDO/SDO  0x7C/Case 0x6508h/SDO Error Reply"
 /begin REF_CHARACTERISTIC core_gcp_u8CanSDOCmd_ErrReply core_gcp_u8CanSDOCmd_ErrReply_MainIndexMismatch core_gcp_u8CanSDOCmd_ErrReply_SubIndexMismatch core_gcp_u8CanSDOCmd_ErrReply_WrongCommand /end REF_CHARACTERISTIC
/end GROUP
/begin GROUP S1055__Case_0x6510_001 "SC_KZQ_EV2274A_4_1/Main/CAN SDO/SDO  0x7C/Case 0x6510h/ Case 0x6510-001" /begin SUB_GROUP S4603_SDO_Reply /end SUB_GROUP /end GROUP
/begin GROUP S1055__Case_0x6510_002 "SC_KZQ_EV2274A_4_1/Main/CAN SDO/SDO  0x7C/Case 0x6510h/ Case 0x6510-002" /begin SUB_GROUP S4604_SDO_Reply /end SUB_GROUP /end GROUP
/begin GROUP S1055_SDO_Error_Reply "SC_KZQ_EV2274A_4_1/Main/CAN SDO/SDO  0x7C/Case 0x6510h/SDO Error Reply"
 /begin REF_CHARACTERISTIC core_gcp_u8CanSDOCmd_ErrReply core_gcp_u8CanSDOCmd_ErrReply_MainIndexMismatch core_gcp_u8CanSDOCmd_ErrReply_SubIndexMismatch core_gcp_u8CanSDOCmd_ErrReply_WrongCommand /end REF_CHARACTERISTIC
/end GROUP
/begin GROUP S4892__Case_0x6520_001 "SC_KZQ_EV2274A_4_1/Main/GPS /SDO  0x7B/Case 0x6520h(25888)/ Case 0x6520-001" /begin SUB_GROUP S4895_SDO_Reply /end SUB_GROUP /end GROUP
/begin GROUP S4892__Case_0x6520_002 "SC_KZQ_EV2274A_4_1/Main/GPS /SDO  0x7B/Case 0x6520h(25888)/ Case 0x6520-002" /begin SUB_GROUP S4896_SDO_Reply /end SUB_GROUP /end GROUP
/begin GROUP S4892__Case_0x6520_003 "SC_KZQ_EV2274A_4_1/Main/GPS /SDO  0x7B/Case 0x6520h(25888)/ Case 0x6520-003" /begin SUB_GROUP S4897_SDO_Reply /end SUB_GROUP /end GROUP
/begin GROUP S4892__Case_0x6520_004 "SC_KZQ_EV2274A_4_1/Main/GPS /SDO  0x7B/Case 0x6520h(25888)/ Case 0x6520-004" /begin SUB_GROUP S4898_SDO_Reply /end SUB_GROUP /end GROUP
/begin GROUP S4892__Case_0x6520_005 "SC_KZQ_EV2274A_4_1/Main/GPS /SDO  0x7B/Case 0x6520h(25888)/ Case 0x6520-005" /begin SUB_GROUP S4899_SDO_Reply /end SUB_GROUP /end GROUP
/begin GROUP S4892__Case_0x6520_010 "SC_KZQ_EV2274A_4_1/Main/GPS /SDO  0x7B/Case 0x6520h(25888)/ Case 0x6520-010" /begin SUB_GROUP S4900_SDO_Reply /end SUB_GROUP /begin REF_CHARACTERISTIC core_gcp_u8CanSDOCmd_QuickWrite /end REF_CHARACTERISTIC /end GROUP
/begin GROUP S4892__Case_0x6520_011 "SC_KZQ_EV2274A_4_1/Main/GPS /SDO  0x7B/Case 0x6520h(25888)/ Case 0x6520-011" /begin SUB_GROUP S4901_SDO_Reply /end SUB_GROUP /begin REF_CHARACTERISTIC core_gcp_u8CanSDOCmd_Write /end REF_CHARACTERISTIC /end GROUP
/begin GROUP S4892_SDO_Error_Reply "SC_KZQ_EV2274A_4_1/Main/GPS /SDO  0x7B/Case 0x6520h(25888)/SDO Error Reply"
 /begin REF_CHARACTERISTIC core_gcp_u8CanSDOCmd_ErrReply core_gcp_u8CanSDOCmd_ErrReply_MainIndexMismatch core_gcp_u8CanSDOCmd_ErrReply_SubIndexMismatch core_gcp_u8CanSDOCmd_ErrReply_WrongCommand /end REF_CHARACTERISTIC
/end GROUP
/begin GROUP S1058_SDO_Reply "SC_KZQ_EV2274A_4_1/Main/CAN SDO/SDO  0x7C/Case 0x6440h(25664)/ Case 0x6440-001/SDO Reply"
 /begin SUB_GROUP S1076_SDO_Error_Reply S1076_value_To_uint8_4_ S1076_value_To_uint8_4_1 /end SUB_GROUP
 /begin REF_CHARACTERISTIC core_gp_xSwapBytes /end REF_CHARACTERISTIC
/end GROUP
/begin GROUP S1059_SDO_Reply "SC_KZQ_EV2274A_4_1/Main/CAN SDO/SDO  0x7C/Case 0x6440h(25664)/ Case 0x6440-002/SDO Reply"
 /begin SUB_GROUP S1112_SDO_Error_Reply S1112_value_To_uint8_4_ S1112_value_To_uint8_4_1 /end SUB_GROUP
 /begin REF_CHARACTERISTIC core_gp_xSwapBytes /end REF_CHARACTERISTIC
/end GROUP
/begin GROUP S1060_SDO_Reply "SC_KZQ_EV2274A_4_1/Main/CAN SDO/SDO  0x7C/Case 0x6440h(25664)/ Case 0x6440-003/SDO Reply"
 /begin SUB_GROUP S1148_SDO_Error_Reply S1148_value_To_uint8_4_ S1148_value_To_uint8_4_1 /end SUB_GROUP
 /begin REF_CHARACTERISTIC core_gp_xSwapBytes /end REF_CHARACTERISTIC
/end GROUP
/begin GROUP S1061_SDO_Reply "SC_KZQ_EV2274A_4_1/Main/CAN SDO/SDO  0x7C/Case 0x6440h(25664)/ Case 0x6440-004/SDO Reply"
 /begin SUB_GROUP S1184_SDO_Error_Reply S1184_value_To_uint8_4_ S1184_value_To_uint8_4_1 /end SUB_GROUP
 /begin REF_CHARACTERISTIC core_gp_xSwapBytes /end REF_CHARACTERISTIC
/end GROUP
/begin GROUP S1062_SDO_Reply "SC_KZQ_EV2274A_4_1/Main/CAN SDO/SDO  0x7C/Case 0x6440h(25664)/ Case 0x6440-005/SDO Reply"
 /begin SUB_GROUP S1220_SDO_Error_Reply S1220_value_To_uint8_4_ S1220_value_To_uint8_4_1 /end SUB_GROUP
 /begin REF_CHARACTERISTIC core_gp_xSwapBytes /end REF_CHARACTERISTIC
/end GROUP
/begin GROUP S1063_SDO_Reply "SC_KZQ_EV2274A_4_1/Main/CAN SDO/SDO  0x7C/Case 0x6440h(25664)/ Case 0x6440-006/SDO Reply"
 /begin SUB_GROUP S1256_SDO_Error_Reply S1256_value_To_uint8_4_ S1256_value_To_uint8_4_1 /end SUB_GROUP
 /begin REF_CHARACTERISTIC core_gp_xSwapBytes /end REF_CHARACTERISTIC
/end GROUP
/begin GROUP S1064_SDO_Reply "SC_KZQ_EV2274A_4_1/Main/CAN SDO/SDO  0x7C/Case 0x6440h(25664)/ Case 0x6440-007/SDO Reply"
 /begin SUB_GROUP S1292_SDO_Error_Reply S1292_value_To_uint8_4_ S1292_value_To_uint8_4_1 /end SUB_GROUP
 /begin REF_CHARACTERISTIC core_gp_xSwapBytes /end REF_CHARACTERISTIC
/end GROUP
/begin GROUP S1065_SDO_Reply "SC_KZQ_EV2274A_4_1/Main/CAN SDO/SDO  0x7C/Case 0x6440h(25664)/ Case 0x6440-008/SDO Reply"
 /begin SUB_GROUP S1328_SDO_Error_Reply S1328_value_To_uint8_4_ S1328_value_To_uint8_4_1 /end SUB_GROUP
 /begin REF_CHARACTERISTIC core_gp_xSwapBytes /end REF_CHARACTERISTIC
/end GROUP
/begin GROUP S1066_SDO_Reply "SC_KZQ_EV2274A_4_1/Main/CAN SDO/SDO  0x7C/Case 0x6440h(25664)/ Case 0x6440-009/SDO Reply"
 /begin SUB_GROUP S1364_SDO_Error_Reply S1364_value_To_uint8_4_ S1364_value_To_uint8_4_1 /end SUB_GROUP
 /begin REF_CHARACTERISTIC core_gp_xSwapBytes /end REF_CHARACTERISTIC
/end GROUP
/begin GROUP S1067_SDO_Reply "SC_KZQ_EV2274A_4_1/Main/CAN SDO/SDO  0x7C/Case 0x6440h(25664)/ Case 0x6440-010/SDO Reply"
 /begin SUB_GROUP S1400_SDO_Error_Reply S1400_value_To_uint8_4_ S1400_value_To_uint8_4_1 /end SUB_GROUP
 /begin REF_CHARACTERISTIC core_gp_xSwapBytes /end REF_CHARACTERISTIC
/end GROUP
/begin GROUP S1068_SDO_Reply "SC_KZQ_EV2274A_4_1/Main/CAN SDO/SDO  0x7C/Case 0x6440h(25664)/ Case 0x6440-011/SDO Reply"
 /begin SUB_GROUP S1436_SDO_Error_Reply S1436_value_To_uint8_4_ S1436_value_To_uint8_4_1 /end SUB_GROUP
 /begin REF_CHARACTERISTIC core_gp_xSwapBytes /end REF_CHARACTERISTIC
/end GROUP
/begin GROUP S1069_SDO_Reply "SC_KZQ_EV2274A_4_1/Main/CAN SDO/SDO  0x7C/Case 0x6440h(25664)/ Case 0x6440-012/SDO Reply"
 /begin SUB_GROUP S1472_SDO_Error_Reply S1472_value_To_uint8_4_ S1472_value_To_uint8_4_1 /end SUB_GROUP
 /begin REF_CHARACTERISTIC core_gp_xSwapBytes /end REF_CHARACTERISTIC
/end GROUP
/begin GROUP S1070_SDO_Reply "SC_KZQ_EV2274A_4_1/Main/CAN SDO/SDO  0x7C/Case 0x6440h(25664)/ Case 0x6440-013/SDO Reply"
 /begin SUB_GROUP S1508_SDO_Error_Reply S1508_value_To_uint8_4_ S1508_value_To_uint8_4_1 /end SUB_GROUP
 /begin REF_CHARACTERISTIC core_gp_xSwapBytes /end REF_CHARACTERISTIC
/end GROUP
/begin GROUP S1071_SDO_Reply "SC_KZQ_EV2274A_4_1/Main/CAN SDO/SDO  0x7C/Case 0x6440h(25664)/ Case 0x6440-014/SDO Reply"
 /begin SUB_GROUP S1544_SDO_Error_Reply S1544_value_To_uint8_4_ S1544_value_To_uint8_4_1 /end SUB_GROUP
 /begin REF_CHARACTERISTIC core_gp_xSwapBytes /end REF_CHARACTERISTIC
/end GROUP
/begin GROUP S1072_SDO_Reply "SC_KZQ_EV2274A_4_1/Main/CAN SDO/SDO  0x7C/Case 0x6440h(25664)/ Case 0x6440-015/SDO Reply"
 /begin SUB_GROUP S1580_SDO_Error_Reply S1580_value_To_uint8_4_ S1580_value_To_uint8_4_1 /end SUB_GROUP
 /begin REF_CHARACTERISTIC core_gp_xSwapBytes /end REF_CHARACTERISTIC
/end GROUP
/begin GROUP S1073_SDO_Reply "SC_KZQ_EV2274A_4_1/Main/CAN SDO/SDO  0x7C/Case 0x6440h(25664)/ Case 0x6440-016/SDO Reply"
 /begin SUB_GROUP S1616_SDO_Error_Reply S1616_value_To_uint8_4_ S1616_value_To_uint8_4_1 /end SUB_GROUP
 /begin REF_CHARACTERISTIC core_gp_xSwapBytes /end REF_CHARACTERISTIC
/end GROUP
/begin GROUP S1656_SDO_Reply "SC_KZQ_EV2274A_4_1/Main/CAN SDO/SDO  0x7C/Case 0x6443h/ Case 0x6443-001/SDO Reply"
 /begin SUB_GROUP S1690_SDO_Error_Reply S1690_value_To_uint8_4_ S1690_value_To_uint8_4_1 /end SUB_GROUP
 /begin REF_CHARACTERISTIC core_gp_xSwapBytes /end REF_CHARACTERISTIC
/end GROUP
/begin GROUP S1657_SDO_Reply "SC_KZQ_EV2274A_4_1/Main/CAN SDO/SDO  0x7C/Case 0x6443h/ Case 0x6443-002/SDO Reply"
 /begin SUB_GROUP S1726_SDO_Error_Reply S1726_value_To_uint8_4_ S1726_value_To_uint8_4_1 /end SUB_GROUP
 /begin REF_CHARACTERISTIC core_gp_xSwapBytes /end REF_CHARACTERISTIC
/end GROUP
/begin GROUP S1658_SDO_Reply "SC_KZQ_EV2274A_4_1/Main/CAN SDO/SDO  0x7C/Case 0x6443h/ Case 0x6443-003/SDO Reply"
 /begin SUB_GROUP S1762_SDO_Error_Reply S1762_value_To_uint8_4_ S1762_value_To_uint8_4_1 /end SUB_GROUP
 /begin REF_CHARACTERISTIC core_gp_xSwapBytes /end REF_CHARACTERISTIC
/end GROUP
/begin GROUP S1659_SDO_Reply "SC_KZQ_EV2274A_4_1/Main/CAN SDO/SDO  0x7C/Case 0x6443h/ Case 0x6443-004/SDO Reply"
 /begin SUB_GROUP S1798_SDO_Error_Reply S1798_value_To_uint8_4_ S1798_value_To_uint8_4_1 /end SUB_GROUP
 /begin REF_CHARACTERISTIC core_gp_xSwapBytes /end REF_CHARACTERISTIC
/end GROUP
/begin GROUP S1660_SDO_Reply "SC_KZQ_EV2274A_4_1/Main/CAN SDO/SDO  0x7C/Case 0x6443h/ Case 0x6443-005/SDO Reply"
 /begin SUB_GROUP S1834_SDO_Error_Reply S1834_value_To_uint8_4_ S1834_value_To_uint8_4_1 /end SUB_GROUP
 /begin REF_CHARACTERISTIC core_gp_xSwapBytes /end REF_CHARACTERISTIC
/end GROUP
/begin GROUP S1661_SDO_Reply "SC_KZQ_EV2274A_4_1/Main/CAN SDO/SDO  0x7C/Case 0x6443h/ Case 0x6443-006/SDO Reply"
 /begin SUB_GROUP S1870_SDO_Error_Reply S1870_value_To_uint8_4_ S1870_value_To_uint8_4_1 /end SUB_GROUP
 /begin REF_CHARACTERISTIC core_gp_xSwapBytes /end REF_CHARACTERISTIC
/end GROUP
/begin GROUP S1662_SDO_Reply "SC_KZQ_EV2274A_4_1/Main/CAN SDO/SDO  0x7C/Case 0x6443h/ Case 0x6443-007/SDO Reply"
 /begin SUB_GROUP S1906_SDO_Error_Reply S1906_value_To_uint8_4_ S1906_value_To_uint8_4_1 /end SUB_GROUP
 /begin REF_CHARACTERISTIC core_gp_xSwapBytes /end REF_CHARACTERISTIC
/end GROUP
/begin GROUP S1663_SDO_Reply "SC_KZQ_EV2274A_4_1/Main/CAN SDO/SDO  0x7C/Case 0x6443h/ Case 0x6443-008/SDO Reply"
 /begin SUB_GROUP S1942_SDO_Error_Reply S1942_value_To_uint8_4_ S1942_value_To_uint8_4_1 /end SUB_GROUP
 /begin REF_CHARACTERISTIC core_gp_xSwapBytes /end REF_CHARACTERISTIC
/end GROUP
/begin GROUP S1664_SDO_Reply "SC_KZQ_EV2274A_4_1/Main/CAN SDO/SDO  0x7C/Case 0x6443h/ Case 0x6443-009/SDO Reply"
 /begin SUB_GROUP S1978_SDO_Error_Reply S1978_value_To_uint8_4_ S1978_value_To_uint8_4_1 /end SUB_GROUP
 /begin REF_CHARACTERISTIC core_gp_xSwapBytes /end REF_CHARACTERISTIC
/end GROUP
/begin GROUP S1665_SDO_Reply "SC_KZQ_EV2274A_4_1/Main/CAN SDO/SDO  0x7C/Case 0x6443h/ Case 0x6443-010/SDO Reply"
 /begin SUB_GROUP S2014_SDO_Error_Reply S2014_value_To_uint8_4_ S2014_value_To_uint8_4_1 /end SUB_GROUP
 /begin REF_CHARACTERISTIC core_gp_xSwapBytes /end REF_CHARACTERISTIC
/end GROUP
/begin GROUP S1666_SDO_Reply "SC_KZQ_EV2274A_4_1/Main/CAN SDO/SDO  0x7C/Case 0x6443h/ Case 0x6443-011/SDO Reply"
 /begin SUB_GROUP S2050_SDO_Error_Reply S2050_value_To_uint8_4_ S2050_value_To_uint8_4_1 /end SUB_GROUP
 /begin REF_CHARACTERISTIC core_gp_xSwapBytes /end REF_CHARACTERISTIC
/end GROUP
/begin GROUP S1667_SDO_Reply "SC_KZQ_EV2274A_4_1/Main/CAN SDO/SDO  0x7C/Case 0x6443h/ Case 0x6443-012/SDO Reply"
 /begin SUB_GROUP S2086_SDO_Error_Reply S2086_value_To_uint8_4_ S2086_value_To_uint8_4_1 /end SUB_GROUP
 /begin REF_CHARACTERISTIC core_gp_xSwapBytes /end REF_CHARACTERISTIC
/end GROUP
/begin GROUP S1668_SDO_Reply "SC_KZQ_EV2274A_4_1/Main/CAN SDO/SDO  0x7C/Case 0x6443h/ Case 0x6443-013/SDO Reply"
 /begin SUB_GROUP S2122_SDO_Error_Reply S2122_value_To_uint8_4_ S2122_value_To_uint8_4_1 /end SUB_GROUP
 /begin REF_CHARACTERISTIC core_gp_xSwapBytes /end REF_CHARACTERISTIC
/end GROUP
/begin GROUP S1669_SDO_Reply "SC_KZQ_EV2274A_4_1/Main/CAN SDO/SDO  0x7C/Case 0x6443h/ Case 0x6443-014/SDO Reply"
 /begin SUB_GROUP S2158_SDO_Error_Reply S2158_value_To_uint8_4_ S2158_value_To_uint8_4_1 /end SUB_GROUP
 /begin REF_CHARACTERISTIC core_gp_xSwapBytes /end REF_CHARACTERISTIC
/end GROUP
/begin GROUP S1670_SDO_Reply "SC_KZQ_EV2274A_4_1/Main/CAN SDO/SDO  0x7C/Case 0x6443h/ Case 0x6443-015/SDO Reply"
 /begin SUB_GROUP S2194_SDO_Error_Reply S2194_value_To_uint8_4_ S2194_value_To_uint8_4_1 /end SUB_GROUP
 /begin REF_CHARACTERISTIC core_gp_xSwapBytes /end REF_CHARACTERISTIC
/end GROUP
/begin GROUP S1671_SDO_Reply "SC_KZQ_EV2274A_4_1/Main/CAN SDO/SDO  0x7C/Case 0x6443h/ Case 0x6443-016/SDO Reply"
 /begin SUB_GROUP S2230_SDO_Error_Reply S2230_value_To_uint8_4_ S2230_value_To_uint8_4_1 /end SUB_GROUP
 /begin REF_CHARACTERISTIC core_gp_xSwapBytes /end REF_CHARACTERISTIC
/end GROUP
/begin GROUP S1672_SDO_Reply "SC_KZQ_EV2274A_4_1/Main/CAN SDO/SDO  0x7C/Case 0x6443h/ Case 0x6443-017/SDO Reply"
 /begin SUB_GROUP S2266_SDO_Error_Reply S2266_value_To_uint8_4_ S2266_value_To_uint8_4_1 /end SUB_GROUP
 /begin REF_CHARACTERISTIC core_gp_xSwapBytes /end REF_CHARACTERISTIC
/end GROUP
/begin GROUP S1673_SDO_Reply "SC_KZQ_EV2274A_4_1/Main/CAN SDO/SDO  0x7C/Case 0x6443h/ Case 0x6443-018/SDO Reply"
 /begin SUB_GROUP S2302_SDO_Error_Reply S2302_value_To_uint8_4_ S2302_value_To_uint8_4_1 /end SUB_GROUP
 /begin REF_CHARACTERISTIC core_gp_xSwapBytes /end REF_CHARACTERISTIC
/end GROUP
/begin GROUP S1674_SDO_Reply "SC_KZQ_EV2274A_4_1/Main/CAN SDO/SDO  0x7C/Case 0x6443h/ Case 0x6443-019/SDO Reply"
 /begin SUB_GROUP S2338_SDO_Error_Reply S2338_value_To_uint8_4_ S2338_value_To_uint8_4_1 /end SUB_GROUP
 /begin REF_CHARACTERISTIC core_gp_xSwapBytes /end REF_CHARACTERISTIC
/end GROUP
/begin GROUP S1675_SDO_Reply "SC_KZQ_EV2274A_4_1/Main/CAN SDO/SDO  0x7C/Case 0x6443h/ Case 0x6443-020/SDO Reply"
 /begin SUB_GROUP S2374_SDO_Error_Reply S2374_value_To_uint8_4_ S2374_value_To_uint8_4_1 /end SUB_GROUP
 /begin REF_CHARACTERISTIC core_gp_xSwapBytes /end REF_CHARACTERISTIC
/end GROUP
/begin GROUP S1676_SDO_Reply "SC_KZQ_EV2274A_4_1/Main/CAN SDO/SDO  0x7C/Case 0x6443h/ Case 0x6443-021/SDO Reply"
 /begin SUB_GROUP S2410_SDO_Error_Reply S2410_value_To_uint8_4_ S2410_value_To_uint8_4_1 /end SUB_GROUP
 /begin REF_CHARACTERISTIC core_gp_xSwapBytes /end REF_CHARACTERISTIC
/end GROUP
/begin GROUP S1677_SDO_Reply "SC_KZQ_EV2274A_4_1/Main/CAN SDO/SDO  0x7C/Case 0x6443h/ Case 0x6443-022/SDO Reply"
 /begin SUB_GROUP S2446_SDO_Error_Reply S2446_value_To_uint8_4_ S2446_value_To_uint8_4_1 /end SUB_GROUP
 /begin REF_CHARACTERISTIC core_gp_xSwapBytes /end REF_CHARACTERISTIC
/end GROUP
/begin GROUP S1678_SDO_Reply "SC_KZQ_EV2274A_4_1/Main/CAN SDO/SDO  0x7C/Case 0x6443h/ Case 0x6443-023/SDO Reply"
 /begin SUB_GROUP S2482_SDO_Error_Reply S2482_value_To_uint8_4_ S2482_value_To_uint8_4_1 /end SUB_GROUP
 /begin REF_CHARACTERISTIC core_gp_xSwapBytes /end REF_CHARACTERISTIC
/end GROUP
/begin GROUP S1679_SDO_Reply "SC_KZQ_EV2274A_4_1/Main/CAN SDO/SDO  0x7C/Case 0x6443h/ Case 0x6443-024/SDO Reply"
 /begin SUB_GROUP S2518_SDO_Error_Reply S2518_value_To_uint8_4_ S2518_value_To_uint8_4_1 /end SUB_GROUP
 /begin REF_CHARACTERISTIC core_gp_xSwapBytes /end REF_CHARACTERISTIC
/end GROUP
/begin GROUP S1680_SDO_Reply "SC_KZQ_EV2274A_4_1/Main/CAN SDO/SDO  0x7C/Case 0x6443h/ Case 0x6443-025/SDO Reply"
 /begin SUB_GROUP S2554_SDO_Error_Reply S2554_value_To_uint8_4_ S2554_value_To_uint8_4_1 /end SUB_GROUP
 /begin REF_CHARACTERISTIC core_gp_xSwapBytes /end REF_CHARACTERISTIC
/end GROUP
/begin GROUP S1681_SDO_Reply "SC_KZQ_EV2274A_4_1/Main/CAN SDO/SDO  0x7C/Case 0x6443h/ Case 0x6443-026/SDO Reply"
 /begin SUB_GROUP S2590_SDO_Error_Reply S2590_value_To_uint8_4_ S2590_value_To_uint8_4_1 /end SUB_GROUP
 /begin REF_CHARACTERISTIC core_gp_xSwapBytes /end REF_CHARACTERISTIC
/end GROUP
/begin GROUP S1682_SDO_Reply "SC_KZQ_EV2274A_4_1/Main/CAN SDO/SDO  0x7C/Case 0x6443h/ Case 0x6443-027/SDO Reply"
 /begin SUB_GROUP S2626_SDO_Error_Reply S2626_value_To_uint8_4_ S2626_value_To_uint8_4_1 /end SUB_GROUP
 /begin REF_CHARACTERISTIC core_gp_xSwapBytes /end REF_CHARACTERISTIC
/end GROUP
/begin GROUP S1683_SDO_Reply "SC_KZQ_EV2274A_4_1/Main/CAN SDO/SDO  0x7C/Case 0x6443h/ Case 0x6443-028/SDO Reply"
 /begin SUB_GROUP S2662_SDO_Error_Reply S2662_value_To_uint8_4_ S2662_value_To_uint8_4_1 /end SUB_GROUP
 /begin REF_CHARACTERISTIC core_gp_xSwapBytes /end REF_CHARACTERISTIC
/end GROUP
/begin GROUP S1684_SDO_Reply "SC_KZQ_EV2274A_4_1/Main/CAN SDO/SDO  0x7C/Case 0x6443h/ Case 0x6443-029/SDO Reply"
 /begin SUB_GROUP S2698_SDO_Error_Reply S2698_value_To_uint8_4_ S2698_value_To_uint8_4_1 /end SUB_GROUP
 /begin REF_CHARACTERISTIC core_gp_xSwapBytes /end REF_CHARACTERISTIC
/end GROUP
/begin GROUP S1685_SDO_Reply "SC_KZQ_EV2274A_4_1/Main/CAN SDO/SDO  0x7C/Case 0x6443h/ Case 0x6443-030/SDO Reply"
 /begin SUB_GROUP S2734_SDO_Error_Reply S2734_value_To_uint8_4_ S2734_value_To_uint8_4_1 /end SUB_GROUP
 /begin REF_CHARACTERISTIC core_gp_xSwapBytes /end REF_CHARACTERISTIC
/end GROUP
/begin GROUP S1686_SDO_Reply "SC_KZQ_EV2274A_4_1/Main/CAN SDO/SDO  0x7C/Case 0x6443h/ Case 0x6443-031/SDO Reply"
 /begin SUB_GROUP S2770_SDO_Error_Reply S2770_value_To_uint8_4_ S2770_value_To_uint8_4_1 /end SUB_GROUP
 /begin REF_CHARACTERISTIC core_gp_xSwapBytes /end REF_CHARACTERISTIC
/end GROUP
/begin GROUP S1687_SDO_Reply "SC_KZQ_EV2274A_4_1/Main/CAN SDO/SDO  0x7C/Case 0x6443h/ Case 0x6443-032/SDO Reply"
 /begin SUB_GROUP S2806_SDO_Error_Reply S2806_value_To_uint8_4_ S2806_value_To_uint8_4_1 /end SUB_GROUP
 /begin REF_CHARACTERISTIC core_gp_xSwapBytes /end REF_CHARACTERISTIC
/end GROUP
/begin GROUP S2846_SDO_Reply "SC_KZQ_EV2274A_4_1/Main/CAN SDO/SDO  0x7C/Case 0x6445h/ Case 0x6445-001/SDO Reply"
 /begin SUB_GROUP S2870_SDO_Error_Reply S2870_value_To_uint8_4_ S2870_value_To_uint8_4_1 /end SUB_GROUP
 /begin REF_CHARACTERISTIC core_gp_xSwapBytes /end REF_CHARACTERISTIC
/end GROUP
/begin GROUP S2847_SDO_Reply "SC_KZQ_EV2274A_4_1/Main/CAN SDO/SDO  0x7C/Case 0x6445h/ Case 0x6445-002/SDO Reply"
 /begin SUB_GROUP S2906_SDO_Error_Reply S2906_value_To_uint8_4_ S2906_value_To_uint8_4_1 /end SUB_GROUP
 /begin REF_CHARACTERISTIC core_gp_xSwapBytes /end REF_CHARACTERISTIC
/end GROUP
/begin GROUP S2848_SDO_Reply "SC_KZQ_EV2274A_4_1/Main/CAN SDO/SDO  0x7C/Case 0x6445h/ Case 0x6445-003/SDO Reply"
 /begin SUB_GROUP S2942_SDO_Error_Reply S2942_value_To_uint8_4_ S2942_value_To_uint8_4_1 /end SUB_GROUP
 /begin REF_CHARACTERISTIC core_gp_xSwapBytes /end REF_CHARACTERISTIC
/end GROUP
/begin GROUP S2849_SDO_Reply "SC_KZQ_EV2274A_4_1/Main/CAN SDO/SDO  0x7C/Case 0x6445h/ Case 0x6445-004/SDO Reply"
 /begin SUB_GROUP S2978_SDO_Error_Reply S2978_value_To_uint8_4_ S2978_value_To_uint8_4_1 /end SUB_GROUP
 /begin REF_CHARACTERISTIC core_gp_xSwapBytes /end REF_CHARACTERISTIC
/end GROUP
/begin GROUP S2850_SDO_Reply "SC_KZQ_EV2274A_4_1/Main/CAN SDO/SDO  0x7C/Case 0x6445h/ Case 0x6445-030/SDO Reply"
 /begin SUB_GROUP S3014_SDO_Error_Reply S3014_value_To_uint8_4_ S3014_value_To_uint8_4_1 /end SUB_GROUP
 /begin REF_CHARACTERISTIC core_gp_xSwapBytes /end REF_CHARACTERISTIC
/end GROUP
/begin GROUP S2851_SDO_Reply "SC_KZQ_EV2274A_4_1/Main/CAN SDO/SDO  0x7C/Case 0x6445h/ Case 0x6445-040/SDO Reply"
 /begin SUB_GROUP S3050_SDO_Error_Reply S3050_value_To_uint8_4_ S3050_value_To_uint8_4_1 /end SUB_GROUP
 /begin REF_CHARACTERISTIC core_gp_xSwapBytes /end REF_CHARACTERISTIC
/end GROUP
/begin GROUP S2852_SDO_Reply "SC_KZQ_EV2274A_4_1/Main/CAN SDO/SDO  0x7C/Case 0x6445h/ Case 0x6445-041/SDO Reply"
 /begin SUB_GROUP S3086_SDO_Error_Reply S3086_value_To_uint8_4_ S3086_value_To_uint8_4_1 /end SUB_GROUP
 /begin REF_CHARACTERISTIC core_gp_xSwapBytes /end REF_CHARACTERISTIC
/end GROUP
/begin GROUP S2853_SDO_Reply "SC_KZQ_EV2274A_4_1/Main/CAN SDO/SDO  0x7C/Case 0x6445h/ Case 0x6445-042/SDO Reply"
 /begin SUB_GROUP S3122_SDO_Error_Reply S3122_value_To_uint8_4_ S3122_value_To_uint8_4_1 /end SUB_GROUP
 /begin REF_CHARACTERISTIC core_gp_xSwapBytes /end REF_CHARACTERISTIC
/end GROUP
/begin GROUP S2854_SDO_Reply "SC_KZQ_EV2274A_4_1/Main/CAN SDO/SDO  0x7C/Case 0x6445h/ Case 0x6445-043/SDO Reply"
 /begin SUB_GROUP S3158_SDO_Error_Reply S3158_value_To_uint8_4_ S3158_value_To_uint8_4_1 /end SUB_GROUP
 /begin REF_CHARACTERISTIC core_gp_xSwapBytes /end REF_CHARACTERISTIC
/end GROUP
/begin GROUP S2855_SDO_Reply "SC_KZQ_EV2274A_4_1/Main/CAN SDO/SDO  0x7C/Case 0x6445h/ Case 0x6445-044/SDO Reply"
 /begin SUB_GROUP S3194_SDO_Error_Reply S3194_value_To_uint8_4_ S3194_value_To_uint8_4_1 /end SUB_GROUP
 /begin REF_CHARACTERISTIC core_gp_xSwapBytes /end REF_CHARACTERISTIC
/end GROUP
/begin GROUP S2856_SDO_Reply "SC_KZQ_EV2274A_4_1/Main/CAN SDO/SDO  0x7C/Case 0x6445h/ Case 0x6445-045/SDO Reply"
 /begin SUB_GROUP S3230_SDO_Error_Reply S3230_value_To_uint8_4_ S3230_value_To_uint8_4_1 /end SUB_GROUP
 /begin REF_CHARACTERISTIC core_gp_xSwapBytes /end REF_CHARACTERISTIC
/end GROUP
/begin GROUP S2857_SDO_Reply "SC_KZQ_EV2274A_4_1/Main/CAN SDO/SDO  0x7C/Case 0x6445h/ Case 0x6445-046/SDO Reply"
 /begin SUB_GROUP S3266_SDO_Error_Reply S3266_value_To_uint8_4_ S3266_value_To_uint8_4_1 /end SUB_GROUP
 /begin REF_CHARACTERISTIC core_gp_xSwapBytes /end REF_CHARACTERISTIC
/end GROUP
/begin GROUP S2858_SDO_Reply "SC_KZQ_EV2274A_4_1/Main/CAN SDO/SDO  0x7C/Case 0x6445h/ Case 0x6445-060/SDO Reply"
 /begin SUB_GROUP S3302_SDO_Error_Reply S3302_value_To_uint8_4_ S3302_value_To_uint8_4_1 /end SUB_GROUP
 /begin REF_CHARACTERISTIC core_gp_xSwapBytes /end REF_CHARACTERISTIC
/end GROUP
/begin GROUP S2859_SDO_Reply "SC_KZQ_EV2274A_4_1/Main/CAN SDO/SDO  0x7C/Case 0x6445h/ Case 0x6445-061/SDO Reply"
 /begin SUB_GROUP S3338_SDO_Error_Reply S3338_value_To_uint8_4_ S3338_value_To_uint8_4_1 /end SUB_GROUP
 /begin REF_CHARACTERISTIC core_gp_xSwapBytes /end REF_CHARACTERISTIC
/end GROUP
/begin GROUP S2860_SDO_Reply "SC_KZQ_EV2274A_4_1/Main/CAN SDO/SDO  0x7C/Case 0x6445h/ Case 0x6445-062/SDO Reply"
 /begin SUB_GROUP S3374_SDO_Error_Reply S3374_value_To_uint8_4_ S3374_value_To_uint8_4_1 /end SUB_GROUP
 /begin REF_CHARACTERISTIC core_gp_xSwapBytes /end REF_CHARACTERISTIC
/end GROUP
/begin GROUP S2861_SDO_Reply "SC_KZQ_EV2274A_4_1/Main/CAN SDO/SDO  0x7C/Case 0x6445h/ Case 0x6445-080/SDO Reply"
 /begin SUB_GROUP S3410_SDO_Error_Reply S3410_value_To_uint8_4_ S3410_value_To_uint8_4_1 /end SUB_GROUP
 /begin REF_CHARACTERISTIC core_gp_xSwapBytes /end REF_CHARACTERISTIC
/end GROUP
/begin GROUP S2862_SDO_Reply "SC_KZQ_EV2274A_4_1/Main/CAN SDO/SDO  0x7C/Case 0x6445h/ Case 0x6445-081/SDO Reply"
 /begin SUB_GROUP S3446_SDO_Error_Reply S3446_value_To_uint8_4_ S3446_value_To_uint8_4_1 /end SUB_GROUP
 /begin REF_CHARACTERISTIC core_gp_xSwapBytes /end REF_CHARACTERISTIC
/end GROUP
/begin GROUP S2863_SDO_Reply "SC_KZQ_EV2274A_4_1/Main/CAN SDO/SDO  0x7C/Case 0x6445h/ Case 0x6445-090/SDO Reply"
 /begin SUB_GROUP S3482_SDO_Error_Reply S3482_value_To_uint8_4_ S3482_value_To_uint8_4_1 /end SUB_GROUP
 /begin REF_CHARACTERISTIC core_gp_xSwapBytes /end REF_CHARACTERISTIC
/end GROUP
/begin GROUP S2864_SDO_Reply "SC_KZQ_EV2274A_4_1/Main/CAN SDO/SDO  0x7C/Case 0x6445h/ Case 0x6445-091/SDO Reply"
 /begin SUB_GROUP S3518_SDO_Error_Reply S3518_value_To_uint8_4_ S3518_value_To_uint8_4_1 /end SUB_GROUP
 /begin REF_CHARACTERISTIC core_gp_xSwapBytes /end REF_CHARACTERISTIC
/end GROUP
/begin GROUP S2865_SDO_Reply "SC_KZQ_EV2274A_4_1/Main/CAN SDO/SDO  0x7C/Case 0x6445h/ Case 0x6445-092/SDO Reply"
 /begin SUB_GROUP S3554_SDO_Error_Reply S3554_value_To_uint8_4_ S3554_value_To_uint8_4_1 /end SUB_GROUP
 /begin REF_CHARACTERISTIC core_gp_xSwapBytes /end REF_CHARACTERISTIC
/end GROUP
/begin GROUP S2866_SDO_Reply "SC_KZQ_EV2274A_4_1/Main/CAN SDO/SDO  0x7C/Case 0x6445h/ Case 0x6445-093/SDO Reply"
 /begin SUB_GROUP S3590_SDO_Error_Reply S3590_value_To_uint8_4_ S3590_value_To_uint8_4_1 /end SUB_GROUP
 /begin REF_CHARACTERISTIC core_gp_xSwapBytes /end REF_CHARACTERISTIC
/end GROUP
/begin GROUP S2867_SDO_Reply "SC_KZQ_EV2274A_4_1/Main/CAN SDO/SDO  0x7C/Case 0x6445h/ Case 0x6445-180/SDO Reply"
 /begin SUB_GROUP S3626_SDO_Error_Reply S3626_value_To_uint8_4_ S3626_value_To_uint8_4_1 /end SUB_GROUP
 /begin REF_CHARACTERISTIC core_gp_xSwapBytes /end REF_CHARACTERISTIC
/end GROUP
/begin GROUP S3666_SDO_Reply "SC_KZQ_EV2274A_4_1/Main/CAN SDO/SDO  0x7C/Case 0x6447h/ Case 0x6447-001/SDO Reply"
 /begin SUB_GROUP S3690_SDO_Error_Reply S3690_value_To_uint8_4_ S3690_value_To_uint8_4_1 /end SUB_GROUP
 /begin REF_CHARACTERISTIC core_gp_xSwapBytes /end REF_CHARACTERISTIC
/end GROUP
/begin GROUP S3667_SDO_Reply "SC_KZQ_EV2274A_4_1/Main/CAN SDO/SDO  0x7C/Case 0x6447h/ Case 0x6447-002/SDO Reply"
 /begin SUB_GROUP S3726_SDO_Error_Reply S3726_value_To_uint8_4_ S3726_value_To_uint8_4_1 /end SUB_GROUP
 /begin REF_CHARACTERISTIC core_gp_xSwapBytes /end REF_CHARACTERISTIC
/end GROUP
/begin GROUP S3668_SDO_Reply "SC_KZQ_EV2274A_4_1/Main/CAN SDO/SDO  0x7C/Case 0x6447h/ Case 0x6447-003/SDO Reply"
 /begin SUB_GROUP S3762_SDO_Error_Reply S3762_value_To_uint8_4_ S3762_value_To_uint8_4_1 /end SUB_GROUP
 /begin REF_CHARACTERISTIC core_gp_xSwapBytes /end REF_CHARACTERISTIC
/end GROUP
/begin GROUP S3669_SDO_Reply "SC_KZQ_EV2274A_4_1/Main/CAN SDO/SDO  0x7C/Case 0x6447h/ Case 0x6447-004/SDO Reply"
 /begin SUB_GROUP S3798_SDO_Error_Reply S3798_value_To_uint8_4_ S3798_value_To_uint8_4_1 /end SUB_GROUP
 /begin REF_CHARACTERISTIC core_gp_xSwapBytes /end REF_CHARACTERISTIC
/end GROUP
/begin GROUP S3670_SDO_Reply "SC_KZQ_EV2274A_4_1/Main/CAN SDO/SDO  0x7C/Case 0x6447h/ Case 0x6447-005/SDO Reply"
 /begin SUB_GROUP S3834_SDO_Error_Reply S3834_value_To_uint8_4_ S3834_value_To_uint8_4_1 /end SUB_GROUP
 /begin REF_CHARACTERISTIC core_gp_xSwapBytes /end REF_CHARACTERISTIC
/end GROUP
/begin GROUP S3671_SDO_Reply "SC_KZQ_EV2274A_4_1/Main/CAN SDO/SDO  0x7C/Case 0x6447h/ Case 0x6447-006/SDO Reply"
 /begin SUB_GROUP S3870_SDO_Error_Reply S3870_value_To_uint8_4_ S3870_value_To_uint8_4_1 /end SUB_GROUP
 /begin REF_CHARACTERISTIC core_gp_xSwapBytes /end REF_CHARACTERISTIC
/end GROUP
/begin GROUP S3672_SDO_Reply "SC_KZQ_EV2274A_4_1/Main/CAN SDO/SDO  0x7C/Case 0x6447h/ Case 0x6447-031/SDO Reply"
 /begin SUB_GROUP S3906_SDO_Error_Reply S3906_value_To_uint8_4_ S3906_value_To_uint8_4_1 /end SUB_GROUP
 /begin REF_CHARACTERISTIC core_gp_xSwapBytes /end REF_CHARACTERISTIC
/end GROUP
/begin GROUP S3673_SDO_Reply "SC_KZQ_EV2274A_4_1/Main/CAN SDO/SDO  0x7C/Case 0x6447h/ Case 0x6447-034/SDO Reply"
 /begin SUB_GROUP S3942_SDO_Error_Reply S3942_value_To_uint8_4_ S3942_value_To_uint8_4_1 /end SUB_GROUP
 /begin REF_CHARACTERISTIC core_gp_xSwapBytes /end REF_CHARACTERISTIC
/end GROUP
/begin GROUP S3674_SDO_Reply "SC_KZQ_EV2274A_4_1/Main/CAN SDO/SDO  0x7C/Case 0x6447h/ Case 0x6447-061/SDO Reply"
 /begin SUB_GROUP S3978_SDO_Error_Reply S3978_value_To_uint8_4_ S3978_value_To_uint8_4_1 /end SUB_GROUP
 /begin REF_CHARACTERISTIC core_gp_xSwapBytes /end REF_CHARACTERISTIC
/end GROUP
/begin GROUP S3675_SDO_Reply "SC_KZQ_EV2274A_4_1/Main/CAN SDO/SDO  0x7C/Case 0x6447h/ Case 0x6447-064/SDO Reply"
 /begin SUB_GROUP S4014_SDO_Error_Reply S4014_value_To_uint8_4_ S4014_value_To_uint8_4_1 /end SUB_GROUP
 /begin REF_CHARACTERISTIC core_gp_xSwapBytes /end REF_CHARACTERISTIC
/end GROUP
/begin GROUP S3676_SDO_Reply "SC_KZQ_EV2274A_4_1/Main/CAN SDO/SDO  0x7C/Case 0x6447h/ Case 0x6447-067/SDO Reply"
 /begin SUB_GROUP S4050_SDO_Error_Reply S4050_value_To_uint8_4_ S4050_value_To_uint8_4_1 /end SUB_GROUP
 /begin REF_CHARACTERISTIC core_gp_xSwapBytes /end REF_CHARACTERISTIC
/end GROUP
/begin GROUP S3677_SDO_Reply "SC_KZQ_EV2274A_4_1/Main/CAN SDO/SDO  0x7C/Case 0x6447h/ Case 0x6447-070/SDO Reply"
 /begin SUB_GROUP S4086_SDO_Error_Reply S4086_value_To_uint8_4_ S4086_value_To_uint8_4_1 /end SUB_GROUP
 /begin REF_CHARACTERISTIC core_gp_xSwapBytes /end REF_CHARACTERISTIC
/end GROUP
/begin GROUP S3678_SDO_Reply "SC_KZQ_EV2274A_4_1/Main/CAN SDO/SDO  0x7C/Case 0x6447h/ Case 0x6447-073/SDO Reply"
 /begin SUB_GROUP S4122_SDO_Error_Reply S4122_value_To_uint8_4_ S4122_value_To_uint8_4_1 /end SUB_GROUP
 /begin REF_CHARACTERISTIC core_gp_xSwapBytes /end REF_CHARACTERISTIC
/end GROUP
/begin GROUP S3679_SDO_Reply "SC_KZQ_EV2274A_4_1/Main/CAN SDO/SDO  0x7C/Case 0x6447h/ Case 0x6447-076/SDO Reply"
 /begin SUB_GROUP S4158_SDO_Error_Reply S4158_value_To_uint8_4_ S4158_value_To_uint8_4_1 /end SUB_GROUP
 /begin REF_CHARACTERISTIC core_gp_xSwapBytes /end REF_CHARACTERISTIC
/end GROUP
/begin GROUP S3680_SDO_Reply "SC_KZQ_EV2274A_4_1/Main/CAN SDO/SDO  0x7C/Case 0x6447h/ Case 0x6447-097/SDO Reply"
 /begin SUB_GROUP S4194_SDO_Error_Reply S4194_value_To_uint8_4_ S4194_value_To_uint8_4_1 /end SUB_GROUP
 /begin REF_CHARACTERISTIC core_gp_xSwapBytes /end REF_CHARACTERISTIC
/end GROUP
/begin GROUP S3681_SDO_Reply "SC_KZQ_EV2274A_4_1/Main/CAN SDO/SDO  0x7C/Case 0x6447h/ Case 0x6447-100/SDO Reply"
 /begin SUB_GROUP S4230_SDO_Error_Reply S4230_value_To_uint8_4_ S4230_value_To_uint8_4_1 /end SUB_GROUP
 /begin REF_CHARACTERISTIC core_gp_xSwapBytes /end REF_CHARACTERISTIC
/end GROUP
/begin GROUP S3682_SDO_Reply "SC_KZQ_EV2274A_4_1/Main/CAN SDO/SDO  0x7C/Case 0x6447h/ Case 0x6447-103/SDO Reply"
 /begin SUB_GROUP S4266_SDO_Error_Reply S4266_value_To_uint8_4_ S4266_value_To_uint8_4_1 /end SUB_GROUP
 /begin REF_CHARACTERISTIC core_gp_xSwapBytes /end REF_CHARACTERISTIC
/end GROUP
/begin GROUP S3683_SDO_Reply "SC_KZQ_EV2274A_4_1/Main/CAN SDO/SDO  0x7C/Case 0x6447h/ Case 0x6447-106/SDO Reply"
 /begin SUB_GROUP S4302_SDO_Error_Reply S4302_value_To_uint8_4_ S4302_value_To_uint8_4_1 /end SUB_GROUP
 /begin REF_CHARACTERISTIC core_gp_xSwapBytes /end REF_CHARACTERISTIC
/end GROUP
/begin GROUP S3684_SDO_Reply "SC_KZQ_EV2274A_4_1/Main/CAN SDO/SDO  0x7C/Case 0x6447h/ Case 0x6447-151/SDO Reply"
 /begin SUB_GROUP S4338_SDO_Error_Reply S4338_value_To_uint8_4_ S4338_value_To_uint8_4_1 /end SUB_GROUP
 /begin REF_CHARACTERISTIC core_gp_xSwapBytes /end REF_CHARACTERISTIC
/end GROUP
/begin GROUP S3685_SDO_Reply "SC_KZQ_EV2274A_4_1/Main/CAN SDO/SDO  0x7C/Case 0x6447h/ Case 0x6447-154/SDO Reply"
 /begin SUB_GROUP S4374_SDO_Error_Reply S4374_value_To_uint8_4_ S4374_value_To_uint8_4_1 /end SUB_GROUP
 /begin REF_CHARACTERISTIC core_gp_xSwapBytes /end REF_CHARACTERISTIC
/end GROUP
/begin GROUP S3686_SDO_Reply "SC_KZQ_EV2274A_4_1/Main/CAN SDO/SDO  0x7C/Case 0x6447h/ Case 0x6447-37/SDO Reply"
 /begin SUB_GROUP S4410_SDO_Error_Reply S4410_value_To_uint8_4_ S4410_value_To_uint8_4_1 /end SUB_GROUP
 /begin REF_CHARACTERISTIC core_gp_xSwapBytes /end REF_CHARACTERISTIC
/end GROUP
/begin GROUP S3687_SDO_Reply "SC_KZQ_EV2274A_4_1/Main/CAN SDO/SDO  0x7C/Case 0x6447h/ Case 0x6447-38/SDO Reply"
 /begin SUB_GROUP S4446_SDO_Error_Reply S4446_value_To_uint8_4_ S4446_value_To_uint8_4_1 /end SUB_GROUP
 /begin REF_CHARACTERISTIC core_gp_xSwapBytes /end REF_CHARACTERISTIC
/end GROUP
/begin GROUP S4486_SDO_Reply "SC_KZQ_EV2274A_4_1/Main/CAN SDO/SDO  0x7C/Case 0x6508h/ Case 0x6508-001/SDO Reply"
 /begin SUB_GROUP S4491_SDO_Error_Reply S4491_value_To_uint8_4_ S4491_value_To_uint8_4_1 /end SUB_GROUP
 /begin REF_CHARACTERISTIC core_gp_xSwapBytes /end REF_CHARACTERISTIC
/end GROUP
/begin GROUP S4487_SDO_Reply "SC_KZQ_EV2274A_4_1/Main/CAN SDO/SDO  0x7C/Case 0x6508h/ Case 0x6508-010/SDO Reply"
 /begin SUB_GROUP S4527_SDO_Error_Reply S4527_value_To_uint8_4_ S4527_value_To_uint8_4_1 /end SUB_GROUP
 /begin REF_CHARACTERISTIC core_gp_xSwapBytes /end REF_CHARACTERISTIC
/end GROUP
/begin GROUP S4488_SDO_Reply "SC_KZQ_EV2274A_4_1/Main/CAN SDO/SDO  0x7C/Case 0x6508h/ Case 0x6508-020/SDO Reply"
 /begin SUB_GROUP S4563_SDO_Error_Reply S4563_value_To_uint8_4_ S4563_value_To_uint8_4_1 /end SUB_GROUP
 /begin REF_CHARACTERISTIC core_gp_xSwapBytes /end REF_CHARACTERISTIC
/end GROUP
/begin GROUP S4603_SDO_Reply "SC_KZQ_EV2274A_4_1/Main/CAN SDO/SDO  0x7C/Case 0x6510h/ Case 0x6510-001/SDO Reply"
 /begin SUB_GROUP S4607_SDO_Error_Reply S4607_value_To_uint8_4_ S4607_value_To_uint8_4_1 /end SUB_GROUP
 /begin REF_CHARACTERISTIC core_gp_xSwapBytes /end REF_CHARACTERISTIC
/end GROUP
/begin GROUP S4604_SDO_Reply "SC_KZQ_EV2274A_4_1/Main/CAN SDO/SDO  0x7C/Case 0x6510h/ Case 0x6510-002/SDO Reply"
 /begin SUB_GROUP S4643_SDO_Error_Reply S4643_value_To_uint8_4_ S4643_value_To_uint8_4_1 /end SUB_GROUP
 /begin REF_CHARACTERISTIC core_gp_xSwapBytes /end REF_CHARACTERISTIC
/end GROUP
/begin GROUP S4895_SDO_Reply "SC_KZQ_EV2274A_4_1/Main/GPS /SDO  0x7B/Case 0x6520h(25888)/ Case 0x6520-001/SDO Reply"
 /begin SUB_GROUP S4904_SDO_Error_Reply S4904_value_To_uint8_4_ S4904_value_To_uint8_4_1 /end SUB_GROUP
 /begin REF_CHARACTERISTIC core_gp_xSwapBytes /end REF_CHARACTERISTIC
/end GROUP
/begin GROUP S4896_SDO_Reply "SC_KZQ_EV2274A_4_1/Main/GPS /SDO  0x7B/Case 0x6520h(25888)/ Case 0x6520-002/SDO Reply"
 /begin SUB_GROUP S4940_SDO_Error_Reply S4940_value_To_uint8_4_ S4940_value_To_uint8_4_1 /end SUB_GROUP
 /begin REF_CHARACTERISTIC core_gp_xSwapBytes /end REF_CHARACTERISTIC
/end GROUP
/begin GROUP S4897_SDO_Reply "SC_KZQ_EV2274A_4_1/Main/GPS /SDO  0x7B/Case 0x6520h(25888)/ Case 0x6520-003/SDO Reply"
 /begin SUB_GROUP S4976_SDO_Error_Reply S4976_value_To_uint8_4_ S4976_value_To_uint8_4_1 /end SUB_GROUP
 /begin REF_CHARACTERISTIC core_gp_xSwapBytes /end REF_CHARACTERISTIC
/end GROUP
/begin GROUP S4898_SDO_Reply "SC_KZQ_EV2274A_4_1/Main/GPS /SDO  0x7B/Case 0x6520h(25888)/ Case 0x6520-004/SDO Reply"
 /begin SUB_GROUP S5012_SDO_Error_Reply S5012_value_To_uint8_4_ S5012_value_To_uint8_4_1 /end SUB_GROUP
 /begin REF_CHARACTERISTIC core_gp_xSwapBytes /end REF_CHARACTERISTIC
/end GROUP
/begin GROUP S4899_SDO_Reply "SC_KZQ_EV2274A_4_1/Main/GPS /SDO  0x7B/Case 0x6520h(25888)/ Case 0x6520-005/SDO Reply"
 /begin SUB_GROUP S5048_SDO_Error_Reply S5048_value_To_uint8_4_ S5048_value_To_uint8_4_1 /end SUB_GROUP
 /begin REF_CHARACTERISTIC core_gp_xSwapBytes /end REF_CHARACTERISTIC
/end GROUP
/begin GROUP S4900_SDO_Reply "SC_KZQ_EV2274A_4_1/Main/GPS /SDO  0x7B/Case 0x6520h(25888)/ Case 0x6520-010/SDO Reply"
 /begin SUB_GROUP S5084_SDO_Error_Reply S5084_value_To_uint8_4_ S5084_value_To_uint8_4_1 /end SUB_GROUP
 /begin REF_CHARACTERISTIC core_gp_xSwapBytes /end REF_CHARACTERISTIC
/end GROUP
/begin GROUP S4901_SDO_Reply "SC_KZQ_EV2274A_4_1/Main/GPS /SDO  0x7B/Case 0x6520h(25888)/ Case 0x6520-011/SDO Reply"
 /begin SUB_GROUP S5121_SDO_Error_Reply S5121_value_To_uint8_4_ S5121_value_To_uint8_4_1 /end SUB_GROUP
 /begin REF_CHARACTERISTIC core_gp_xSwapBytes /end REF_CHARACTERISTIC
/end GROUP
/begin GROUP S1076_SDO_Error_Reply "SC_KZQ_EV2274A_4_1/Main/CAN SDO/SDO  0x7C/Case 0x6440h(25664)/ Case 0x6440-001/SDO Reply/SDO Error Reply"
 /begin REF_CHARACTERISTIC core_gcp_u8CanSDOCmd_ErrReply core_gcp_u8CanSDOCmd_ErrReply_MainIndexMismatch core_gcp_u8CanSDOCmd_ErrReply_SubIndexMismatch core_gcp_u8CanSDOCmd_ErrReply_WrongCommand /end REF_CHARACTERISTIC
/end GROUP
/begin GROUP S1076_value_To_uint8_4_ "SC_KZQ_EV2274A_4_1/Main/CAN SDO/SDO  0x7C/Case 0x6440h(25664)/ Case 0x6440-001/SDO Reply/value_To_uint8[4]" /begin REF_CHARACTERISTIC core_gp_xSwapBytes /end REF_CHARACTERISTIC /end GROUP
/begin GROUP S1076_value_To_uint8_4_1 "SC_KZQ_EV2274A_4_1/Main/CAN SDO/SDO  0x7C/Case 0x6440h(25664)/ Case 0x6440-001/SDO Reply/value_To_uint8[4]1" /begin REF_CHARACTERISTIC core_gp_xSwapBytes /end REF_CHARACTERISTIC /end GROUP
/begin GROUP S1112_SDO_Error_Reply "SC_KZQ_EV2274A_4_1/Main/CAN SDO/SDO  0x7C/Case 0x6440h(25664)/ Case 0x6440-002/SDO Reply/SDO Error Reply"
 /begin REF_CHARACTERISTIC core_gcp_u8CanSDOCmd_ErrReply core_gcp_u8CanSDOCmd_ErrReply_MainIndexMismatch core_gcp_u8CanSDOCmd_ErrReply_SubIndexMismatch core_gcp_u8CanSDOCmd_ErrReply_WrongCommand /end REF_CHARACTERISTIC
/end GROUP
/begin GROUP S1112_value_To_uint8_4_ "SC_KZQ_EV2274A_4_1/Main/CAN SDO/SDO  0x7C/Case 0x6440h(25664)/ Case 0x6440-002/SDO Reply/value_To_uint8[4]" /begin REF_CHARACTERISTIC core_gp_xSwapBytes /end REF_CHARACTERISTIC /end GROUP
/begin GROUP S1112_value_To_uint8_4_1 "SC_KZQ_EV2274A_4_1/Main/CAN SDO/SDO  0x7C/Case 0x6440h(25664)/ Case 0x6440-002/SDO Reply/value_To_uint8[4]1" /begin REF_CHARACTERISTIC core_gp_xSwapBytes /end REF_CHARACTERISTIC /end GROUP
/begin GROUP S1148_SDO_Error_Reply "SC_KZQ_EV2274A_4_1/Main/CAN SDO/SDO  0x7C/Case 0x6440h(25664)/ Case 0x6440-003/SDO Reply/SDO Error Reply"
 /begin REF_CHARACTERISTIC core_gcp_u8CanSDOCmd_ErrReply core_gcp_u8CanSDOCmd_ErrReply_MainIndexMismatch core_gcp_u8CanSDOCmd_ErrReply_SubIndexMismatch core_gcp_u8CanSDOCmd_ErrReply_WrongCommand /end REF_CHARACTERISTIC
/end GROUP
/begin GROUP S1148_value_To_uint8_4_ "SC_KZQ_EV2274A_4_1/Main/CAN SDO/SDO  0x7C/Case 0x6440h(25664)/ Case 0x6440-003/SDO Reply/value_To_uint8[4]" /begin REF_CHARACTERISTIC core_gp_xSwapBytes /end REF_CHARACTERISTIC /end GROUP
/begin GROUP S1148_value_To_uint8_4_1 "SC_KZQ_EV2274A_4_1/Main/CAN SDO/SDO  0x7C/Case 0x6440h(25664)/ Case 0x6440-003/SDO Reply/value_To_uint8[4]1" /begin REF_CHARACTERISTIC core_gp_xSwapBytes /end REF_CHARACTERISTIC /end GROUP
/begin GROUP S1184_SDO_Error_Reply "SC_KZQ_EV2274A_4_1/Main/CAN SDO/SDO  0x7C/Case 0x6440h(25664)/ Case 0x6440-004/SDO Reply/SDO Error Reply"
 /begin REF_CHARACTERISTIC core_gcp_u8CanSDOCmd_ErrReply core_gcp_u8CanSDOCmd_ErrReply_MainIndexMismatch core_gcp_u8CanSDOCmd_ErrReply_SubIndexMismatch core_gcp_u8CanSDOCmd_ErrReply_WrongCommand /end REF_CHARACTERISTIC
/end GROUP
/begin GROUP S1184_value_To_uint8_4_ "SC_KZQ_EV2274A_4_1/Main/CAN SDO/SDO  0x7C/Case 0x6440h(25664)/ Case 0x6440-004/SDO Reply/value_To_uint8[4]" /begin REF_CHARACTERISTIC core_gp_xSwapBytes /end REF_CHARACTERISTIC /end GROUP
/begin GROUP S1184_value_To_uint8_4_1 "SC_KZQ_EV2274A_4_1/Main/CAN SDO/SDO  0x7C/Case 0x6440h(25664)/ Case 0x6440-004/SDO Reply/value_To_uint8[4]1" /begin REF_CHARACTERISTIC core_gp_xSwapBytes /end REF_CHARACTERISTIC /end GROUP
/begin GROUP S1220_SDO_Error_Reply "SC_KZQ_EV2274A_4_1/Main/CAN SDO/SDO  0x7C/Case 0x6440h(25664)/ Case 0x6440-005/SDO Reply/SDO Error Reply"
 /begin REF_CHARACTERISTIC core_gcp_u8CanSDOCmd_ErrReply core_gcp_u8CanSDOCmd_ErrReply_MainIndexMismatch core_gcp_u8CanSDOCmd_ErrReply_SubIndexMismatch core_gcp_u8CanSDOCmd_ErrReply_WrongCommand /end REF_CHARACTERISTIC
/end GROUP
/begin GROUP S1220_value_To_uint8_4_ "SC_KZQ_EV2274A_4_1/Main/CAN SDO/SDO  0x7C/Case 0x6440h(25664)/ Case 0x6440-005/SDO Reply/value_To_uint8[4]" /begin REF_CHARACTERISTIC core_gp_xSwapBytes /end REF_CHARACTERISTIC /end GROUP
/begin GROUP S1220_value_To_uint8_4_1 "SC_KZQ_EV2274A_4_1/Main/CAN SDO/SDO  0x7C/Case 0x6440h(25664)/ Case 0x6440-005/SDO Reply/value_To_uint8[4]1" /begin REF_CHARACTERISTIC core_gp_xSwapBytes /end REF_CHARACTERISTIC /end GROUP
/begin GROUP S1256_SDO_Error_Reply "SC_KZQ_EV2274A_4_1/Main/CAN SDO/SDO  0x7C/Case 0x6440h(25664)/ Case 0x6440-006/SDO Reply/SDO Error Reply"
 /begin REF_CHARACTERISTIC core_gcp_u8CanSDOCmd_ErrReply core_gcp_u8CanSDOCmd_ErrReply_MainIndexMismatch core_gcp_u8CanSDOCmd_ErrReply_SubIndexMismatch core_gcp_u8CanSDOCmd_ErrReply_WrongCommand /end REF_CHARACTERISTIC
/end GROUP
/begin GROUP S1256_value_To_uint8_4_ "SC_KZQ_EV2274A_4_1/Main/CAN SDO/SDO  0x7C/Case 0x6440h(25664)/ Case 0x6440-006/SDO Reply/value_To_uint8[4]" /begin REF_CHARACTERISTIC core_gp_xSwapBytes /end REF_CHARACTERISTIC /end GROUP
/begin GROUP S1256_value_To_uint8_4_1 "SC_KZQ_EV2274A_4_1/Main/CAN SDO/SDO  0x7C/Case 0x6440h(25664)/ Case 0x6440-006/SDO Reply/value_To_uint8[4]1" /begin REF_CHARACTERISTIC core_gp_xSwapBytes /end REF_CHARACTERISTIC /end GROUP
/begin GROUP S1292_SDO_Error_Reply "SC_KZQ_EV2274A_4_1/Main/CAN SDO/SDO  0x7C/Case 0x6440h(25664)/ Case 0x6440-007/SDO Reply/SDO Error Reply"
 /begin REF_CHARACTERISTIC core_gcp_u8CanSDOCmd_ErrReply core_gcp_u8CanSDOCmd_ErrReply_MainIndexMismatch core_gcp_u8CanSDOCmd_ErrReply_SubIndexMismatch core_gcp_u8CanSDOCmd_ErrReply_WrongCommand /end REF_CHARACTERISTIC
/end GROUP
/begin GROUP S1292_value_To_uint8_4_ "SC_KZQ_EV2274A_4_1/Main/CAN SDO/SDO  0x7C/Case 0x6440h(25664)/ Case 0x6440-007/SDO Reply/value_To_uint8[4]" /begin REF_CHARACTERISTIC core_gp_xSwapBytes /end REF_CHARACTERISTIC /end GROUP
/begin GROUP S1292_value_To_uint8_4_1 "SC_KZQ_EV2274A_4_1/Main/CAN SDO/SDO  0x7C/Case 0x6440h(25664)/ Case 0x6440-007/SDO Reply/value_To_uint8[4]1" /begin REF_CHARACTERISTIC core_gp_xSwapBytes /end REF_CHARACTERISTIC /end GROUP
/begin GROUP S1328_SDO_Error_Reply "SC_KZQ_EV2274A_4_1/Main/CAN SDO/SDO  0x7C/Case 0x6440h(25664)/ Case 0x6440-008/SDO Reply/SDO Error Reply"
 /begin REF_CHARACTERISTIC core_gcp_u8CanSDOCmd_ErrReply core_gcp_u8CanSDOCmd_ErrReply_MainIndexMismatch core_gcp_u8CanSDOCmd_ErrReply_SubIndexMismatch core_gcp_u8CanSDOCmd_ErrReply_WrongCommand /end REF_CHARACTERISTIC
/end GROUP
/begin GROUP S1328_value_To_uint8_4_ "SC_KZQ_EV2274A_4_1/Main/CAN SDO/SDO  0x7C/Case 0x6440h(25664)/ Case 0x6440-008/SDO Reply/value_To_uint8[4]" /begin REF_CHARACTERISTIC core_gp_xSwapBytes /end REF_CHARACTERISTIC /end GROUP
/begin GROUP S1328_value_To_uint8_4_1 "SC_KZQ_EV2274A_4_1/Main/CAN SDO/SDO  0x7C/Case 0x6440h(25664)/ Case 0x6440-008/SDO Reply/value_To_uint8[4]1" /begin REF_CHARACTERISTIC core_gp_xSwapBytes /end REF_CHARACTERISTIC /end GROUP
/begin GROUP S1364_SDO_Error_Reply "SC_KZQ_EV2274A_4_1/Main/CAN SDO/SDO  0x7C/Case 0x6440h(25664)/ Case 0x6440-009/SDO Reply/SDO Error Reply"
 /begin REF_CHARACTERISTIC core_gcp_u8CanSDOCmd_ErrReply core_gcp_u8CanSDOCmd_ErrReply_MainIndexMismatch core_gcp_u8CanSDOCmd_ErrReply_SubIndexMismatch core_gcp_u8CanSDOCmd_ErrReply_WrongCommand /end REF_CHARACTERISTIC
/end GROUP
/begin GROUP S1364_value_To_uint8_4_ "SC_KZQ_EV2274A_4_1/Main/CAN SDO/SDO  0x7C/Case 0x6440h(25664)/ Case 0x6440-009/SDO Reply/value_To_uint8[4]" /begin REF_CHARACTERISTIC core_gp_xSwapBytes /end REF_CHARACTERISTIC /end GROUP
/begin GROUP S1364_value_To_uint8_4_1 "SC_KZQ_EV2274A_4_1/Main/CAN SDO/SDO  0x7C/Case 0x6440h(25664)/ Case 0x6440-009/SDO Reply/value_To_uint8[4]1" /begin REF_CHARACTERISTIC core_gp_xSwapBytes /end REF_CHARACTERISTIC /end GROUP
/begin GROUP S1400_SDO_Error_Reply "SC_KZQ_EV2274A_4_1/Main/CAN SDO/SDO  0x7C/Case 0x6440h(25664)/ Case 0x6440-010/SDO Reply/SDO Error Reply"
 /begin REF_CHARACTERISTIC core_gcp_u8CanSDOCmd_ErrReply core_gcp_u8CanSDOCmd_ErrReply_MainIndexMismatch core_gcp_u8CanSDOCmd_ErrReply_SubIndexMismatch core_gcp_u8CanSDOCmd_ErrReply_WrongCommand /end REF_CHARACTERISTIC
/end GROUP
/begin GROUP S1400_value_To_uint8_4_ "SC_KZQ_EV2274A_4_1/Main/CAN SDO/SDO  0x7C/Case 0x6440h(25664)/ Case 0x6440-010/SDO Reply/value_To_uint8[4]" /begin REF_CHARACTERISTIC core_gp_xSwapBytes /end REF_CHARACTERISTIC /end GROUP
/begin GROUP S1400_value_To_uint8_4_1 "SC_KZQ_EV2274A_4_1/Main/CAN SDO/SDO  0x7C/Case 0x6440h(25664)/ Case 0x6440-010/SDO Reply/value_To_uint8[4]1" /begin REF_CHARACTERISTIC core_gp_xSwapBytes /end REF_CHARACTERISTIC /end GROUP
/begin GROUP S1436_SDO_Error_Reply "SC_KZQ_EV2274A_4_1/Main/CAN SDO/SDO  0x7C/Case 0x6440h(25664)/ Case 0x6440-011/SDO Reply/SDO Error Reply"
 /begin REF_CHARACTERISTIC core_gcp_u8CanSDOCmd_ErrReply core_gcp_u8CanSDOCmd_ErrReply_MainIndexMismatch core_gcp_u8CanSDOCmd_ErrReply_SubIndexMismatch core_gcp_u8CanSDOCmd_ErrReply_WrongCommand /end REF_CHARACTERISTIC
/end GROUP
/begin GROUP S1436_value_To_uint8_4_ "SC_KZQ_EV2274A_4_1/Main/CAN SDO/SDO  0x7C/Case 0x6440h(25664)/ Case 0x6440-011/SDO Reply/value_To_uint8[4]" /begin REF_CHARACTERISTIC core_gp_xSwapBytes /end REF_CHARACTERISTIC /end GROUP
/begin GROUP S1436_value_To_uint8_4_1 "SC_KZQ_EV2274A_4_1/Main/CAN SDO/SDO  0x7C/Case 0x6440h(25664)/ Case 0x6440-011/SDO Reply/value_To_uint8[4]1" /begin REF_CHARACTERISTIC core_gp_xSwapBytes /end REF_CHARACTERISTIC /end GROUP
/begin GROUP S1472_SDO_Error_Reply "SC_KZQ_EV2274A_4_1/Main/CAN SDO/SDO  0x7C/Case 0x6440h(25664)/ Case 0x6440-012/SDO Reply/SDO Error Reply"
 /begin REF_CHARACTERISTIC core_gcp_u8CanSDOCmd_ErrReply core_gcp_u8CanSDOCmd_ErrReply_MainIndexMismatch core_gcp_u8CanSDOCmd_ErrReply_SubIndexMismatch core_gcp_u8CanSDOCmd_ErrReply_WrongCommand /end REF_CHARACTERISTIC
/end GROUP
/begin GROUP S1472_value_To_uint8_4_ "SC_KZQ_EV2274A_4_1/Main/CAN SDO/SDO  0x7C/Case 0x6440h(25664)/ Case 0x6440-012/SDO Reply/value_To_uint8[4]" /begin REF_CHARACTERISTIC core_gp_xSwapBytes /end REF_CHARACTERISTIC /end GROUP
/begin GROUP S1472_value_To_uint8_4_1 "SC_KZQ_EV2274A_4_1/Main/CAN SDO/SDO  0x7C/Case 0x6440h(25664)/ Case 0x6440-012/SDO Reply/value_To_uint8[4]1" /begin REF_CHARACTERISTIC core_gp_xSwapBytes /end REF_CHARACTERISTIC /end GROUP
/begin GROUP S1508_SDO_Error_Reply "SC_KZQ_EV2274A_4_1/Main/CAN SDO/SDO  0x7C/Case 0x6440h(25664)/ Case 0x6440-013/SDO Reply/SDO Error Reply"
 /begin REF_CHARACTERISTIC core_gcp_u8CanSDOCmd_ErrReply core_gcp_u8CanSDOCmd_ErrReply_MainIndexMismatch core_gcp_u8CanSDOCmd_ErrReply_SubIndexMismatch core_gcp_u8CanSDOCmd_ErrReply_WrongCommand /end REF_CHARACTERISTIC
/end GROUP
/begin GROUP S1508_value_To_uint8_4_ "SC_KZQ_EV2274A_4_1/Main/CAN SDO/SDO  0x7C/Case 0x6440h(25664)/ Case 0x6440-013/SDO Reply/value_To_uint8[4]" /begin REF_CHARACTERISTIC core_gp_xSwapBytes /end REF_CHARACTERISTIC /end GROUP
/begin GROUP S1508_value_To_uint8_4_1 "SC_KZQ_EV2274A_4_1/Main/CAN SDO/SDO  0x7C/Case 0x6440h(25664)/ Case 0x6440-013/SDO Reply/value_To_uint8[4]1" /begin REF_CHARACTERISTIC core_gp_xSwapBytes /end REF_CHARACTERISTIC /end GROUP
/begin GROUP S1544_SDO_Error_Reply "SC_KZQ_EV2274A_4_1/Main/CAN SDO/SDO  0x7C/Case 0x6440h(25664)/ Case 0x6440-014/SDO Reply/SDO Error Reply"
 /begin REF_CHARACTERISTIC core_gcp_u8CanSDOCmd_ErrReply core_gcp_u8CanSDOCmd_ErrReply_MainIndexMismatch core_gcp_u8CanSDOCmd_ErrReply_SubIndexMismatch core_gcp_u8CanSDOCmd_ErrReply_WrongCommand /end REF_CHARACTERISTIC
/end GROUP
/begin GROUP S1544_value_To_uint8_4_ "SC_KZQ_EV2274A_4_1/Main/CAN SDO/SDO  0x7C/Case 0x6440h(25664)/ Case 0x6440-014/SDO Reply/value_To_uint8[4]" /begin REF_CHARACTERISTIC core_gp_xSwapBytes /end REF_CHARACTERISTIC /end GROUP
/begin GROUP S1544_value_To_uint8_4_1 "SC_KZQ_EV2274A_4_1/Main/CAN SDO/SDO  0x7C/Case 0x6440h(25664)/ Case 0x6440-014/SDO Reply/value_To_uint8[4]1" /begin REF_CHARACTERISTIC core_gp_xSwapBytes /end REF_CHARACTERISTIC /end GROUP
/begin GROUP S1580_SDO_Error_Reply "SC_KZQ_EV2274A_4_1/Main/CAN SDO/SDO  0x7C/Case 0x6440h(25664)/ Case 0x6440-015/SDO Reply/SDO Error Reply"
 /begin REF_CHARACTERISTIC core_gcp_u8CanSDOCmd_ErrReply core_gcp_u8CanSDOCmd_ErrReply_MainIndexMismatch core_gcp_u8CanSDOCmd_ErrReply_SubIndexMismatch core_gcp_u8CanSDOCmd_ErrReply_WrongCommand /end REF_CHARACTERISTIC
/end GROUP
/begin GROUP S1580_value_To_uint8_4_ "SC_KZQ_EV2274A_4_1/Main/CAN SDO/SDO  0x7C/Case 0x6440h(25664)/ Case 0x6440-015/SDO Reply/value_To_uint8[4]" /begin REF_CHARACTERISTIC core_gp_xSwapBytes /end REF_CHARACTERISTIC /end GROUP
/begin GROUP S1580_value_To_uint8_4_1 "SC_KZQ_EV2274A_4_1/Main/CAN SDO/SDO  0x7C/Case 0x6440h(25664)/ Case 0x6440-015/SDO Reply/value_To_uint8[4]1" /begin REF_CHARACTERISTIC core_gp_xSwapBytes /end REF_CHARACTERISTIC /end GROUP
/begin GROUP S1616_SDO_Error_Reply "SC_KZQ_EV2274A_4_1/Main/CAN SDO/SDO  0x7C/Case 0x6440h(25664)/ Case 0x6440-016/SDO Reply/SDO Error Reply"
 /begin REF_CHARACTERISTIC core_gcp_u8CanSDOCmd_ErrReply core_gcp_u8CanSDOCmd_ErrReply_MainIndexMismatch core_gcp_u8CanSDOCmd_ErrReply_SubIndexMismatch core_gcp_u8CanSDOCmd_ErrReply_WrongCommand /end REF_CHARACTERISTIC
/end GROUP
/begin GROUP S1616_value_To_uint8_4_ "SC_KZQ_EV2274A_4_1/Main/CAN SDO/SDO  0x7C/Case 0x6440h(25664)/ Case 0x6440-016/SDO Reply/value_To_uint8[4]" /begin REF_CHARACTERISTIC core_gp_xSwapBytes /end REF_CHARACTERISTIC /end GROUP
/begin GROUP S1616_value_To_uint8_4_1 "SC_KZQ_EV2274A_4_1/Main/CAN SDO/SDO  0x7C/Case 0x6440h(25664)/ Case 0x6440-016/SDO Reply/value_To_uint8[4]1" /begin REF_CHARACTERISTIC core_gp_xSwapBytes /end REF_CHARACTERISTIC /end GROUP
/begin GROUP S1690_SDO_Error_Reply "SC_KZQ_EV2274A_4_1/Main/CAN SDO/SDO  0x7C/Case 0x6443h/ Case 0x6443-001/SDO Reply/SDO Error Reply"
 /begin REF_CHARACTERISTIC core_gcp_u8CanSDOCmd_ErrReply core_gcp_u8CanSDOCmd_ErrReply_MainIndexMismatch core_gcp_u8CanSDOCmd_ErrReply_SubIndexMismatch core_gcp_u8CanSDOCmd_ErrReply_WrongCommand /end REF_CHARACTERISTIC
/end GROUP
/begin GROUP S1690_value_To_uint8_4_ "SC_KZQ_EV2274A_4_1/Main/CAN SDO/SDO  0x7C/Case 0x6443h/ Case 0x6443-001/SDO Reply/value_To_uint8[4]" /begin REF_CHARACTERISTIC core_gp_xSwapBytes /end REF_CHARACTERISTIC /end GROUP
/begin GROUP S1690_value_To_uint8_4_1 "SC_KZQ_EV2274A_4_1/Main/CAN SDO/SDO  0x7C/Case 0x6443h/ Case 0x6443-001/SDO Reply/value_To_uint8[4]1" /begin REF_CHARACTERISTIC core_gp_xSwapBytes /end REF_CHARACTERISTIC /end GROUP
/begin GROUP S1726_SDO_Error_Reply "SC_KZQ_EV2274A_4_1/Main/CAN SDO/SDO  0x7C/Case 0x6443h/ Case 0x6443-002/SDO Reply/SDO Error Reply"
 /begin REF_CHARACTERISTIC core_gcp_u8CanSDOCmd_ErrReply core_gcp_u8CanSDOCmd_ErrReply_MainIndexMismatch core_gcp_u8CanSDOCmd_ErrReply_SubIndexMismatch core_gcp_u8CanSDOCmd_ErrReply_WrongCommand /end REF_CHARACTERISTIC
/end GROUP
/begin GROUP S1726_value_To_uint8_4_ "SC_KZQ_EV2274A_4_1/Main/CAN SDO/SDO  0x7C/Case 0x6443h/ Case 0x6443-002/SDO Reply/value_To_uint8[4]" /begin REF_CHARACTERISTIC core_gp_xSwapBytes /end REF_CHARACTERISTIC /end GROUP
/begin GROUP S1726_value_To_uint8_4_1 "SC_KZQ_EV2274A_4_1/Main/CAN SDO/SDO  0x7C/Case 0x6443h/ Case 0x6443-002/SDO Reply/value_To_uint8[4]1" /begin REF_CHARACTERISTIC core_gp_xSwapBytes /end REF_CHARACTERISTIC /end GROUP
/begin GROUP S1762_SDO_Error_Reply "SC_KZQ_EV2274A_4_1/Main/CAN SDO/SDO  0x7C/Case 0x6443h/ Case 0x6443-003/SDO Reply/SDO Error Reply"
 /begin REF_CHARACTERISTIC core_gcp_u8CanSDOCmd_ErrReply core_gcp_u8CanSDOCmd_ErrReply_MainIndexMismatch core_gcp_u8CanSDOCmd_ErrReply_SubIndexMismatch core_gcp_u8CanSDOCmd_ErrReply_WrongCommand /end REF_CHARACTERISTIC
/end GROUP
/begin GROUP S1762_value_To_uint8_4_ "SC_KZQ_EV2274A_4_1/Main/CAN SDO/SDO  0x7C/Case 0x6443h/ Case 0x6443-003/SDO Reply/value_To_uint8[4]" /begin REF_CHARACTERISTIC core_gp_xSwapBytes /end REF_CHARACTERISTIC /end GROUP
/begin GROUP S1762_value_To_uint8_4_1 "SC_KZQ_EV2274A_4_1/Main/CAN SDO/SDO  0x7C/Case 0x6443h/ Case 0x6443-003/SDO Reply/value_To_uint8[4]1" /begin REF_CHARACTERISTIC core_gp_xSwapBytes /end REF_CHARACTERISTIC /end GROUP
/begin GROUP S1798_SDO_Error_Reply "SC_KZQ_EV2274A_4_1/Main/CAN SDO/SDO  0x7C/Case 0x6443h/ Case 0x6443-004/SDO Reply/SDO Error Reply"
 /begin REF_CHARACTERISTIC core_gcp_u8CanSDOCmd_ErrReply core_gcp_u8CanSDOCmd_ErrReply_MainIndexMismatch core_gcp_u8CanSDOCmd_ErrReply_SubIndexMismatch core_gcp_u8CanSDOCmd_ErrReply_WrongCommand /end REF_CHARACTERISTIC
/end GROUP
/begin GROUP S1798_value_To_uint8_4_ "SC_KZQ_EV2274A_4_1/Main/CAN SDO/SDO  0x7C/Case 0x6443h/ Case 0x6443-004/SDO Reply/value_To_uint8[4]" /begin REF_CHARACTERISTIC core_gp_xSwapBytes /end REF_CHARACTERISTIC /end GROUP
/begin GROUP S1798_value_To_uint8_4_1 "SC_KZQ_EV2274A_4_1/Main/CAN SDO/SDO  0x7C/Case 0x6443h/ Case 0x6443-004/SDO Reply/value_To_uint8[4]1" /begin REF_CHARACTERISTIC core_gp_xSwapBytes /end REF_CHARACTERISTIC /end GROUP
/begin GROUP S1834_SDO_Error_Reply "SC_KZQ_EV2274A_4_1/Main/CAN SDO/SDO  0x7C/Case 0x6443h/ Case 0x6443-005/SDO Reply/SDO Error Reply"
 /begin REF_CHARACTERISTIC core_gcp_u8CanSDOCmd_ErrReply core_gcp_u8CanSDOCmd_ErrReply_MainIndexMismatch core_gcp_u8CanSDOCmd_ErrReply_SubIndexMismatch core_gcp_u8CanSDOCmd_ErrReply_WrongCommand /end REF_CHARACTERISTIC
/end GROUP
/begin GROUP S1834_value_To_uint8_4_ "SC_KZQ_EV2274A_4_1/Main/CAN SDO/SDO  0x7C/Case 0x6443h/ Case 0x6443-005/SDO Reply/value_To_uint8[4]" /begin REF_CHARACTERISTIC core_gp_xSwapBytes /end REF_CHARACTERISTIC /end GROUP
/begin GROUP S1834_value_To_uint8_4_1 "SC_KZQ_EV2274A_4_1/Main/CAN SDO/SDO  0x7C/Case 0x6443h/ Case 0x6443-005/SDO Reply/value_To_uint8[4]1" /begin REF_CHARACTERISTIC core_gp_xSwapBytes /end REF_CHARACTERISTIC /end GROUP
/begin GROUP S1870_SDO_Error_Reply "SC_KZQ_EV2274A_4_1/Main/CAN SDO/SDO  0x7C/Case 0x6443h/ Case 0x6443-006/SDO Reply/SDO Error Reply"
 /begin REF_CHARACTERISTIC core_gcp_u8CanSDOCmd_ErrReply core_gcp_u8CanSDOCmd_ErrReply_MainIndexMismatch core_gcp_u8CanSDOCmd_ErrReply_SubIndexMismatch core_gcp_u8CanSDOCmd_ErrReply_WrongCommand /end REF_CHARACTERISTIC
/end GROUP
/begin GROUP S1870_value_To_uint8_4_ "SC_KZQ_EV2274A_4_1/Main/CAN SDO/SDO  0x7C/Case 0x6443h/ Case 0x6443-006/SDO Reply/value_To_uint8[4]" /begin REF_CHARACTERISTIC core_gp_xSwapBytes /end REF_CHARACTERISTIC /end GROUP
/begin GROUP S1870_value_To_uint8_4_1 "SC_KZQ_EV2274A_4_1/Main/CAN SDO/SDO  0x7C/Case 0x6443h/ Case 0x6443-006/SDO Reply/value_To_uint8[4]1" /begin REF_CHARACTERISTIC core_gp_xSwapBytes /end REF_CHARACTERISTIC /end GROUP
/begin GROUP S1906_SDO_Error_Reply "SC_KZQ_EV2274A_4_1/Main/CAN SDO/SDO  0x7C/Case 0x6443h/ Case 0x6443-007/SDO Reply/SDO Error Reply"
 /begin REF_CHARACTERISTIC core_gcp_u8CanSDOCmd_ErrReply core_gcp_u8CanSDOCmd_ErrReply_MainIndexMismatch core_gcp_u8CanSDOCmd_ErrReply_SubIndexMismatch core_gcp_u8CanSDOCmd_ErrReply_WrongCommand /end REF_CHARACTERISTIC
/end GROUP
/begin GROUP S1906_value_To_uint8_4_ "SC_KZQ_EV2274A_4_1/Main/CAN SDO/SDO  0x7C/Case 0x6443h/ Case 0x6443-007/SDO Reply/value_To_uint8[4]" /begin REF_CHARACTERISTIC core_gp_xSwapBytes /end REF_CHARACTERISTIC /end GROUP
/begin GROUP S1906_value_To_uint8_4_1 "SC_KZQ_EV2274A_4_1/Main/CAN SDO/SDO  0x7C/Case 0x6443h/ Case 0x6443-007/SDO Reply/value_To_uint8[4]1" /begin REF_CHARACTERISTIC core_gp_xSwapBytes /end REF_CHARACTERISTIC /end GROUP
/begin GROUP S1942_SDO_Error_Reply "SC_KZQ_EV2274A_4_1/Main/CAN SDO/SDO  0x7C/Case 0x6443h/ Case 0x6443-008/SDO Reply/SDO Error Reply"
 /begin REF_CHARACTERISTIC core_gcp_u8CanSDOCmd_ErrReply core_gcp_u8CanSDOCmd_ErrReply_MainIndexMismatch core_gcp_u8CanSDOCmd_ErrReply_SubIndexMismatch core_gcp_u8CanSDOCmd_ErrReply_WrongCommand /end REF_CHARACTERISTIC
/end GROUP
/begin GROUP S1942_value_To_uint8_4_ "SC_KZQ_EV2274A_4_1/Main/CAN SDO/SDO  0x7C/Case 0x6443h/ Case 0x6443-008/SDO Reply/value_To_uint8[4]" /begin REF_CHARACTERISTIC core_gp_xSwapBytes /end REF_CHARACTERISTIC /end GROUP
/begin GROUP S1942_value_To_uint8_4_1 "SC_KZQ_EV2274A_4_1/Main/CAN SDO/SDO  0x7C/Case 0x6443h/ Case 0x6443-008/SDO Reply/value_To_uint8[4]1" /begin REF_CHARACTERISTIC core_gp_xSwapBytes /end REF_CHARACTERISTIC /end GROUP
/begin GROUP S1978_SDO_Error_Reply "SC_KZQ_EV2274A_4_1/Main/CAN SDO/SDO  0x7C/Case 0x6443h/ Case 0x6443-009/SDO Reply/SDO Error Reply"
 /begin REF_CHARACTERISTIC core_gcp_u8CanSDOCmd_ErrReply core_gcp_u8CanSDOCmd_ErrReply_MainIndexMismatch core_gcp_u8CanSDOCmd_ErrReply_SubIndexMismatch core_gcp_u8CanSDOCmd_ErrReply_WrongCommand /end REF_CHARACTERISTIC
/end GROUP
/begin GROUP S1978_value_To_uint8_4_ "SC_KZQ_EV2274A_4_1/Main/CAN SDO/SDO  0x7C/Case 0x6443h/ Case 0x6443-009/SDO Reply/value_To_uint8[4]" /begin REF_CHARACTERISTIC core_gp_xSwapBytes /end REF_CHARACTERISTIC /end GROUP
/begin GROUP S1978_value_To_uint8_4_1 "SC_KZQ_EV2274A_4_1/Main/CAN SDO/SDO  0x7C/Case 0x6443h/ Case 0x6443-009/SDO Reply/value_To_uint8[4]1" /begin REF_CHARACTERISTIC core_gp_xSwapBytes /end REF_CHARACTERISTIC /end GROUP
/begin GROUP S2014_SDO_Error_Reply "SC_KZQ_EV2274A_4_1/Main/CAN SDO/SDO  0x7C/Case 0x6443h/ Case 0x6443-010/SDO Reply/SDO Error Reply"
 /begin REF_CHARACTERISTIC core_gcp_u8CanSDOCmd_ErrReply core_gcp_u8CanSDOCmd_ErrReply_MainIndexMismatch core_gcp_u8CanSDOCmd_ErrReply_SubIndexMismatch core_gcp_u8CanSDOCmd_ErrReply_WrongCommand /end REF_CHARACTERISTIC
/end GROUP
/begin GROUP S2014_value_To_uint8_4_ "SC_KZQ_EV2274A_4_1/Main/CAN SDO/SDO  0x7C/Case 0x6443h/ Case 0x6443-010/SDO Reply/value_To_uint8[4]" /begin REF_CHARACTERISTIC core_gp_xSwapBytes /end REF_CHARACTERISTIC /end GROUP
/begin GROUP S2014_value_To_uint8_4_1 "SC_KZQ_EV2274A_4_1/Main/CAN SDO/SDO  0x7C/Case 0x6443h/ Case 0x6443-010/SDO Reply/value_To_uint8[4]1" /begin REF_CHARACTERISTIC core_gp_xSwapBytes /end REF_CHARACTERISTIC /end GROUP
/begin GROUP S2050_SDO_Error_Reply "SC_KZQ_EV2274A_4_1/Main/CAN SDO/SDO  0x7C/Case 0x6443h/ Case 0x6443-011/SDO Reply/SDO Error Reply"
 /begin REF_CHARACTERISTIC core_gcp_u8CanSDOCmd_ErrReply core_gcp_u8CanSDOCmd_ErrReply_MainIndexMismatch core_gcp_u8CanSDOCmd_ErrReply_SubIndexMismatch core_gcp_u8CanSDOCmd_ErrReply_WrongCommand /end REF_CHARACTERISTIC
/end GROUP
/begin GROUP S2050_value_To_uint8_4_ "SC_KZQ_EV2274A_4_1/Main/CAN SDO/SDO  0x7C/Case 0x6443h/ Case 0x6443-011/SDO Reply/value_To_uint8[4]" /begin REF_CHARACTERISTIC core_gp_xSwapBytes /end REF_CHARACTERISTIC /end GROUP
/begin GROUP S2050_value_To_uint8_4_1 "SC_KZQ_EV2274A_4_1/Main/CAN SDO/SDO  0x7C/Case 0x6443h/ Case 0x6443-011/SDO Reply/value_To_uint8[4]1" /begin REF_CHARACTERISTIC core_gp_xSwapBytes /end REF_CHARACTERISTIC /end GROUP
/begin GROUP S2086_SDO_Error_Reply "SC_KZQ_EV2274A_4_1/Main/CAN SDO/SDO  0x7C/Case 0x6443h/ Case 0x6443-012/SDO Reply/SDO Error Reply"
 /begin REF_CHARACTERISTIC core_gcp_u8CanSDOCmd_ErrReply core_gcp_u8CanSDOCmd_ErrReply_MainIndexMismatch core_gcp_u8CanSDOCmd_ErrReply_SubIndexMismatch core_gcp_u8CanSDOCmd_ErrReply_WrongCommand /end REF_CHARACTERISTIC
/end GROUP
/begin GROUP S2086_value_To_uint8_4_ "SC_KZQ_EV2274A_4_1/Main/CAN SDO/SDO  0x7C/Case 0x6443h/ Case 0x6443-012/SDO Reply/value_To_uint8[4]" /begin REF_CHARACTERISTIC core_gp_xSwapBytes /end REF_CHARACTERISTIC /end GROUP
/begin GROUP S2086_value_To_uint8_4_1 "SC_KZQ_EV2274A_4_1/Main/CAN SDO/SDO  0x7C/Case 0x6443h/ Case 0x6443-012/SDO Reply/value_To_uint8[4]1" /begin REF_CHARACTERISTIC core_gp_xSwapBytes /end REF_CHARACTERISTIC /end GROUP
/begin GROUP S2122_SDO_Error_Reply "SC_KZQ_EV2274A_4_1/Main/CAN SDO/SDO  0x7C/Case 0x6443h/ Case 0x6443-013/SDO Reply/SDO Error Reply"
 /begin REF_CHARACTERISTIC core_gcp_u8CanSDOCmd_ErrReply core_gcp_u8CanSDOCmd_ErrReply_MainIndexMismatch core_gcp_u8CanSDOCmd_ErrReply_SubIndexMismatch core_gcp_u8CanSDOCmd_ErrReply_WrongCommand /end REF_CHARACTERISTIC
/end GROUP
/begin GROUP S2122_value_To_uint8_4_ "SC_KZQ_EV2274A_4_1/Main/CAN SDO/SDO  0x7C/Case 0x6443h/ Case 0x6443-013/SDO Reply/value_To_uint8[4]" /begin REF_CHARACTERISTIC core_gp_xSwapBytes /end REF_CHARACTERISTIC /end GROUP
/begin GROUP S2122_value_To_uint8_4_1 "SC_KZQ_EV2274A_4_1/Main/CAN SDO/SDO  0x7C/Case 0x6443h/ Case 0x6443-013/SDO Reply/value_To_uint8[4]1" /begin REF_CHARACTERISTIC core_gp_xSwapBytes /end REF_CHARACTERISTIC /end GROUP
/begin GROUP S2158_SDO_Error_Reply "SC_KZQ_EV2274A_4_1/Main/CAN SDO/SDO  0x7C/Case 0x6443h/ Case 0x6443-014/SDO Reply/SDO Error Reply"
 /begin REF_CHARACTERISTIC core_gcp_u8CanSDOCmd_ErrReply core_gcp_u8CanSDOCmd_ErrReply_MainIndexMismatch core_gcp_u8CanSDOCmd_ErrReply_SubIndexMismatch core_gcp_u8CanSDOCmd_ErrReply_WrongCommand /end REF_CHARACTERISTIC
/end GROUP
/begin GROUP S2158_value_To_uint8_4_ "SC_KZQ_EV2274A_4_1/Main/CAN SDO/SDO  0x7C/Case 0x6443h/ Case 0x6443-014/SDO Reply/value_To_uint8[4]" /begin REF_CHARACTERISTIC core_gp_xSwapBytes /end REF_CHARACTERISTIC /end GROUP
/begin GROUP S2158_value_To_uint8_4_1 "SC_KZQ_EV2274A_4_1/Main/CAN SDO/SDO  0x7C/Case 0x6443h/ Case 0x6443-014/SDO Reply/value_To_uint8[4]1" /begin REF_CHARACTERISTIC core_gp_xSwapBytes /end REF_CHARACTERISTIC /end GROUP
/begin GROUP S2194_SDO_Error_Reply "SC_KZQ_EV2274A_4_1/Main/CAN SDO/SDO  0x7C/Case 0x6443h/ Case 0x6443-015/SDO Reply/SDO Error Reply"
 /begin REF_CHARACTERISTIC core_gcp_u8CanSDOCmd_ErrReply core_gcp_u8CanSDOCmd_ErrReply_MainIndexMismatch core_gcp_u8CanSDOCmd_ErrReply_SubIndexMismatch core_gcp_u8CanSDOCmd_ErrReply_WrongCommand /end REF_CHARACTERISTIC
/end GROUP
/begin GROUP S2194_value_To_uint8_4_ "SC_KZQ_EV2274A_4_1/Main/CAN SDO/SDO  0x7C/Case 0x6443h/ Case 0x6443-015/SDO Reply/value_To_uint8[4]" /begin REF_CHARACTERISTIC core_gp_xSwapBytes /end REF_CHARACTERISTIC /end GROUP
/begin GROUP S2194_value_To_uint8_4_1 "SC_KZQ_EV2274A_4_1/Main/CAN SDO/SDO  0x7C/Case 0x6443h/ Case 0x6443-015/SDO Reply/value_To_uint8[4]1" /begin REF_CHARACTERISTIC core_gp_xSwapBytes /end REF_CHARACTERISTIC /end GROUP
/begin GROUP S2230_SDO_Error_Reply "SC_KZQ_EV2274A_4_1/Main/CAN SDO/SDO  0x7C/Case 0x6443h/ Case 0x6443-016/SDO Reply/SDO Error Reply"
 /begin REF_CHARACTERISTIC core_gcp_u8CanSDOCmd_ErrReply core_gcp_u8CanSDOCmd_ErrReply_MainIndexMismatch core_gcp_u8CanSDOCmd_ErrReply_SubIndexMismatch core_gcp_u8CanSDOCmd_ErrReply_WrongCommand /end REF_CHARACTERISTIC
/end GROUP
/begin GROUP S2230_value_To_uint8_4_ "SC_KZQ_EV2274A_4_1/Main/CAN SDO/SDO  0x7C/Case 0x6443h/ Case 0x6443-016/SDO Reply/value_To_uint8[4]" /begin REF_CHARACTERISTIC core_gp_xSwapBytes /end REF_CHARACTERISTIC /end GROUP
/begin GROUP S2230_value_To_uint8_4_1 "SC_KZQ_EV2274A_4_1/Main/CAN SDO/SDO  0x7C/Case 0x6443h/ Case 0x6443-016/SDO Reply/value_To_uint8[4]1" /begin REF_CHARACTERISTIC core_gp_xSwapBytes /end REF_CHARACTERISTIC /end GROUP
/begin GROUP S2266_SDO_Error_Reply "SC_KZQ_EV2274A_4_1/Main/CAN SDO/SDO  0x7C/Case 0x6443h/ Case 0x6443-017/SDO Reply/SDO Error Reply"
 /begin REF_CHARACTERISTIC core_gcp_u8CanSDOCmd_ErrReply core_gcp_u8CanSDOCmd_ErrReply_MainIndexMismatch core_gcp_u8CanSDOCmd_ErrReply_SubIndexMismatch core_gcp_u8CanSDOCmd_ErrReply_WrongCommand /end REF_CHARACTERISTIC
/end GROUP
/begin GROUP S2266_value_To_uint8_4_ "SC_KZQ_EV2274A_4_1/Main/CAN SDO/SDO  0x7C/Case 0x6443h/ Case 0x6443-017/SDO Reply/value_To_uint8[4]" /begin REF_CHARACTERISTIC core_gp_xSwapBytes /end REF_CHARACTERISTIC /end GROUP
/begin GROUP S2266_value_To_uint8_4_1 "SC_KZQ_EV2274A_4_1/Main/CAN SDO/SDO  0x7C/Case 0x6443h/ Case 0x6443-017/SDO Reply/value_To_uint8[4]1" /begin REF_CHARACTERISTIC core_gp_xSwapBytes /end REF_CHARACTERISTIC /end GROUP
/begin GROUP S2302_SDO_Error_Reply "SC_KZQ_EV2274A_4_1/Main/CAN SDO/SDO  0x7C/Case 0x6443h/ Case 0x6443-018/SDO Reply/SDO Error Reply"
 /begin REF_CHARACTERISTIC core_gcp_u8CanSDOCmd_ErrReply core_gcp_u8CanSDOCmd_ErrReply_MainIndexMismatch core_gcp_u8CanSDOCmd_ErrReply_SubIndexMismatch core_gcp_u8CanSDOCmd_ErrReply_WrongCommand /end REF_CHARACTERISTIC
/end GROUP
/begin GROUP S2302_value_To_uint8_4_ "SC_KZQ_EV2274A_4_1/Main/CAN SDO/SDO  0x7C/Case 0x6443h/ Case 0x6443-018/SDO Reply/value_To_uint8[4]" /begin REF_CHARACTERISTIC core_gp_xSwapBytes /end REF_CHARACTERISTIC /end GROUP
/begin GROUP S2302_value_To_uint8_4_1 "SC_KZQ_EV2274A_4_1/Main/CAN SDO/SDO  0x7C/Case 0x6443h/ Case 0x6443-018/SDO Reply/value_To_uint8[4]1" /begin REF_CHARACTERISTIC core_gp_xSwapBytes /end REF_CHARACTERISTIC /end GROUP
/begin GROUP S2338_SDO_Error_Reply "SC_KZQ_EV2274A_4_1/Main/CAN SDO/SDO  0x7C/Case 0x6443h/ Case 0x6443-019/SDO Reply/SDO Error Reply"
 /begin REF_CHARACTERISTIC core_gcp_u8CanSDOCmd_ErrReply core_gcp_u8CanSDOCmd_ErrReply_MainIndexMismatch core_gcp_u8CanSDOCmd_ErrReply_SubIndexMismatch core_gcp_u8CanSDOCmd_ErrReply_WrongCommand /end REF_CHARACTERISTIC
/end GROUP
/begin GROUP S2338_value_To_uint8_4_ "SC_KZQ_EV2274A_4_1/Main/CAN SDO/SDO  0x7C/Case 0x6443h/ Case 0x6443-019/SDO Reply/value_To_uint8[4]" /begin REF_CHARACTERISTIC core_gp_xSwapBytes /end REF_CHARACTERISTIC /end GROUP
/begin GROUP S2338_value_To_uint8_4_1 "SC_KZQ_EV2274A_4_1/Main/CAN SDO/SDO  0x7C/Case 0x6443h/ Case 0x6443-019/SDO Reply/value_To_uint8[4]1" /begin REF_CHARACTERISTIC core_gp_xSwapBytes /end REF_CHARACTERISTIC /end GROUP
/begin GROUP S2374_SDO_Error_Reply "SC_KZQ_EV2274A_4_1/Main/CAN SDO/SDO  0x7C/Case 0x6443h/ Case 0x6443-020/SDO Reply/SDO Error Reply"
 /begin REF_CHARACTERISTIC core_gcp_u8CanSDOCmd_ErrReply core_gcp_u8CanSDOCmd_ErrReply_MainIndexMismatch core_gcp_u8CanSDOCmd_ErrReply_SubIndexMismatch core_gcp_u8CanSDOCmd_ErrReply_WrongCommand /end REF_CHARACTERISTIC
/end GROUP
/begin GROUP S2374_value_To_uint8_4_ "SC_KZQ_EV2274A_4_1/Main/CAN SDO/SDO  0x7C/Case 0x6443h/ Case 0x6443-020/SDO Reply/value_To_uint8[4]" /begin REF_CHARACTERISTIC core_gp_xSwapBytes /end REF_CHARACTERISTIC /end GROUP
/begin GROUP S2374_value_To_uint8_4_1 "SC_KZQ_EV2274A_4_1/Main/CAN SDO/SDO  0x7C/Case 0x6443h/ Case 0x6443-020/SDO Reply/value_To_uint8[4]1" /begin REF_CHARACTERISTIC core_gp_xSwapBytes /end REF_CHARACTERISTIC /end GROUP
/begin GROUP S2410_SDO_Error_Reply "SC_KZQ_EV2274A_4_1/Main/CAN SDO/SDO  0x7C/Case 0x6443h/ Case 0x6443-021/SDO Reply/SDO Error Reply"
 /begin REF_CHARACTERISTIC core_gcp_u8CanSDOCmd_ErrReply core_gcp_u8CanSDOCmd_ErrReply_MainIndexMismatch core_gcp_u8CanSDOCmd_ErrReply_SubIndexMismatch core_gcp_u8CanSDOCmd_ErrReply_WrongCommand /end REF_CHARACTERISTIC
/end GROUP
/begin GROUP S2410_value_To_uint8_4_ "SC_KZQ_EV2274A_4_1/Main/CAN SDO/SDO  0x7C/Case 0x6443h/ Case 0x6443-021/SDO Reply/value_To_uint8[4]" /begin REF_CHARACTERISTIC core_gp_xSwapBytes /end REF_CHARACTERISTIC /end GROUP
/begin GROUP S2410_value_To_uint8_4_1 "SC_KZQ_EV2274A_4_1/Main/CAN SDO/SDO  0x7C/Case 0x6443h/ Case 0x6443-021/SDO Reply/value_To_uint8[4]1" /begin REF_CHARACTERISTIC core_gp_xSwapBytes /end REF_CHARACTERISTIC /end GROUP
/begin GROUP S2446_SDO_Error_Reply "SC_KZQ_EV2274A_4_1/Main/CAN SDO/SDO  0x7C/Case 0x6443h/ Case 0x6443-022/SDO Reply/SDO Error Reply"
 /begin REF_CHARACTERISTIC core_gcp_u8CanSDOCmd_ErrReply core_gcp_u8CanSDOCmd_ErrReply_MainIndexMismatch core_gcp_u8CanSDOCmd_ErrReply_SubIndexMismatch core_gcp_u8CanSDOCmd_ErrReply_WrongCommand /end REF_CHARACTERISTIC
/end GROUP
/begin GROUP S2446_value_To_uint8_4_ "SC_KZQ_EV2274A_4_1/Main/CAN SDO/SDO  0x7C/Case 0x6443h/ Case 0x6443-022/SDO Reply/value_To_uint8[4]" /begin REF_CHARACTERISTIC core_gp_xSwapBytes /end REF_CHARACTERISTIC /end GROUP
/begin GROUP S2446_value_To_uint8_4_1 "SC_KZQ_EV2274A_4_1/Main/CAN SDO/SDO  0x7C/Case 0x6443h/ Case 0x6443-022/SDO Reply/value_To_uint8[4]1" /begin REF_CHARACTERISTIC core_gp_xSwapBytes /end REF_CHARACTERISTIC /end GROUP
/begin GROUP S2482_SDO_Error_Reply "SC_KZQ_EV2274A_4_1/Main/CAN SDO/SDO  0x7C/Case 0x6443h/ Case 0x6443-023/SDO Reply/SDO Error Reply"
 /begin REF_CHARACTERISTIC core_gcp_u8CanSDOCmd_ErrReply core_gcp_u8CanSDOCmd_ErrReply_MainIndexMismatch core_gcp_u8CanSDOCmd_ErrReply_SubIndexMismatch core_gcp_u8CanSDOCmd_ErrReply_WrongCommand /end REF_CHARACTERISTIC
/end GROUP
/begin GROUP S2482_value_To_uint8_4_ "SC_KZQ_EV2274A_4_1/Main/CAN SDO/SDO  0x7C/Case 0x6443h/ Case 0x6443-023/SDO Reply/value_To_uint8[4]" /begin REF_CHARACTERISTIC core_gp_xSwapBytes /end REF_CHARACTERISTIC /end GROUP
/begin GROUP S2482_value_To_uint8_4_1 "SC_KZQ_EV2274A_4_1/Main/CAN SDO/SDO  0x7C/Case 0x6443h/ Case 0x6443-023/SDO Reply/value_To_uint8[4]1" /begin REF_CHARACTERISTIC core_gp_xSwapBytes /end REF_CHARACTERISTIC /end GROUP
/begin GROUP S2518_SDO_Error_Reply "SC_KZQ_EV2274A_4_1/Main/CAN SDO/SDO  0x7C/Case 0x6443h/ Case 0x6443-024/SDO Reply/SDO Error Reply"
 /begin REF_CHARACTERISTIC core_gcp_u8CanSDOCmd_ErrReply core_gcp_u8CanSDOCmd_ErrReply_MainIndexMismatch core_gcp_u8CanSDOCmd_ErrReply_SubIndexMismatch core_gcp_u8CanSDOCmd_ErrReply_WrongCommand /end REF_CHARACTERISTIC
/end GROUP
/begin GROUP S2518_value_To_uint8_4_ "SC_KZQ_EV2274A_4_1/Main/CAN SDO/SDO  0x7C/Case 0x6443h/ Case 0x6443-024/SDO Reply/value_To_uint8[4]" /begin REF_CHARACTERISTIC core_gp_xSwapBytes /end REF_CHARACTERISTIC /end GROUP
/begin GROUP S2518_value_To_uint8_4_1 "SC_KZQ_EV2274A_4_1/Main/CAN SDO/SDO  0x7C/Case 0x6443h/ Case 0x6443-024/SDO Reply/value_To_uint8[4]1" /begin REF_CHARACTERISTIC core_gp_xSwapBytes /end REF_CHARACTERISTIC /end GROUP
/begin GROUP S2554_SDO_Error_Reply "SC_KZQ_EV2274A_4_1/Main/CAN SDO/SDO  0x7C/Case 0x6443h/ Case 0x6443-025/SDO Reply/SDO Error Reply"
 /begin REF_CHARACTERISTIC core_gcp_u8CanSDOCmd_ErrReply core_gcp_u8CanSDOCmd_ErrReply_MainIndexMismatch core_gcp_u8CanSDOCmd_ErrReply_SubIndexMismatch core_gcp_u8CanSDOCmd_ErrReply_WrongCommand /end REF_CHARACTERISTIC
/end GROUP
/begin GROUP S2554_value_To_uint8_4_ "SC_KZQ_EV2274A_4_1/Main/CAN SDO/SDO  0x7C/Case 0x6443h/ Case 0x6443-025/SDO Reply/value_To_uint8[4]" /begin REF_CHARACTERISTIC core_gp_xSwapBytes /end REF_CHARACTERISTIC /end GROUP
/begin GROUP S2554_value_To_uint8_4_1 "SC_KZQ_EV2274A_4_1/Main/CAN SDO/SDO  0x7C/Case 0x6443h/ Case 0x6443-025/SDO Reply/value_To_uint8[4]1" /begin REF_CHARACTERISTIC core_gp_xSwapBytes /end REF_CHARACTERISTIC /end GROUP
/begin GROUP S2590_SDO_Error_Reply "SC_KZQ_EV2274A_4_1/Main/CAN SDO/SDO  0x7C/Case 0x6443h/ Case 0x6443-026/SDO Reply/SDO Error Reply"
 /begin REF_CHARACTERISTIC core_gcp_u8CanSDOCmd_ErrReply core_gcp_u8CanSDOCmd_ErrReply_MainIndexMismatch core_gcp_u8CanSDOCmd_ErrReply_SubIndexMismatch core_gcp_u8CanSDOCmd_ErrReply_WrongCommand /end REF_CHARACTERISTIC
/end GROUP
/begin GROUP S2590_value_To_uint8_4_ "SC_KZQ_EV2274A_4_1/Main/CAN SDO/SDO  0x7C/Case 0x6443h/ Case 0x6443-026/SDO Reply/value_To_uint8[4]" /begin REF_CHARACTERISTIC core_gp_xSwapBytes /end REF_CHARACTERISTIC /end GROUP
/begin GROUP S2590_value_To_uint8_4_1 "SC_KZQ_EV2274A_4_1/Main/CAN SDO/SDO  0x7C/Case 0x6443h/ Case 0x6443-026/SDO Reply/value_To_uint8[4]1" /begin REF_CHARACTERISTIC core_gp_xSwapBytes /end REF_CHARACTERISTIC /end GROUP
/begin GROUP S2626_SDO_Error_Reply "SC_KZQ_EV2274A_4_1/Main/CAN SDO/SDO  0x7C/Case 0x6443h/ Case 0x6443-027/SDO Reply/SDO Error Reply"
 /begin REF_CHARACTERISTIC core_gcp_u8CanSDOCmd_ErrReply core_gcp_u8CanSDOCmd_ErrReply_MainIndexMismatch core_gcp_u8CanSDOCmd_ErrReply_SubIndexMismatch core_gcp_u8CanSDOCmd_ErrReply_WrongCommand /end REF_CHARACTERISTIC
/end GROUP
/begin GROUP S2626_value_To_uint8_4_ "SC_KZQ_EV2274A_4_1/Main/CAN SDO/SDO  0x7C/Case 0x6443h/ Case 0x6443-027/SDO Reply/value_To_uint8[4]" /begin REF_CHARACTERISTIC core_gp_xSwapBytes /end REF_CHARACTERISTIC /end GROUP
/begin GROUP S2626_value_To_uint8_4_1 "SC_KZQ_EV2274A_4_1/Main/CAN SDO/SDO  0x7C/Case 0x6443h/ Case 0x6443-027/SDO Reply/value_To_uint8[4]1" /begin REF_CHARACTERISTIC core_gp_xSwapBytes /end REF_CHARACTERISTIC /end GROUP
/begin GROUP S2662_SDO_Error_Reply "SC_KZQ_EV2274A_4_1/Main/CAN SDO/SDO  0x7C/Case 0x6443h/ Case 0x6443-028/SDO Reply/SDO Error Reply"
 /begin REF_CHARACTERISTIC core_gcp_u8CanSDOCmd_ErrReply core_gcp_u8CanSDOCmd_ErrReply_MainIndexMismatch core_gcp_u8CanSDOCmd_ErrReply_SubIndexMismatch core_gcp_u8CanSDOCmd_ErrReply_WrongCommand /end REF_CHARACTERISTIC
/end GROUP
/begin GROUP S2662_value_To_uint8_4_ "SC_KZQ_EV2274A_4_1/Main/CAN SDO/SDO  0x7C/Case 0x6443h/ Case 0x6443-028/SDO Reply/value_To_uint8[4]" /begin REF_CHARACTERISTIC core_gp_xSwapBytes /end REF_CHARACTERISTIC /end GROUP
/begin GROUP S2662_value_To_uint8_4_1 "SC_KZQ_EV2274A_4_1/Main/CAN SDO/SDO  0x7C/Case 0x6443h/ Case 0x6443-028/SDO Reply/value_To_uint8[4]1" /begin REF_CHARACTERISTIC core_gp_xSwapBytes /end REF_CHARACTERISTIC /end GROUP
/begin GROUP S2698_SDO_Error_Reply "SC_KZQ_EV2274A_4_1/Main/CAN SDO/SDO  0x7C/Case 0x6443h/ Case 0x6443-029/SDO Reply/SDO Error Reply"
 /begin REF_CHARACTERISTIC core_gcp_u8CanSDOCmd_ErrReply core_gcp_u8CanSDOCmd_ErrReply_MainIndexMismatch core_gcp_u8CanSDOCmd_ErrReply_SubIndexMismatch core_gcp_u8CanSDOCmd_ErrReply_WrongCommand /end REF_CHARACTERISTIC
/end GROUP
/begin GROUP S2698_value_To_uint8_4_ "SC_KZQ_EV2274A_4_1/Main/CAN SDO/SDO  0x7C/Case 0x6443h/ Case 0x6443-029/SDO Reply/value_To_uint8[4]" /begin REF_CHARACTERISTIC core_gp_xSwapBytes /end REF_CHARACTERISTIC /end GROUP
/begin GROUP S2698_value_To_uint8_4_1 "SC_KZQ_EV2274A_4_1/Main/CAN SDO/SDO  0x7C/Case 0x6443h/ Case 0x6443-029/SDO Reply/value_To_uint8[4]1" /begin REF_CHARACTERISTIC core_gp_xSwapBytes /end REF_CHARACTERISTIC /end GROUP
/begin GROUP S2734_SDO_Error_Reply "SC_KZQ_EV2274A_4_1/Main/CAN SDO/SDO  0x7C/Case 0x6443h/ Case 0x6443-030/SDO Reply/SDO Error Reply"
 /begin REF_CHARACTERISTIC core_gcp_u8CanSDOCmd_ErrReply core_gcp_u8CanSDOCmd_ErrReply_MainIndexMismatch core_gcp_u8CanSDOCmd_ErrReply_SubIndexMismatch core_gcp_u8CanSDOCmd_ErrReply_WrongCommand /end REF_CHARACTERISTIC
/end GROUP
/begin GROUP S2734_value_To_uint8_4_ "SC_KZQ_EV2274A_4_1/Main/CAN SDO/SDO  0x7C/Case 0x6443h/ Case 0x6443-030/SDO Reply/value_To_uint8[4]" /begin REF_CHARACTERISTIC core_gp_xSwapBytes /end REF_CHARACTERISTIC /end GROUP
/begin GROUP S2734_value_To_uint8_4_1 "SC_KZQ_EV2274A_4_1/Main/CAN SDO/SDO  0x7C/Case 0x6443h/ Case 0x6443-030/SDO Reply/value_To_uint8[4]1" /begin REF_CHARACTERISTIC core_gp_xSwapBytes /end REF_CHARACTERISTIC /end GROUP
/begin GROUP S2770_SDO_Error_Reply "SC_KZQ_EV2274A_4_1/Main/CAN SDO/SDO  0x7C/Case 0x6443h/ Case 0x6443-031/SDO Reply/SDO Error Reply"
 /begin REF_CHARACTERISTIC core_gcp_u8CanSDOCmd_ErrReply core_gcp_u8CanSDOCmd_ErrReply_MainIndexMismatch core_gcp_u8CanSDOCmd_ErrReply_SubIndexMismatch core_gcp_u8CanSDOCmd_ErrReply_WrongCommand /end REF_CHARACTERISTIC
/end GROUP
/begin GROUP S2770_value_To_uint8_4_ "SC_KZQ_EV2274A_4_1/Main/CAN SDO/SDO  0x7C/Case 0x6443h/ Case 0x6443-031/SDO Reply/value_To_uint8[4]" /begin REF_CHARACTERISTIC core_gp_xSwapBytes /end REF_CHARACTERISTIC /end GROUP
/begin GROUP S2770_value_To_uint8_4_1 "SC_KZQ_EV2274A_4_1/Main/CAN SDO/SDO  0x7C/Case 0x6443h/ Case 0x6443-031/SDO Reply/value_To_uint8[4]1" /begin REF_CHARACTERISTIC core_gp_xSwapBytes /end REF_CHARACTERISTIC /end GROUP
/begin GROUP S2806_SDO_Error_Reply "SC_KZQ_EV2274A_4_1/Main/CAN SDO/SDO  0x7C/Case 0x6443h/ Case 0x6443-032/SDO Reply/SDO Error Reply"
 /begin REF_CHARACTERISTIC core_gcp_u8CanSDOCmd_ErrReply core_gcp_u8CanSDOCmd_ErrReply_MainIndexMismatch core_gcp_u8CanSDOCmd_ErrReply_SubIndexMismatch core_gcp_u8CanSDOCmd_ErrReply_WrongCommand /end REF_CHARACTERISTIC
/end GROUP
/begin GROUP S2806_value_To_uint8_4_ "SC_KZQ_EV2274A_4_1/Main/CAN SDO/SDO  0x7C/Case 0x6443h/ Case 0x6443-032/SDO Reply/value_To_uint8[4]" /begin REF_CHARACTERISTIC core_gp_xSwapBytes /end REF_CHARACTERISTIC /end GROUP
/begin GROUP S2806_value_To_uint8_4_1 "SC_KZQ_EV2274A_4_1/Main/CAN SDO/SDO  0x7C/Case 0x6443h/ Case 0x6443-032/SDO Reply/value_To_uint8[4]1" /begin REF_CHARACTERISTIC core_gp_xSwapBytes /end REF_CHARACTERISTIC /end GROUP
/begin GROUP S2870_SDO_Error_Reply "SC_KZQ_EV2274A_4_1/Main/CAN SDO/SDO  0x7C/Case 0x6445h/ Case 0x6445-001/SDO Reply/SDO Error Reply"
 /begin REF_CHARACTERISTIC core_gcp_u8CanSDOCmd_ErrReply core_gcp_u8CanSDOCmd_ErrReply_MainIndexMismatch core_gcp_u8CanSDOCmd_ErrReply_SubIndexMismatch core_gcp_u8CanSDOCmd_ErrReply_WrongCommand /end REF_CHARACTERISTIC
/end GROUP
/begin GROUP S2870_value_To_uint8_4_ "SC_KZQ_EV2274A_4_1/Main/CAN SDO/SDO  0x7C/Case 0x6445h/ Case 0x6445-001/SDO Reply/value_To_uint8[4]" /begin REF_CHARACTERISTIC core_gp_xSwapBytes /end REF_CHARACTERISTIC /end GROUP
/begin GROUP S2870_value_To_uint8_4_1 "SC_KZQ_EV2274A_4_1/Main/CAN SDO/SDO  0x7C/Case 0x6445h/ Case 0x6445-001/SDO Reply/value_To_uint8[4]1" /begin REF_CHARACTERISTIC core_gp_xSwapBytes /end REF_CHARACTERISTIC /end GROUP
/begin GROUP S2906_SDO_Error_Reply "SC_KZQ_EV2274A_4_1/Main/CAN SDO/SDO  0x7C/Case 0x6445h/ Case 0x6445-002/SDO Reply/SDO Error Reply"
 /begin REF_CHARACTERISTIC core_gcp_u8CanSDOCmd_ErrReply core_gcp_u8CanSDOCmd_ErrReply_MainIndexMismatch core_gcp_u8CanSDOCmd_ErrReply_SubIndexMismatch core_gcp_u8CanSDOCmd_ErrReply_WrongCommand /end REF_CHARACTERISTIC
/end GROUP
/begin GROUP S2906_value_To_uint8_4_ "SC_KZQ_EV2274A_4_1/Main/CAN SDO/SDO  0x7C/Case 0x6445h/ Case 0x6445-002/SDO Reply/value_To_uint8[4]" /begin REF_CHARACTERISTIC core_gp_xSwapBytes /end REF_CHARACTERISTIC /end GROUP
/begin GROUP S2906_value_To_uint8_4_1 "SC_KZQ_EV2274A_4_1/Main/CAN SDO/SDO  0x7C/Case 0x6445h/ Case 0x6445-002/SDO Reply/value_To_uint8[4]1" /begin REF_CHARACTERISTIC core_gp_xSwapBytes /end REF_CHARACTERISTIC /end GROUP
/begin GROUP S2942_SDO_Error_Reply "SC_KZQ_EV2274A_4_1/Main/CAN SDO/SDO  0x7C/Case 0x6445h/ Case 0x6445-003/SDO Reply/SDO Error Reply"
 /begin REF_CHARACTERISTIC core_gcp_u8CanSDOCmd_ErrReply core_gcp_u8CanSDOCmd_ErrReply_MainIndexMismatch core_gcp_u8CanSDOCmd_ErrReply_SubIndexMismatch core_gcp_u8CanSDOCmd_ErrReply_WrongCommand /end REF_CHARACTERISTIC
/end GROUP
/begin GROUP S2942_value_To_uint8_4_ "SC_KZQ_EV2274A_4_1/Main/CAN SDO/SDO  0x7C/Case 0x6445h/ Case 0x6445-003/SDO Reply/value_To_uint8[4]" /begin REF_CHARACTERISTIC core_gp_xSwapBytes /end REF_CHARACTERISTIC /end GROUP
/begin GROUP S2942_value_To_uint8_4_1 "SC_KZQ_EV2274A_4_1/Main/CAN SDO/SDO  0x7C/Case 0x6445h/ Case 0x6445-003/SDO Reply/value_To_uint8[4]1" /begin REF_CHARACTERISTIC core_gp_xSwapBytes /end REF_CHARACTERISTIC /end GROUP
/begin GROUP S2978_SDO_Error_Reply "SC_KZQ_EV2274A_4_1/Main/CAN SDO/SDO  0x7C/Case 0x6445h/ Case 0x6445-004/SDO Reply/SDO Error Reply"
 /begin REF_CHARACTERISTIC core_gcp_u8CanSDOCmd_ErrReply core_gcp_u8CanSDOCmd_ErrReply_MainIndexMismatch core_gcp_u8CanSDOCmd_ErrReply_SubIndexMismatch core_gcp_u8CanSDOCmd_ErrReply_WrongCommand /end REF_CHARACTERISTIC
/end GROUP
/begin GROUP S2978_value_To_uint8_4_ "SC_KZQ_EV2274A_4_1/Main/CAN SDO/SDO  0x7C/Case 0x6445h/ Case 0x6445-004/SDO Reply/value_To_uint8[4]" /begin REF_CHARACTERISTIC core_gp_xSwapBytes /end REF_CHARACTERISTIC /end GROUP
/begin GROUP S2978_value_To_uint8_4_1 "SC_KZQ_EV2274A_4_1/Main/CAN SDO/SDO  0x7C/Case 0x6445h/ Case 0x6445-004/SDO Reply/value_To_uint8[4]1" /begin REF_CHARACTERISTIC core_gp_xSwapBytes /end REF_CHARACTERISTIC /end GROUP
/begin GROUP S3014_SDO_Error_Reply "SC_KZQ_EV2274A_4_1/Main/CAN SDO/SDO  0x7C/Case 0x6445h/ Case 0x6445-030/SDO Reply/SDO Error Reply"
 /begin REF_CHARACTERISTIC core_gcp_u8CanSDOCmd_ErrReply core_gcp_u8CanSDOCmd_ErrReply_MainIndexMismatch core_gcp_u8CanSDOCmd_ErrReply_SubIndexMismatch core_gcp_u8CanSDOCmd_ErrReply_WrongCommand /end REF_CHARACTERISTIC
/end GROUP
/begin GROUP S3014_value_To_uint8_4_ "SC_KZQ_EV2274A_4_1/Main/CAN SDO/SDO  0x7C/Case 0x6445h/ Case 0x6445-030/SDO Reply/value_To_uint8[4]" /begin REF_CHARACTERISTIC core_gp_xSwapBytes /end REF_CHARACTERISTIC /end GROUP
/begin GROUP S3014_value_To_uint8_4_1 "SC_KZQ_EV2274A_4_1/Main/CAN SDO/SDO  0x7C/Case 0x6445h/ Case 0x6445-030/SDO Reply/value_To_uint8[4]1" /begin REF_CHARACTERISTIC core_gp_xSwapBytes /end REF_CHARACTERISTIC /end GROUP
/begin GROUP S3050_SDO_Error_Reply "SC_KZQ_EV2274A_4_1/Main/CAN SDO/SDO  0x7C/Case 0x6445h/ Case 0x6445-040/SDO Reply/SDO Error Reply"
 /begin REF_CHARACTERISTIC core_gcp_u8CanSDOCmd_ErrReply core_gcp_u8CanSDOCmd_ErrReply_MainIndexMismatch core_gcp_u8CanSDOCmd_ErrReply_SubIndexMismatch core_gcp_u8CanSDOCmd_ErrReply_WrongCommand /end REF_CHARACTERISTIC
/end GROUP
/begin GROUP S3050_value_To_uint8_4_ "SC_KZQ_EV2274A_4_1/Main/CAN SDO/SDO  0x7C/Case 0x6445h/ Case 0x6445-040/SDO Reply/value_To_uint8[4]" /begin REF_CHARACTERISTIC core_gp_xSwapBytes /end REF_CHARACTERISTIC /end GROUP
/begin GROUP S3050_value_To_uint8_4_1 "SC_KZQ_EV2274A_4_1/Main/CAN SDO/SDO  0x7C/Case 0x6445h/ Case 0x6445-040/SDO Reply/value_To_uint8[4]1" /begin REF_CHARACTERISTIC core_gp_xSwapBytes /end REF_CHARACTERISTIC /end GROUP
/begin GROUP S3086_SDO_Error_Reply "SC_KZQ_EV2274A_4_1/Main/CAN SDO/SDO  0x7C/Case 0x6445h/ Case 0x6445-041/SDO Reply/SDO Error Reply"
 /begin REF_CHARACTERISTIC core_gcp_u8CanSDOCmd_ErrReply core_gcp_u8CanSDOCmd_ErrReply_MainIndexMismatch core_gcp_u8CanSDOCmd_ErrReply_SubIndexMismatch core_gcp_u8CanSDOCmd_ErrReply_WrongCommand /end REF_CHARACTERISTIC
/end GROUP
/begin GROUP S3086_value_To_uint8_4_ "SC_KZQ_EV2274A_4_1/Main/CAN SDO/SDO  0x7C/Case 0x6445h/ Case 0x6445-041/SDO Reply/value_To_uint8[4]" /begin REF_CHARACTERISTIC core_gp_xSwapBytes /end REF_CHARACTERISTIC /end GROUP
/begin GROUP S3086_value_To_uint8_4_1 "SC_KZQ_EV2274A_4_1/Main/CAN SDO/SDO  0x7C/Case 0x6445h/ Case 0x6445-041/SDO Reply/value_To_uint8[4]1" /begin REF_CHARACTERISTIC core_gp_xSwapBytes /end REF_CHARACTERISTIC /end GROUP
/begin GROUP S3122_SDO_Error_Reply "SC_KZQ_EV2274A_4_1/Main/CAN SDO/SDO  0x7C/Case 0x6445h/ Case 0x6445-042/SDO Reply/SDO Error Reply"
 /begin REF_CHARACTERISTIC core_gcp_u8CanSDOCmd_ErrReply core_gcp_u8CanSDOCmd_ErrReply_MainIndexMismatch core_gcp_u8CanSDOCmd_ErrReply_SubIndexMismatch core_gcp_u8CanSDOCmd_ErrReply_WrongCommand /end REF_CHARACTERISTIC
/end GROUP
/begin GROUP S3122_value_To_uint8_4_ "SC_KZQ_EV2274A_4_1/Main/CAN SDO/SDO  0x7C/Case 0x6445h/ Case 0x6445-042/SDO Reply/value_To_uint8[4]" /begin REF_CHARACTERISTIC core_gp_xSwapBytes /end REF_CHARACTERISTIC /end GROUP
/begin GROUP S3122_value_To_uint8_4_1 "SC_KZQ_EV2274A_4_1/Main/CAN SDO/SDO  0x7C/Case 0x6445h/ Case 0x6445-042/SDO Reply/value_To_uint8[4]1" /begin REF_CHARACTERISTIC core_gp_xSwapBytes /end REF_CHARACTERISTIC /end GROUP
/begin GROUP S3158_SDO_Error_Reply "SC_KZQ_EV2274A_4_1/Main/CAN SDO/SDO  0x7C/Case 0x6445h/ Case 0x6445-043/SDO Reply/SDO Error Reply"
 /begin REF_CHARACTERISTIC core_gcp_u8CanSDOCmd_ErrReply core_gcp_u8CanSDOCmd_ErrReply_MainIndexMismatch core_gcp_u8CanSDOCmd_ErrReply_SubIndexMismatch core_gcp_u8CanSDOCmd_ErrReply_WrongCommand /end REF_CHARACTERISTIC
/end GROUP
/begin GROUP S3158_value_To_uint8_4_ "SC_KZQ_EV2274A_4_1/Main/CAN SDO/SDO  0x7C/Case 0x6445h/ Case 0x6445-043/SDO Reply/value_To_uint8[4]" /begin REF_CHARACTERISTIC core_gp_xSwapBytes /end REF_CHARACTERISTIC /end GROUP
/begin GROUP S3158_value_To_uint8_4_1 "SC_KZQ_EV2274A_4_1/Main/CAN SDO/SDO  0x7C/Case 0x6445h/ Case 0x6445-043/SDO Reply/value_To_uint8[4]1" /begin REF_CHARACTERISTIC core_gp_xSwapBytes /end REF_CHARACTERISTIC /end GROUP
/begin GROUP S3194_SDO_Error_Reply "SC_KZQ_EV2274A_4_1/Main/CAN SDO/SDO  0x7C/Case 0x6445h/ Case 0x6445-044/SDO Reply/SDO Error Reply"
 /begin REF_CHARACTERISTIC core_gcp_u8CanSDOCmd_ErrReply core_gcp_u8CanSDOCmd_ErrReply_MainIndexMismatch core_gcp_u8CanSDOCmd_ErrReply_SubIndexMismatch core_gcp_u8CanSDOCmd_ErrReply_WrongCommand /end REF_CHARACTERISTIC
/end GROUP
/begin GROUP S3194_value_To_uint8_4_ "SC_KZQ_EV2274A_4_1/Main/CAN SDO/SDO  0x7C/Case 0x6445h/ Case 0x6445-044/SDO Reply/value_To_uint8[4]" /begin REF_CHARACTERISTIC core_gp_xSwapBytes /end REF_CHARACTERISTIC /end GROUP
/begin GROUP S3194_value_To_uint8_4_1 "SC_KZQ_EV2274A_4_1/Main/CAN SDO/SDO  0x7C/Case 0x6445h/ Case 0x6445-044/SDO Reply/value_To_uint8[4]1" /begin REF_CHARACTERISTIC core_gp_xSwapBytes /end REF_CHARACTERISTIC /end GROUP
/begin GROUP S3230_SDO_Error_Reply "SC_KZQ_EV2274A_4_1/Main/CAN SDO/SDO  0x7C/Case 0x6445h/ Case 0x6445-045/SDO Reply/SDO Error Reply"
 /begin REF_CHARACTERISTIC core_gcp_u8CanSDOCmd_ErrReply core_gcp_u8CanSDOCmd_ErrReply_MainIndexMismatch core_gcp_u8CanSDOCmd_ErrReply_SubIndexMismatch core_gcp_u8CanSDOCmd_ErrReply_WrongCommand /end REF_CHARACTERISTIC
/end GROUP
/begin GROUP S3230_value_To_uint8_4_ "SC_KZQ_EV2274A_4_1/Main/CAN SDO/SDO  0x7C/Case 0x6445h/ Case 0x6445-045/SDO Reply/value_To_uint8[4]" /begin REF_CHARACTERISTIC core_gp_xSwapBytes /end REF_CHARACTERISTIC /end GROUP
/begin GROUP S3230_value_To_uint8_4_1 "SC_KZQ_EV2274A_4_1/Main/CAN SDO/SDO  0x7C/Case 0x6445h/ Case 0x6445-045/SDO Reply/value_To_uint8[4]1" /begin REF_CHARACTERISTIC core_gp_xSwapBytes /end REF_CHARACTERISTIC /end GROUP
/begin GROUP S3266_SDO_Error_Reply "SC_KZQ_EV2274A_4_1/Main/CAN SDO/SDO  0x7C/Case 0x6445h/ Case 0x6445-046/SDO Reply/SDO Error Reply"
 /begin REF_CHARACTERISTIC core_gcp_u8CanSDOCmd_ErrReply core_gcp_u8CanSDOCmd_ErrReply_MainIndexMismatch core_gcp_u8CanSDOCmd_ErrReply_SubIndexMismatch core_gcp_u8CanSDOCmd_ErrReply_WrongCommand /end REF_CHARACTERISTIC
/end GROUP
/begin GROUP S3266_value_To_uint8_4_ "SC_KZQ_EV2274A_4_1/Main/CAN SDO/SDO  0x7C/Case 0x6445h/ Case 0x6445-046/SDO Reply/value_To_uint8[4]" /begin REF_CHARACTERISTIC core_gp_xSwapBytes /end REF_CHARACTERISTIC /end GROUP
/begin GROUP S3266_value_To_uint8_4_1 "SC_KZQ_EV2274A_4_1/Main/CAN SDO/SDO  0x7C/Case 0x6445h/ Case 0x6445-046/SDO Reply/value_To_uint8[4]1" /begin REF_CHARACTERISTIC core_gp_xSwapBytes /end REF_CHARACTERISTIC /end GROUP
/begin GROUP S3302_SDO_Error_Reply "SC_KZQ_EV2274A_4_1/Main/CAN SDO/SDO  0x7C/Case 0x6445h/ Case 0x6445-060/SDO Reply/SDO Error Reply"
 /begin REF_CHARACTERISTIC core_gcp_u8CanSDOCmd_ErrReply core_gcp_u8CanSDOCmd_ErrReply_MainIndexMismatch core_gcp_u8CanSDOCmd_ErrReply_SubIndexMismatch core_gcp_u8CanSDOCmd_ErrReply_WrongCommand /end REF_CHARACTERISTIC
/end GROUP
/begin GROUP S3302_value_To_uint8_4_ "SC_KZQ_EV2274A_4_1/Main/CAN SDO/SDO  0x7C/Case 0x6445h/ Case 0x6445-060/SDO Reply/value_To_uint8[4]" /begin REF_CHARACTERISTIC core_gp_xSwapBytes /end REF_CHARACTERISTIC /end GROUP
/begin GROUP S3302_value_To_uint8_4_1 "SC_KZQ_EV2274A_4_1/Main/CAN SDO/SDO  0x7C/Case 0x6445h/ Case 0x6445-060/SDO Reply/value_To_uint8[4]1" /begin REF_CHARACTERISTIC core_gp_xSwapBytes /end REF_CHARACTERISTIC /end GROUP
/begin GROUP S3338_SDO_Error_Reply "SC_KZQ_EV2274A_4_1/Main/CAN SDO/SDO  0x7C/Case 0x6445h/ Case 0x6445-061/SDO Reply/SDO Error Reply"
 /begin REF_CHARACTERISTIC core_gcp_u8CanSDOCmd_ErrReply core_gcp_u8CanSDOCmd_ErrReply_MainIndexMismatch core_gcp_u8CanSDOCmd_ErrReply_SubIndexMismatch core_gcp_u8CanSDOCmd_ErrReply_WrongCommand /end REF_CHARACTERISTIC
/end GROUP
/begin GROUP S3338_value_To_uint8_4_ "SC_KZQ_EV2274A_4_1/Main/CAN SDO/SDO  0x7C/Case 0x6445h/ Case 0x6445-061/SDO Reply/value_To_uint8[4]" /begin REF_CHARACTERISTIC core_gp_xSwapBytes /end REF_CHARACTERISTIC /end GROUP
/begin GROUP S3338_value_To_uint8_4_1 "SC_KZQ_EV2274A_4_1/Main/CAN SDO/SDO  0x7C/Case 0x6445h/ Case 0x6445-061/SDO Reply/value_To_uint8[4]1" /begin REF_CHARACTERISTIC core_gp_xSwapBytes /end REF_CHARACTERISTIC /end GROUP
/begin GROUP S3374_SDO_Error_Reply "SC_KZQ_EV2274A_4_1/Main/CAN SDO/SDO  0x7C/Case 0x6445h/ Case 0x6445-062/SDO Reply/SDO Error Reply"
 /begin REF_CHARACTERISTIC core_gcp_u8CanSDOCmd_ErrReply core_gcp_u8CanSDOCmd_ErrReply_MainIndexMismatch core_gcp_u8CanSDOCmd_ErrReply_SubIndexMismatch core_gcp_u8CanSDOCmd_ErrReply_WrongCommand /end REF_CHARACTERISTIC
/end GROUP
/begin GROUP S3374_value_To_uint8_4_ "SC_KZQ_EV2274A_4_1/Main/CAN SDO/SDO  0x7C/Case 0x6445h/ Case 0x6445-062/SDO Reply/value_To_uint8[4]" /begin REF_CHARACTERISTIC core_gp_xSwapBytes /end REF_CHARACTERISTIC /end GROUP
/begin GROUP S3374_value_To_uint8_4_1 "SC_KZQ_EV2274A_4_1/Main/CAN SDO/SDO  0x7C/Case 0x6445h/ Case 0x6445-062/SDO Reply/value_To_uint8[4]1" /begin REF_CHARACTERISTIC core_gp_xSwapBytes /end REF_CHARACTERISTIC /end GROUP
/begin GROUP S3410_SDO_Error_Reply "SC_KZQ_EV2274A_4_1/Main/CAN SDO/SDO  0x7C/Case 0x6445h/ Case 0x6445-080/SDO Reply/SDO Error Reply"
 /begin REF_CHARACTERISTIC core_gcp_u8CanSDOCmd_ErrReply core_gcp_u8CanSDOCmd_ErrReply_MainIndexMismatch core_gcp_u8CanSDOCmd_ErrReply_SubIndexMismatch core_gcp_u8CanSDOCmd_ErrReply_WrongCommand /end REF_CHARACTERISTIC
/end GROUP
/begin GROUP S3410_value_To_uint8_4_ "SC_KZQ_EV2274A_4_1/Main/CAN SDO/SDO  0x7C/Case 0x6445h/ Case 0x6445-080/SDO Reply/value_To_uint8[4]" /begin REF_CHARACTERISTIC core_gp_xSwapBytes /end REF_CHARACTERISTIC /end GROUP
/begin GROUP S3410_value_To_uint8_4_1 "SC_KZQ_EV2274A_4_1/Main/CAN SDO/SDO  0x7C/Case 0x6445h/ Case 0x6445-080/SDO Reply/value_To_uint8[4]1" /begin REF_CHARACTERISTIC core_gp_xSwapBytes /end REF_CHARACTERISTIC /end GROUP
/begin GROUP S3446_SDO_Error_Reply "SC_KZQ_EV2274A_4_1/Main/CAN SDO/SDO  0x7C/Case 0x6445h/ Case 0x6445-081/SDO Reply/SDO Error Reply"
 /begin REF_CHARACTERISTIC core_gcp_u8CanSDOCmd_ErrReply core_gcp_u8CanSDOCmd_ErrReply_MainIndexMismatch core_gcp_u8CanSDOCmd_ErrReply_SubIndexMismatch core_gcp_u8CanSDOCmd_ErrReply_WrongCommand /end REF_CHARACTERISTIC
/end GROUP
/begin GROUP S3446_value_To_uint8_4_ "SC_KZQ_EV2274A_4_1/Main/CAN SDO/SDO  0x7C/Case 0x6445h/ Case 0x6445-081/SDO Reply/value_To_uint8[4]" /begin REF_CHARACTERISTIC core_gp_xSwapBytes /end REF_CHARACTERISTIC /end GROUP
/begin GROUP S3446_value_To_uint8_4_1 "SC_KZQ_EV2274A_4_1/Main/CAN SDO/SDO  0x7C/Case 0x6445h/ Case 0x6445-081/SDO Reply/value_To_uint8[4]1" /begin REF_CHARACTERISTIC core_gp_xSwapBytes /end REF_CHARACTERISTIC /end GROUP
/begin GROUP S3482_SDO_Error_Reply "SC_KZQ_EV2274A_4_1/Main/CAN SDO/SDO  0x7C/Case 0x6445h/ Case 0x6445-090/SDO Reply/SDO Error Reply"
 /begin REF_CHARACTERISTIC core_gcp_u8CanSDOCmd_ErrReply core_gcp_u8CanSDOCmd_ErrReply_MainIndexMismatch core_gcp_u8CanSDOCmd_ErrReply_SubIndexMismatch core_gcp_u8CanSDOCmd_ErrReply_WrongCommand /end REF_CHARACTERISTIC
/end GROUP
/begin GROUP S3482_value_To_uint8_4_ "SC_KZQ_EV2274A_4_1/Main/CAN SDO/SDO  0x7C/Case 0x6445h/ Case 0x6445-090/SDO Reply/value_To_uint8[4]" /begin REF_CHARACTERISTIC core_gp_xSwapBytes /end REF_CHARACTERISTIC /end GROUP
/begin GROUP S3482_value_To_uint8_4_1 "SC_KZQ_EV2274A_4_1/Main/CAN SDO/SDO  0x7C/Case 0x6445h/ Case 0x6445-090/SDO Reply/value_To_uint8[4]1" /begin REF_CHARACTERISTIC core_gp_xSwapBytes /end REF_CHARACTERISTIC /end GROUP
/begin GROUP S3518_SDO_Error_Reply "SC_KZQ_EV2274A_4_1/Main/CAN SDO/SDO  0x7C/Case 0x6445h/ Case 0x6445-091/SDO Reply/SDO Error Reply"
 /begin REF_CHARACTERISTIC core_gcp_u8CanSDOCmd_ErrReply core_gcp_u8CanSDOCmd_ErrReply_MainIndexMismatch core_gcp_u8CanSDOCmd_ErrReply_SubIndexMismatch core_gcp_u8CanSDOCmd_ErrReply_WrongCommand /end REF_CHARACTERISTIC
/end GROUP
/begin GROUP S3518_value_To_uint8_4_ "SC_KZQ_EV2274A_4_1/Main/CAN SDO/SDO  0x7C/Case 0x6445h/ Case 0x6445-091/SDO Reply/value_To_uint8[4]" /begin REF_CHARACTERISTIC core_gp_xSwapBytes /end REF_CHARACTERISTIC /end GROUP
/begin GROUP S3518_value_To_uint8_4_1 "SC_KZQ_EV2274A_4_1/Main/CAN SDO/SDO  0x7C/Case 0x6445h/ Case 0x6445-091/SDO Reply/value_To_uint8[4]1" /begin REF_CHARACTERISTIC core_gp_xSwapBytes /end REF_CHARACTERISTIC /end GROUP
/begin GROUP S3554_SDO_Error_Reply "SC_KZQ_EV2274A_4_1/Main/CAN SDO/SDO  0x7C/Case 0x6445h/ Case 0x6445-092/SDO Reply/SDO Error Reply"
 /begin REF_CHARACTERISTIC core_gcp_u8CanSDOCmd_ErrReply core_gcp_u8CanSDOCmd_ErrReply_MainIndexMismatch core_gcp_u8CanSDOCmd_ErrReply_SubIndexMismatch core_gcp_u8CanSDOCmd_ErrReply_WrongCommand /end REF_CHARACTERISTIC
/end GROUP
/begin GROUP S3554_value_To_uint8_4_ "SC_KZQ_EV2274A_4_1/Main/CAN SDO/SDO  0x7C/Case 0x6445h/ Case 0x6445-092/SDO Reply/value_To_uint8[4]" /begin REF_CHARACTERISTIC core_gp_xSwapBytes /end REF_CHARACTERISTIC /end GROUP
/begin GROUP S3554_value_To_uint8_4_1 "SC_KZQ_EV2274A_4_1/Main/CAN SDO/SDO  0x7C/Case 0x6445h/ Case 0x6445-092/SDO Reply/value_To_uint8[4]1" /begin REF_CHARACTERISTIC core_gp_xSwapBytes /end REF_CHARACTERISTIC /end GROUP
/begin GROUP S3590_SDO_Error_Reply "SC_KZQ_EV2274A_4_1/Main/CAN SDO/SDO  0x7C/Case 0x6445h/ Case 0x6445-093/SDO Reply/SDO Error Reply"
 /begin REF_CHARACTERISTIC core_gcp_u8CanSDOCmd_ErrReply core_gcp_u8CanSDOCmd_ErrReply_MainIndexMismatch core_gcp_u8CanSDOCmd_ErrReply_SubIndexMismatch core_gcp_u8CanSDOCmd_ErrReply_WrongCommand /end REF_CHARACTERISTIC
/end GROUP
/begin GROUP S3590_value_To_uint8_4_ "SC_KZQ_EV2274A_4_1/Main/CAN SDO/SDO  0x7C/Case 0x6445h/ Case 0x6445-093/SDO Reply/value_To_uint8[4]" /begin REF_CHARACTERISTIC core_gp_xSwapBytes /end REF_CHARACTERISTIC /end GROUP
/begin GROUP S3590_value_To_uint8_4_1 "SC_KZQ_EV2274A_4_1/Main/CAN SDO/SDO  0x7C/Case 0x6445h/ Case 0x6445-093/SDO Reply/value_To_uint8[4]1" /begin REF_CHARACTERISTIC core_gp_xSwapBytes /end REF_CHARACTERISTIC /end GROUP
/begin GROUP S3626_SDO_Error_Reply "SC_KZQ_EV2274A_4_1/Main/CAN SDO/SDO  0x7C/Case 0x6445h/ Case 0x6445-180/SDO Reply/SDO Error Reply"
 /begin REF_CHARACTERISTIC core_gcp_u8CanSDOCmd_ErrReply core_gcp_u8CanSDOCmd_ErrReply_MainIndexMismatch core_gcp_u8CanSDOCmd_ErrReply_SubIndexMismatch core_gcp_u8CanSDOCmd_ErrReply_WrongCommand /end REF_CHARACTERISTIC
/end GROUP
/begin GROUP S3626_value_To_uint8_4_ "SC_KZQ_EV2274A_4_1/Main/CAN SDO/SDO  0x7C/Case 0x6445h/ Case 0x6445-180/SDO Reply/value_To_uint8[4]" /begin REF_CHARACTERISTIC core_gp_xSwapBytes /end REF_CHARACTERISTIC /end GROUP
/begin GROUP S3626_value_To_uint8_4_1 "SC_KZQ_EV2274A_4_1/Main/CAN SDO/SDO  0x7C/Case 0x6445h/ Case 0x6445-180/SDO Reply/value_To_uint8[4]1" /begin REF_CHARACTERISTIC core_gp_xSwapBytes /end REF_CHARACTERISTIC /end GROUP
/begin GROUP S3690_SDO_Error_Reply "SC_KZQ_EV2274A_4_1/Main/CAN SDO/SDO  0x7C/Case 0x6447h/ Case 0x6447-001/SDO Reply/SDO Error Reply"
 /begin REF_CHARACTERISTIC core_gcp_u8CanSDOCmd_ErrReply core_gcp_u8CanSDOCmd_ErrReply_MainIndexMismatch core_gcp_u8CanSDOCmd_ErrReply_SubIndexMismatch core_gcp_u8CanSDOCmd_ErrReply_WrongCommand /end REF_CHARACTERISTIC
/end GROUP
/begin GROUP S3690_value_To_uint8_4_ "SC_KZQ_EV2274A_4_1/Main/CAN SDO/SDO  0x7C/Case 0x6447h/ Case 0x6447-001/SDO Reply/value_To_uint8[4]" /begin REF_CHARACTERISTIC core_gp_xSwapBytes /end REF_CHARACTERISTIC /end GROUP
/begin GROUP S3690_value_To_uint8_4_1 "SC_KZQ_EV2274A_4_1/Main/CAN SDO/SDO  0x7C/Case 0x6447h/ Case 0x6447-001/SDO Reply/value_To_uint8[4]1" /begin REF_CHARACTERISTIC core_gp_xSwapBytes /end REF_CHARACTERISTIC /end GROUP
/begin GROUP S3726_SDO_Error_Reply "SC_KZQ_EV2274A_4_1/Main/CAN SDO/SDO  0x7C/Case 0x6447h/ Case 0x6447-002/SDO Reply/SDO Error Reply"
 /begin REF_CHARACTERISTIC core_gcp_u8CanSDOCmd_ErrReply core_gcp_u8CanSDOCmd_ErrReply_MainIndexMismatch core_gcp_u8CanSDOCmd_ErrReply_SubIndexMismatch core_gcp_u8CanSDOCmd_ErrReply_WrongCommand /end REF_CHARACTERISTIC
/end GROUP
/begin GROUP S3726_value_To_uint8_4_ "SC_KZQ_EV2274A_4_1/Main/CAN SDO/SDO  0x7C/Case 0x6447h/ Case 0x6447-002/SDO Reply/value_To_uint8[4]" /begin REF_CHARACTERISTIC core_gp_xSwapBytes /end REF_CHARACTERISTIC /end GROUP
/begin GROUP S3726_value_To_uint8_4_1 "SC_KZQ_EV2274A_4_1/Main/CAN SDO/SDO  0x7C/Case 0x6447h/ Case 0x6447-002/SDO Reply/value_To_uint8[4]1" /begin REF_CHARACTERISTIC core_gp_xSwapBytes /end REF_CHARACTERISTIC /end GROUP
/begin GROUP S3762_SDO_Error_Reply "SC_KZQ_EV2274A_4_1/Main/CAN SDO/SDO  0x7C/Case 0x6447h/ Case 0x6447-003/SDO Reply/SDO Error Reply"
 /begin REF_CHARACTERISTIC core_gcp_u8CanSDOCmd_ErrReply core_gcp_u8CanSDOCmd_ErrReply_MainIndexMismatch core_gcp_u8CanSDOCmd_ErrReply_SubIndexMismatch core_gcp_u8CanSDOCmd_ErrReply_WrongCommand /end REF_CHARACTERISTIC
/end GROUP
/begin GROUP S3762_value_To_uint8_4_ "SC_KZQ_EV2274A_4_1/Main/CAN SDO/SDO  0x7C/Case 0x6447h/ Case 0x6447-003/SDO Reply/value_To_uint8[4]" /begin REF_CHARACTERISTIC core_gp_xSwapBytes /end REF_CHARACTERISTIC /end GROUP
/begin GROUP S3762_value_To_uint8_4_1 "SC_KZQ_EV2274A_4_1/Main/CAN SDO/SDO  0x7C/Case 0x6447h/ Case 0x6447-003/SDO Reply/value_To_uint8[4]1" /begin REF_CHARACTERISTIC core_gp_xSwapBytes /end REF_CHARACTERISTIC /end GROUP
/begin GROUP S3798_SDO_Error_Reply "SC_KZQ_EV2274A_4_1/Main/CAN SDO/SDO  0x7C/Case 0x6447h/ Case 0x6447-004/SDO Reply/SDO Error Reply"
 /begin REF_CHARACTERISTIC core_gcp_u8CanSDOCmd_ErrReply core_gcp_u8CanSDOCmd_ErrReply_MainIndexMismatch core_gcp_u8CanSDOCmd_ErrReply_SubIndexMismatch core_gcp_u8CanSDOCmd_ErrReply_WrongCommand /end REF_CHARACTERISTIC
/end GROUP
/begin GROUP S3798_value_To_uint8_4_ "SC_KZQ_EV2274A_4_1/Main/CAN SDO/SDO  0x7C/Case 0x6447h/ Case 0x6447-004/SDO Reply/value_To_uint8[4]" /begin REF_CHARACTERISTIC core_gp_xSwapBytes /end REF_CHARACTERISTIC /end GROUP
/begin GROUP S3798_value_To_uint8_4_1 "SC_KZQ_EV2274A_4_1/Main/CAN SDO/SDO  0x7C/Case 0x6447h/ Case 0x6447-004/SDO Reply/value_To_uint8[4]1" /begin REF_CHARACTERISTIC core_gp_xSwapBytes /end REF_CHARACTERISTIC /end GROUP
/begin GROUP S3834_SDO_Error_Reply "SC_KZQ_EV2274A_4_1/Main/CAN SDO/SDO  0x7C/Case 0x6447h/ Case 0x6447-005/SDO Reply/SDO Error Reply"
 /begin REF_CHARACTERISTIC core_gcp_u8CanSDOCmd_ErrReply core_gcp_u8CanSDOCmd_ErrReply_MainIndexMismatch core_gcp_u8CanSDOCmd_ErrReply_SubIndexMismatch core_gcp_u8CanSDOCmd_ErrReply_WrongCommand /end REF_CHARACTERISTIC
/end GROUP
/begin GROUP S3834_value_To_uint8_4_ "SC_KZQ_EV2274A_4_1/Main/CAN SDO/SDO  0x7C/Case 0x6447h/ Case 0x6447-005/SDO Reply/value_To_uint8[4]" /begin REF_CHARACTERISTIC core_gp_xSwapBytes /end REF_CHARACTERISTIC /end GROUP
/begin GROUP S3834_value_To_uint8_4_1 "SC_KZQ_EV2274A_4_1/Main/CAN SDO/SDO  0x7C/Case 0x6447h/ Case 0x6447-005/SDO Reply/value_To_uint8[4]1" /begin REF_CHARACTERISTIC core_gp_xSwapBytes /end REF_CHARACTERISTIC /end GROUP
/begin GROUP S3870_SDO_Error_Reply "SC_KZQ_EV2274A_4_1/Main/CAN SDO/SDO  0x7C/Case 0x6447h/ Case 0x6447-006/SDO Reply/SDO Error Reply"
 /begin REF_CHARACTERISTIC core_gcp_u8CanSDOCmd_ErrReply core_gcp_u8CanSDOCmd_ErrReply_MainIndexMismatch core_gcp_u8CanSDOCmd_ErrReply_SubIndexMismatch core_gcp_u8CanSDOCmd_ErrReply_WrongCommand /end REF_CHARACTERISTIC
/end GROUP
/begin GROUP S3870_value_To_uint8_4_ "SC_KZQ_EV2274A_4_1/Main/CAN SDO/SDO  0x7C/Case 0x6447h/ Case 0x6447-006/SDO Reply/value_To_uint8[4]" /begin REF_CHARACTERISTIC core_gp_xSwapBytes /end REF_CHARACTERISTIC /end GROUP
/begin GROUP S3870_value_To_uint8_4_1 "SC_KZQ_EV2274A_4_1/Main/CAN SDO/SDO  0x7C/Case 0x6447h/ Case 0x6447-006/SDO Reply/value_To_uint8[4]1" /begin REF_CHARACTERISTIC core_gp_xSwapBytes /end REF_CHARACTERISTIC /end GROUP
/begin GROUP S3906_SDO_Error_Reply "SC_KZQ_EV2274A_4_1/Main/CAN SDO/SDO  0x7C/Case 0x6447h/ Case 0x6447-031/SDO Reply/SDO Error Reply"
 /begin REF_CHARACTERISTIC core_gcp_u8CanSDOCmd_ErrReply core_gcp_u8CanSDOCmd_ErrReply_MainIndexMismatch core_gcp_u8CanSDOCmd_ErrReply_SubIndexMismatch core_gcp_u8CanSDOCmd_ErrReply_WrongCommand /end REF_CHARACTERISTIC
/end GROUP
/begin GROUP S3906_value_To_uint8_4_ "SC_KZQ_EV2274A_4_1/Main/CAN SDO/SDO  0x7C/Case 0x6447h/ Case 0x6447-031/SDO Reply/value_To_uint8[4]" /begin REF_CHARACTERISTIC core_gp_xSwapBytes /end REF_CHARACTERISTIC /end GROUP
/begin GROUP S3906_value_To_uint8_4_1 "SC_KZQ_EV2274A_4_1/Main/CAN SDO/SDO  0x7C/Case 0x6447h/ Case 0x6447-031/SDO Reply/value_To_uint8[4]1" /begin REF_CHARACTERISTIC core_gp_xSwapBytes /end REF_CHARACTERISTIC /end GROUP
/begin GROUP S3942_SDO_Error_Reply "SC_KZQ_EV2274A_4_1/Main/CAN SDO/SDO  0x7C/Case 0x6447h/ Case 0x6447-034/SDO Reply/SDO Error Reply"
 /begin REF_CHARACTERISTIC core_gcp_u8CanSDOCmd_ErrReply core_gcp_u8CanSDOCmd_ErrReply_MainIndexMismatch core_gcp_u8CanSDOCmd_ErrReply_SubIndexMismatch core_gcp_u8CanSDOCmd_ErrReply_WrongCommand /end REF_CHARACTERISTIC
/end GROUP
/begin GROUP S3942_value_To_uint8_4_ "SC_KZQ_EV2274A_4_1/Main/CAN SDO/SDO  0x7C/Case 0x6447h/ Case 0x6447-034/SDO Reply/value_To_uint8[4]" /begin REF_CHARACTERISTIC core_gp_xSwapBytes /end REF_CHARACTERISTIC /end GROUP
/begin GROUP S3942_value_To_uint8_4_1 "SC_KZQ_EV2274A_4_1/Main/CAN SDO/SDO  0x7C/Case 0x6447h/ Case 0x6447-034/SDO Reply/value_To_uint8[4]1" /begin REF_CHARACTERISTIC core_gp_xSwapBytes /end REF_CHARACTERISTIC /end GROUP
/begin GROUP S3978_SDO_Error_Reply "SC_KZQ_EV2274A_4_1/Main/CAN SDO/SDO  0x7C/Case 0x6447h/ Case 0x6447-061/SDO Reply/SDO Error Reply"
 /begin REF_CHARACTERISTIC core_gcp_u8CanSDOCmd_ErrReply core_gcp_u8CanSDOCmd_ErrReply_MainIndexMismatch core_gcp_u8CanSDOCmd_ErrReply_SubIndexMismatch core_gcp_u8CanSDOCmd_ErrReply_WrongCommand /end REF_CHARACTERISTIC
/end GROUP
/begin GROUP S3978_value_To_uint8_4_ "SC_KZQ_EV2274A_4_1/Main/CAN SDO/SDO  0x7C/Case 0x6447h/ Case 0x6447-061/SDO Reply/value_To_uint8[4]" /begin REF_CHARACTERISTIC core_gp_xSwapBytes /end REF_CHARACTERISTIC /end GROUP
/begin GROUP S3978_value_To_uint8_4_1 "SC_KZQ_EV2274A_4_1/Main/CAN SDO/SDO  0x7C/Case 0x6447h/ Case 0x6447-061/SDO Reply/value_To_uint8[4]1" /begin REF_CHARACTERISTIC core_gp_xSwapBytes /end REF_CHARACTERISTIC /end GROUP
/begin GROUP S4014_SDO_Error_Reply "SC_KZQ_EV2274A_4_1/Main/CAN SDO/SDO  0x7C/Case 0x6447h/ Case 0x6447-064/SDO Reply/SDO Error Reply"
 /begin REF_CHARACTERISTIC core_gcp_u8CanSDOCmd_ErrReply core_gcp_u8CanSDOCmd_ErrReply_MainIndexMismatch core_gcp_u8CanSDOCmd_ErrReply_SubIndexMismatch core_gcp_u8CanSDOCmd_ErrReply_WrongCommand /end REF_CHARACTERISTIC
/end GROUP
/begin GROUP S4014_value_To_uint8_4_ "SC_KZQ_EV2274A_4_1/Main/CAN SDO/SDO  0x7C/Case 0x6447h/ Case 0x6447-064/SDO Reply/value_To_uint8[4]" /begin REF_CHARACTERISTIC core_gp_xSwapBytes /end REF_CHARACTERISTIC /end GROUP
/begin GROUP S4014_value_To_uint8_4_1 "SC_KZQ_EV2274A_4_1/Main/CAN SDO/SDO  0x7C/Case 0x6447h/ Case 0x6447-064/SDO Reply/value_To_uint8[4]1" /begin REF_CHARACTERISTIC core_gp_xSwapBytes /end REF_CHARACTERISTIC /end GROUP
/begin GROUP S4050_SDO_Error_Reply "SC_KZQ_EV2274A_4_1/Main/CAN SDO/SDO  0x7C/Case 0x6447h/ Case 0x6447-067/SDO Reply/SDO Error Reply"
 /begin REF_CHARACTERISTIC core_gcp_u8CanSDOCmd_ErrReply core_gcp_u8CanSDOCmd_ErrReply_MainIndexMismatch core_gcp_u8CanSDOCmd_ErrReply_SubIndexMismatch core_gcp_u8CanSDOCmd_ErrReply_WrongCommand /end REF_CHARACTERISTIC
/end GROUP
/begin GROUP S4050_value_To_uint8_4_ "SC_KZQ_EV2274A_4_1/Main/CAN SDO/SDO  0x7C/Case 0x6447h/ Case 0x6447-067/SDO Reply/value_To_uint8[4]" /begin REF_CHARACTERISTIC core_gp_xSwapBytes /end REF_CHARACTERISTIC /end GROUP
/begin GROUP S4050_value_To_uint8_4_1 "SC_KZQ_EV2274A_4_1/Main/CAN SDO/SDO  0x7C/Case 0x6447h/ Case 0x6447-067/SDO Reply/value_To_uint8[4]1" /begin REF_CHARACTERISTIC core_gp_xSwapBytes /end REF_CHARACTERISTIC /end GROUP
/begin GROUP S4086_SDO_Error_Reply "SC_KZQ_EV2274A_4_1/Main/CAN SDO/SDO  0x7C/Case 0x6447h/ Case 0x6447-070/SDO Reply/SDO Error Reply"
 /begin REF_CHARACTERISTIC core_gcp_u8CanSDOCmd_ErrReply core_gcp_u8CanSDOCmd_ErrReply_MainIndexMismatch core_gcp_u8CanSDOCmd_ErrReply_SubIndexMismatch core_gcp_u8CanSDOCmd_ErrReply_WrongCommand /end REF_CHARACTERISTIC
/end GROUP
/begin GROUP S4086_value_To_uint8_4_ "SC_KZQ_EV2274A_4_1/Main/CAN SDO/SDO  0x7C/Case 0x6447h/ Case 0x6447-070/SDO Reply/value_To_uint8[4]" /begin REF_CHARACTERISTIC core_gp_xSwapBytes /end REF_CHARACTERISTIC /end GROUP
/begin GROUP S4086_value_To_uint8_4_1 "SC_KZQ_EV2274A_4_1/Main/CAN SDO/SDO  0x7C/Case 0x6447h/ Case 0x6447-070/SDO Reply/value_To_uint8[4]1" /begin REF_CHARACTERISTIC core_gp_xSwapBytes /end REF_CHARACTERISTIC /end GROUP
/begin GROUP S4122_SDO_Error_Reply "SC_KZQ_EV2274A_4_1/Main/CAN SDO/SDO  0x7C/Case 0x6447h/ Case 0x6447-073/SDO Reply/SDO Error Reply"
 /begin REF_CHARACTERISTIC core_gcp_u8CanSDOCmd_ErrReply core_gcp_u8CanSDOCmd_ErrReply_MainIndexMismatch core_gcp_u8CanSDOCmd_ErrReply_SubIndexMismatch core_gcp_u8CanSDOCmd_ErrReply_WrongCommand /end REF_CHARACTERISTIC
/end GROUP
/begin GROUP S4122_value_To_uint8_4_ "SC_KZQ_EV2274A_4_1/Main/CAN SDO/SDO  0x7C/Case 0x6447h/ Case 0x6447-073/SDO Reply/value_To_uint8[4]" /begin REF_CHARACTERISTIC core_gp_xSwapBytes /end REF_CHARACTERISTIC /end GROUP
/begin GROUP S4122_value_To_uint8_4_1 "SC_KZQ_EV2274A_4_1/Main/CAN SDO/SDO  0x7C/Case 0x6447h/ Case 0x6447-073/SDO Reply/value_To_uint8[4]1" /begin REF_CHARACTERISTIC core_gp_xSwapBytes /end REF_CHARACTERISTIC /end GROUP
/begin GROUP S4158_SDO_Error_Reply "SC_KZQ_EV2274A_4_1/Main/CAN SDO/SDO  0x7C/Case 0x6447h/ Case 0x6447-076/SDO Reply/SDO Error Reply"
 /begin REF_CHARACTERISTIC core_gcp_u8CanSDOCmd_ErrReply core_gcp_u8CanSDOCmd_ErrReply_MainIndexMismatch core_gcp_u8CanSDOCmd_ErrReply_SubIndexMismatch core_gcp_u8CanSDOCmd_ErrReply_WrongCommand /end REF_CHARACTERISTIC
/end GROUP
/begin GROUP S4158_value_To_uint8_4_ "SC_KZQ_EV2274A_4_1/Main/CAN SDO/SDO  0x7C/Case 0x6447h/ Case 0x6447-076/SDO Reply/value_To_uint8[4]" /begin REF_CHARACTERISTIC core_gp_xSwapBytes /end REF_CHARACTERISTIC /end GROUP
/begin GROUP S4158_value_To_uint8_4_1 "SC_KZQ_EV2274A_4_1/Main/CAN SDO/SDO  0x7C/Case 0x6447h/ Case 0x6447-076/SDO Reply/value_To_uint8[4]1" /begin REF_CHARACTERISTIC core_gp_xSwapBytes /end REF_CHARACTERISTIC /end GROUP
/begin GROUP S4194_SDO_Error_Reply "SC_KZQ_EV2274A_4_1/Main/CAN SDO/SDO  0x7C/Case 0x6447h/ Case 0x6447-097/SDO Reply/SDO Error Reply"
 /begin REF_CHARACTERISTIC core_gcp_u8CanSDOCmd_ErrReply core_gcp_u8CanSDOCmd_ErrReply_MainIndexMismatch core_gcp_u8CanSDOCmd_ErrReply_SubIndexMismatch core_gcp_u8CanSDOCmd_ErrReply_WrongCommand /end REF_CHARACTERISTIC
/end GROUP
/begin GROUP S4194_value_To_uint8_4_ "SC_KZQ_EV2274A_4_1/Main/CAN SDO/SDO  0x7C/Case 0x6447h/ Case 0x6447-097/SDO Reply/value_To_uint8[4]" /begin REF_CHARACTERISTIC core_gp_xSwapBytes /end REF_CHARACTERISTIC /end GROUP
/begin GROUP S4194_value_To_uint8_4_1 "SC_KZQ_EV2274A_4_1/Main/CAN SDO/SDO  0x7C/Case 0x6447h/ Case 0x6447-097/SDO Reply/value_To_uint8[4]1" /begin REF_CHARACTERISTIC core_gp_xSwapBytes /end REF_CHARACTERISTIC /end GROUP
/begin GROUP S4230_SDO_Error_Reply "SC_KZQ_EV2274A_4_1/Main/CAN SDO/SDO  0x7C/Case 0x6447h/ Case 0x6447-100/SDO Reply/SDO Error Reply"
 /begin REF_CHARACTERISTIC core_gcp_u8CanSDOCmd_ErrReply core_gcp_u8CanSDOCmd_ErrReply_MainIndexMismatch core_gcp_u8CanSDOCmd_ErrReply_SubIndexMismatch core_gcp_u8CanSDOCmd_ErrReply_WrongCommand /end REF_CHARACTERISTIC
/end GROUP
/begin GROUP S4230_value_To_uint8_4_ "SC_KZQ_EV2274A_4_1/Main/CAN SDO/SDO  0x7C/Case 0x6447h/ Case 0x6447-100/SDO Reply/value_To_uint8[4]" /begin REF_CHARACTERISTIC core_gp_xSwapBytes /end REF_CHARACTERISTIC /end GROUP
/begin GROUP S4230_value_To_uint8_4_1 "SC_KZQ_EV2274A_4_1/Main/CAN SDO/SDO  0x7C/Case 0x6447h/ Case 0x6447-100/SDO Reply/value_To_uint8[4]1" /begin REF_CHARACTERISTIC core_gp_xSwapBytes /end REF_CHARACTERISTIC /end GROUP
/begin GROUP S4266_SDO_Error_Reply "SC_KZQ_EV2274A_4_1/Main/CAN SDO/SDO  0x7C/Case 0x6447h/ Case 0x6447-103/SDO Reply/SDO Error Reply"
 /begin REF_CHARACTERISTIC core_gcp_u8CanSDOCmd_ErrReply core_gcp_u8CanSDOCmd_ErrReply_MainIndexMismatch core_gcp_u8CanSDOCmd_ErrReply_SubIndexMismatch core_gcp_u8CanSDOCmd_ErrReply_WrongCommand /end REF_CHARACTERISTIC
/end GROUP
/begin GROUP S4266_value_To_uint8_4_ "SC_KZQ_EV2274A_4_1/Main/CAN SDO/SDO  0x7C/Case 0x6447h/ Case 0x6447-103/SDO Reply/value_To_uint8[4]" /begin REF_CHARACTERISTIC core_gp_xSwapBytes /end REF_CHARACTERISTIC /end GROUP
/begin GROUP S4266_value_To_uint8_4_1 "SC_KZQ_EV2274A_4_1/Main/CAN SDO/SDO  0x7C/Case 0x6447h/ Case 0x6447-103/SDO Reply/value_To_uint8[4]1" /begin REF_CHARACTERISTIC core_gp_xSwapBytes /end REF_CHARACTERISTIC /end GROUP
/begin GROUP S4302_SDO_Error_Reply "SC_KZQ_EV2274A_4_1/Main/CAN SDO/SDO  0x7C/Case 0x6447h/ Case 0x6447-106/SDO Reply/SDO Error Reply"
 /begin REF_CHARACTERISTIC core_gcp_u8CanSDOCmd_ErrReply core_gcp_u8CanSDOCmd_ErrReply_MainIndexMismatch core_gcp_u8CanSDOCmd_ErrReply_SubIndexMismatch core_gcp_u8CanSDOCmd_ErrReply_WrongCommand /end REF_CHARACTERISTIC
/end GROUP
/begin GROUP S4302_value_To_uint8_4_ "SC_KZQ_EV2274A_4_1/Main/CAN SDO/SDO  0x7C/Case 0x6447h/ Case 0x6447-106/SDO Reply/value_To_uint8[4]" /begin REF_CHARACTERISTIC core_gp_xSwapBytes /end REF_CHARACTERISTIC /end GROUP
/begin GROUP S4302_value_To_uint8_4_1 "SC_KZQ_EV2274A_4_1/Main/CAN SDO/SDO  0x7C/Case 0x6447h/ Case 0x6447-106/SDO Reply/value_To_uint8[4]1" /begin REF_CHARACTERISTIC core_gp_xSwapBytes /end REF_CHARACTERISTIC /end GROUP
/begin GROUP S4338_SDO_Error_Reply "SC_KZQ_EV2274A_4_1/Main/CAN SDO/SDO  0x7C/Case 0x6447h/ Case 0x6447-151/SDO Reply/SDO Error Reply"
 /begin REF_CHARACTERISTIC core_gcp_u8CanSDOCmd_ErrReply core_gcp_u8CanSDOCmd_ErrReply_MainIndexMismatch core_gcp_u8CanSDOCmd_ErrReply_SubIndexMismatch core_gcp_u8CanSDOCmd_ErrReply_WrongCommand /end REF_CHARACTERISTIC
/end GROUP
/begin GROUP S4338_value_To_uint8_4_ "SC_KZQ_EV2274A_4_1/Main/CAN SDO/SDO  0x7C/Case 0x6447h/ Case 0x6447-151/SDO Reply/value_To_uint8[4]" /begin REF_CHARACTERISTIC core_gp_xSwapBytes /end REF_CHARACTERISTIC /end GROUP
/begin GROUP S4338_value_To_uint8_4_1 "SC_KZQ_EV2274A_4_1/Main/CAN SDO/SDO  0x7C/Case 0x6447h/ Case 0x6447-151/SDO Reply/value_To_uint8[4]1" /begin REF_CHARACTERISTIC core_gp_xSwapBytes /end REF_CHARACTERISTIC /end GROUP
/begin GROUP S4374_SDO_Error_Reply "SC_KZQ_EV2274A_4_1/Main/CAN SDO/SDO  0x7C/Case 0x6447h/ Case 0x6447-154/SDO Reply/SDO Error Reply"
 /begin REF_CHARACTERISTIC core_gcp_u8CanSDOCmd_ErrReply core_gcp_u8CanSDOCmd_ErrReply_MainIndexMismatch core_gcp_u8CanSDOCmd_ErrReply_SubIndexMismatch core_gcp_u8CanSDOCmd_ErrReply_WrongCommand /end REF_CHARACTERISTIC
/end GROUP
/begin GROUP S4374_value_To_uint8_4_ "SC_KZQ_EV2274A_4_1/Main/CAN SDO/SDO  0x7C/Case 0x6447h/ Case 0x6447-154/SDO Reply/value_To_uint8[4]" /begin REF_CHARACTERISTIC core_gp_xSwapBytes /end REF_CHARACTERISTIC /end GROUP
/begin GROUP S4374_value_To_uint8_4_1 "SC_KZQ_EV2274A_4_1/Main/CAN SDO/SDO  0x7C/Case 0x6447h/ Case 0x6447-154/SDO Reply/value_To_uint8[4]1" /begin REF_CHARACTERISTIC core_gp_xSwapBytes /end REF_CHARACTERISTIC /end GROUP
/begin GROUP S4410_SDO_Error_Reply "SC_KZQ_EV2274A_4_1/Main/CAN SDO/SDO  0x7C/Case 0x6447h/ Case 0x6447-37/SDO Reply/SDO Error Reply"
 /begin REF_CHARACTERISTIC core_gcp_u8CanSDOCmd_ErrReply core_gcp_u8CanSDOCmd_ErrReply_MainIndexMismatch core_gcp_u8CanSDOCmd_ErrReply_SubIndexMismatch core_gcp_u8CanSDOCmd_ErrReply_WrongCommand /end REF_CHARACTERISTIC
/end GROUP
/begin GROUP S4410_value_To_uint8_4_ "SC_KZQ_EV2274A_4_1/Main/CAN SDO/SDO  0x7C/Case 0x6447h/ Case 0x6447-37/SDO Reply/value_To_uint8[4]" /begin REF_CHARACTERISTIC core_gp_xSwapBytes /end REF_CHARACTERISTIC /end GROUP
/begin GROUP S4410_value_To_uint8_4_1 "SC_KZQ_EV2274A_4_1/Main/CAN SDO/SDO  0x7C/Case 0x6447h/ Case 0x6447-37/SDO Reply/value_To_uint8[4]1" /begin REF_CHARACTERISTIC core_gp_xSwapBytes /end REF_CHARACTERISTIC /end GROUP
/begin GROUP S4446_SDO_Error_Reply "SC_KZQ_EV2274A_4_1/Main/CAN SDO/SDO  0x7C/Case 0x6447h/ Case 0x6447-38/SDO Reply/SDO Error Reply"
 /begin REF_CHARACTERISTIC core_gcp_u8CanSDOCmd_ErrReply core_gcp_u8CanSDOCmd_ErrReply_MainIndexMismatch core_gcp_u8CanSDOCmd_ErrReply_SubIndexMismatch core_gcp_u8CanSDOCmd_ErrReply_WrongCommand /end REF_CHARACTERISTIC
/end GROUP
/begin GROUP S4446_value_To_uint8_4_ "SC_KZQ_EV2274A_4_1/Main/CAN SDO/SDO  0x7C/Case 0x6447h/ Case 0x6447-38/SDO Reply/value_To_uint8[4]" /begin REF_CHARACTERISTIC core_gp_xSwapBytes /end REF_CHARACTERISTIC /end GROUP
/begin GROUP S4446_value_To_uint8_4_1 "SC_KZQ_EV2274A_4_1/Main/CAN SDO/SDO  0x7C/Case 0x6447h/ Case 0x6447-38/SDO Reply/value_To_uint8[4]1" /begin REF_CHARACTERISTIC core_gp_xSwapBytes /end REF_CHARACTERISTIC /end GROUP
/begin GROUP S4491_SDO_Error_Reply "SC_KZQ_EV2274A_4_1/Main/CAN SDO/SDO  0x7C/Case 0x6508h/ Case 0x6508-001/SDO Reply/SDO Error Reply"
 /begin REF_CHARACTERISTIC core_gcp_u8CanSDOCmd_ErrReply core_gcp_u8CanSDOCmd_ErrReply_MainIndexMismatch core_gcp_u8CanSDOCmd_ErrReply_SubIndexMismatch core_gcp_u8CanSDOCmd_ErrReply_WrongCommand /end REF_CHARACTERISTIC
/end GROUP
/begin GROUP S4491_value_To_uint8_4_ "SC_KZQ_EV2274A_4_1/Main/CAN SDO/SDO  0x7C/Case 0x6508h/ Case 0x6508-001/SDO Reply/value_To_uint8[4]" /begin REF_CHARACTERISTIC core_gp_xSwapBytes /end REF_CHARACTERISTIC /end GROUP
/begin GROUP S4491_value_To_uint8_4_1 "SC_KZQ_EV2274A_4_1/Main/CAN SDO/SDO  0x7C/Case 0x6508h/ Case 0x6508-001/SDO Reply/value_To_uint8[4]1" /begin REF_CHARACTERISTIC core_gp_xSwapBytes /end REF_CHARACTERISTIC /end GROUP
/begin GROUP S4527_SDO_Error_Reply "SC_KZQ_EV2274A_4_1/Main/CAN SDO/SDO  0x7C/Case 0x6508h/ Case 0x6508-010/SDO Reply/SDO Error Reply"
 /begin REF_CHARACTERISTIC core_gcp_u8CanSDOCmd_ErrReply core_gcp_u8CanSDOCmd_ErrReply_MainIndexMismatch core_gcp_u8CanSDOCmd_ErrReply_SubIndexMismatch core_gcp_u8CanSDOCmd_ErrReply_WrongCommand /end REF_CHARACTERISTIC
/end GROUP
/begin GROUP S4527_value_To_uint8_4_ "SC_KZQ_EV2274A_4_1/Main/CAN SDO/SDO  0x7C/Case 0x6508h/ Case 0x6508-010/SDO Reply/value_To_uint8[4]" /begin REF_CHARACTERISTIC core_gp_xSwapBytes /end REF_CHARACTERISTIC /end GROUP
/begin GROUP S4527_value_To_uint8_4_1 "SC_KZQ_EV2274A_4_1/Main/CAN SDO/SDO  0x7C/Case 0x6508h/ Case 0x6508-010/SDO Reply/value_To_uint8[4]1" /begin REF_CHARACTERISTIC core_gp_xSwapBytes /end REF_CHARACTERISTIC /end GROUP
/begin GROUP S4563_SDO_Error_Reply "SC_KZQ_EV2274A_4_1/Main/CAN SDO/SDO  0x7C/Case 0x6508h/ Case 0x6508-020/SDO Reply/SDO Error Reply"
 /begin REF_CHARACTERISTIC core_gcp_u8CanSDOCmd_ErrReply core_gcp_u8CanSDOCmd_ErrReply_MainIndexMismatch core_gcp_u8CanSDOCmd_ErrReply_SubIndexMismatch core_gcp_u8CanSDOCmd_ErrReply_WrongCommand /end REF_CHARACTERISTIC
/end GROUP
/begin GROUP S4563_value_To_uint8_4_ "SC_KZQ_EV2274A_4_1/Main/CAN SDO/SDO  0x7C/Case 0x6508h/ Case 0x6508-020/SDO Reply/value_To_uint8[4]" /begin REF_CHARACTERISTIC core_gp_xSwapBytes /end REF_CHARACTERISTIC /end GROUP
/begin GROUP S4563_value_To_uint8_4_1 "SC_KZQ_EV2274A_4_1/Main/CAN SDO/SDO  0x7C/Case 0x6508h/ Case 0x6508-020/SDO Reply/value_To_uint8[4]1" /begin REF_CHARACTERISTIC core_gp_xSwapBytes /end REF_CHARACTERISTIC /end GROUP
/begin GROUP S4607_SDO_Error_Reply "SC_KZQ_EV2274A_4_1/Main/CAN SDO/SDO  0x7C/Case 0x6510h/ Case 0x6510-001/SDO Reply/SDO Error Reply"
 /begin REF_CHARACTERISTIC core_gcp_u8CanSDOCmd_ErrReply core_gcp_u8CanSDOCmd_ErrReply_MainIndexMismatch core_gcp_u8CanSDOCmd_ErrReply_SubIndexMismatch core_gcp_u8CanSDOCmd_ErrReply_WrongCommand /end REF_CHARACTERISTIC
/end GROUP
/begin GROUP S4607_value_To_uint8_4_ "SC_KZQ_EV2274A_4_1/Main/CAN SDO/SDO  0x7C/Case 0x6510h/ Case 0x6510-001/SDO Reply/value_To_uint8[4]" /begin REF_CHARACTERISTIC core_gp_xSwapBytes /end REF_CHARACTERISTIC /end GROUP
/begin GROUP S4607_value_To_uint8_4_1 "SC_KZQ_EV2274A_4_1/Main/CAN SDO/SDO  0x7C/Case 0x6510h/ Case 0x6510-001/SDO Reply/value_To_uint8[4]1" /begin REF_CHARACTERISTIC core_gp_xSwapBytes /end REF_CHARACTERISTIC /end GROUP
/begin GROUP S4643_SDO_Error_Reply "SC_KZQ_EV2274A_4_1/Main/CAN SDO/SDO  0x7C/Case 0x6510h/ Case 0x6510-002/SDO Reply/SDO Error Reply"
 /begin REF_CHARACTERISTIC core_gcp_u8CanSDOCmd_ErrReply core_gcp_u8CanSDOCmd_ErrReply_MainIndexMismatch core_gcp_u8CanSDOCmd_ErrReply_SubIndexMismatch core_gcp_u8CanSDOCmd_ErrReply_WrongCommand /end REF_CHARACTERISTIC
/end GROUP
/begin GROUP S4643_value_To_uint8_4_ "SC_KZQ_EV2274A_4_1/Main/CAN SDO/SDO  0x7C/Case 0x6510h/ Case 0x6510-002/SDO Reply/value_To_uint8[4]" /begin REF_CHARACTERISTIC core_gp_xSwapBytes /end REF_CHARACTERISTIC /end GROUP
/begin GROUP S4643_value_To_uint8_4_1 "SC_KZQ_EV2274A_4_1/Main/CAN SDO/SDO  0x7C/Case 0x6510h/ Case 0x6510-002/SDO Reply/value_To_uint8[4]1" /begin REF_CHARACTERISTIC core_gp_xSwapBytes /end REF_CHARACTERISTIC /end GROUP
/begin GROUP S4904_SDO_Error_Reply "SC_KZQ_EV2274A_4_1/Main/GPS /SDO  0x7B/Case 0x6520h(25888)/ Case 0x6520-001/SDO Reply/SDO Error Reply"
 /begin REF_CHARACTERISTIC core_gcp_u8CanSDOCmd_ErrReply core_gcp_u8CanSDOCmd_ErrReply_MainIndexMismatch core_gcp_u8CanSDOCmd_ErrReply_SubIndexMismatch core_gcp_u8CanSDOCmd_ErrReply_WrongCommand /end REF_CHARACTERISTIC
/end GROUP
/begin GROUP S4904_value_To_uint8_4_ "SC_KZQ_EV2274A_4_1/Main/GPS /SDO  0x7B/Case 0x6520h(25888)/ Case 0x6520-001/SDO Reply/value_To_uint8[4]" /begin REF_CHARACTERISTIC core_gp_xSwapBytes /end REF_CHARACTERISTIC /end GROUP
/begin GROUP S4904_value_To_uint8_4_1 "SC_KZQ_EV2274A_4_1/Main/GPS /SDO  0x7B/Case 0x6520h(25888)/ Case 0x6520-001/SDO Reply/value_To_uint8[4]1" /begin REF_CHARACTERISTIC core_gp_xSwapBytes /end REF_CHARACTERISTIC /end GROUP
/begin GROUP S4940_SDO_Error_Reply "SC_KZQ_EV2274A_4_1/Main/GPS /SDO  0x7B/Case 0x6520h(25888)/ Case 0x6520-002/SDO Reply/SDO Error Reply"
 /begin REF_CHARACTERISTIC core_gcp_u8CanSDOCmd_ErrReply core_gcp_u8CanSDOCmd_ErrReply_MainIndexMismatch core_gcp_u8CanSDOCmd_ErrReply_SubIndexMismatch core_gcp_u8CanSDOCmd_ErrReply_WrongCommand /end REF_CHARACTERISTIC
/end GROUP
/begin GROUP S4940_value_To_uint8_4_ "SC_KZQ_EV2274A_4_1/Main/GPS /SDO  0x7B/Case 0x6520h(25888)/ Case 0x6520-002/SDO Reply/value_To_uint8[4]" /begin REF_CHARACTERISTIC core_gp_xSwapBytes /end REF_CHARACTERISTIC /end GROUP
/begin GROUP S4940_value_To_uint8_4_1 "SC_KZQ_EV2274A_4_1/Main/GPS /SDO  0x7B/Case 0x6520h(25888)/ Case 0x6520-002/SDO Reply/value_To_uint8[4]1" /begin REF_CHARACTERISTIC core_gp_xSwapBytes /end REF_CHARACTERISTIC /end GROUP
/begin GROUP S4976_SDO_Error_Reply "SC_KZQ_EV2274A_4_1/Main/GPS /SDO  0x7B/Case 0x6520h(25888)/ Case 0x6520-003/SDO Reply/SDO Error Reply"
 /begin REF_CHARACTERISTIC core_gcp_u8CanSDOCmd_ErrReply core_gcp_u8CanSDOCmd_ErrReply_MainIndexMismatch core_gcp_u8CanSDOCmd_ErrReply_SubIndexMismatch core_gcp_u8CanSDOCmd_ErrReply_WrongCommand /end REF_CHARACTERISTIC
/end GROUP
/begin GROUP S4976_value_To_uint8_4_ "SC_KZQ_EV2274A_4_1/Main/GPS /SDO  0x7B/Case 0x6520h(25888)/ Case 0x6520-003/SDO Reply/value_To_uint8[4]" /begin REF_CHARACTERISTIC core_gp_xSwapBytes /end REF_CHARACTERISTIC /end GROUP
/begin GROUP S4976_value_To_uint8_4_1 "SC_KZQ_EV2274A_4_1/Main/GPS /SDO  0x7B/Case 0x6520h(25888)/ Case 0x6520-003/SDO Reply/value_To_uint8[4]1" /begin REF_CHARACTERISTIC core_gp_xSwapBytes /end REF_CHARACTERISTIC /end GROUP
/begin GROUP S5012_SDO_Error_Reply "SC_KZQ_EV2274A_4_1/Main/GPS /SDO  0x7B/Case 0x6520h(25888)/ Case 0x6520-004/SDO Reply/SDO Error Reply"
 /begin REF_CHARACTERISTIC core_gcp_u8CanSDOCmd_ErrReply core_gcp_u8CanSDOCmd_ErrReply_MainIndexMismatch core_gcp_u8CanSDOCmd_ErrReply_SubIndexMismatch core_gcp_u8CanSDOCmd_ErrReply_WrongCommand /end REF_CHARACTERISTIC
/end GROUP
/begin GROUP S5012_value_To_uint8_4_ "SC_KZQ_EV2274A_4_1/Main/GPS /SDO  0x7B/Case 0x6520h(25888)/ Case 0x6520-004/SDO Reply/value_To_uint8[4]" /begin REF_CHARACTERISTIC core_gp_xSwapBytes /end REF_CHARACTERISTIC /end GROUP
/begin GROUP S5012_value_To_uint8_4_1 "SC_KZQ_EV2274A_4_1/Main/GPS /SDO  0x7B/Case 0x6520h(25888)/ Case 0x6520-004/SDO Reply/value_To_uint8[4]1" /begin REF_CHARACTERISTIC core_gp_xSwapBytes /end REF_CHARACTERISTIC /end GROUP
/begin GROUP S5048_SDO_Error_Reply "SC_KZQ_EV2274A_4_1/Main/GPS /SDO  0x7B/Case 0x6520h(25888)/ Case 0x6520-005/SDO Reply/SDO Error Reply"
 /begin REF_CHARACTERISTIC core_gcp_u8CanSDOCmd_ErrReply core_gcp_u8CanSDOCmd_ErrReply_MainIndexMismatch core_gcp_u8CanSDOCmd_ErrReply_SubIndexMismatch core_gcp_u8CanSDOCmd_ErrReply_WrongCommand /end REF_CHARACTERISTIC
/end GROUP
/begin GROUP S5048_value_To_uint8_4_ "SC_KZQ_EV2274A_4_1/Main/GPS /SDO  0x7B/Case 0x6520h(25888)/ Case 0x6520-005/SDO Reply/value_To_uint8[4]" /begin REF_CHARACTERISTIC core_gp_xSwapBytes /end REF_CHARACTERISTIC /end GROUP
/begin GROUP S5048_value_To_uint8_4_1 "SC_KZQ_EV2274A_4_1/Main/GPS /SDO  0x7B/Case 0x6520h(25888)/ Case 0x6520-005/SDO Reply/value_To_uint8[4]1" /begin REF_CHARACTERISTIC core_gp_xSwapBytes /end REF_CHARACTERISTIC /end GROUP
/begin GROUP S5084_SDO_Error_Reply "SC_KZQ_EV2274A_4_1/Main/GPS /SDO  0x7B/Case 0x6520h(25888)/ Case 0x6520-010/SDO Reply/SDO Error Reply"
 /begin REF_CHARACTERISTIC core_gcp_u8CanSDOCmd_ErrReply core_gcp_u8CanSDOCmd_ErrReply_MainIndexMismatch core_gcp_u8CanSDOCmd_ErrReply_SubIndexMismatch core_gcp_u8CanSDOCmd_ErrReply_WrongCommand /end REF_CHARACTERISTIC
/end GROUP
/begin GROUP S5084_value_To_uint8_4_ "SC_KZQ_EV2274A_4_1/Main/GPS /SDO  0x7B/Case 0x6520h(25888)/ Case 0x6520-010/SDO Reply/value_To_uint8[4]" /begin REF_CHARACTERISTIC core_gp_xSwapBytes /end REF_CHARACTERISTIC /end GROUP
/begin GROUP S5084_value_To_uint8_4_1 "SC_KZQ_EV2274A_4_1/Main/GPS /SDO  0x7B/Case 0x6520h(25888)/ Case 0x6520-010/SDO Reply/value_To_uint8[4]1" /begin REF_CHARACTERISTIC core_gp_xSwapBytes /end REF_CHARACTERISTIC /end GROUP
/begin GROUP S5121_SDO_Error_Reply "SC_KZQ_EV2274A_4_1/Main/GPS /SDO  0x7B/Case 0x6520h(25888)/ Case 0x6520-011/SDO Reply/SDO Error Reply"
 /begin REF_CHARACTERISTIC core_gcp_u8CanSDOCmd_ErrReply core_gcp_u8CanSDOCmd_ErrReply_MainIndexMismatch core_gcp_u8CanSDOCmd_ErrReply_SubIndexMismatch core_gcp_u8CanSDOCmd_ErrReply_WrongCommand /end REF_CHARACTERISTIC
/end GROUP
/begin GROUP S5121_value_To_uint8_4_ "SC_KZQ_EV2274A_4_1/Main/GPS /SDO  0x7B/Case 0x6520h(25888)/ Case 0x6520-011/SDO Reply/value_To_uint8[4]" /begin REF_CHARACTERISTIC core_gp_xSwapBytes /end REF_CHARACTERISTIC /end GROUP
/begin GROUP S5121_value_To_uint8_4_1 "SC_KZQ_EV2274A_4_1/Main/GPS /SDO  0x7B/Case 0x6520h(25888)/ Case 0x6520-011/SDO Reply/value_To_uint8[4]1" /begin REF_CHARACTERISTIC core_gp_xSwapBytes /end REF_CHARACTERISTIC /end GROUP
/end MODULE
/end PROJECT
