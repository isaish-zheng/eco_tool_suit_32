/******************************************************************************
* ASAP2 file: xjmain.a2l
* Code generation for model "xjmain".
* Model version : 6.488
* Simulink Coder version : 9.9 (R2023a) 19-Nov-2022
* C source code generated on : Wed Jun 26 09:46:13 2024
* Target selection: MPC5644A.tlc
* Embedded hardware selection: Freescale->MPC55xx
* Code generation objectives: Unspecified
* Validation result: Not run
* (add additional file header information here)
******************************************************************************/
/* Version 1.31 */
ASAP2_VERSION 1 31
/begin PROJECT ProjectName "Project Comment Goes Here"
/begin HEADER "Header Comments go here" /end HEADER
/begin MODULE ModuleName "Module Comment Goes Here"
/* EcoCoder v2.9.13 R5 Target:EV2274A verCalTool:0.0*/
/* XCP-En:0 XCPCalTool:CANape CANape XCP-CAN:CAN_CTRL_C XCP-CAN-Baud:250000bps*/
/* CCP-En:1 CCP-TYPE:Configurable CCPCalTool:CANape CCP-CAN:CAN_CTRL_B CCP-CAN-Baud:250000bps*/
/*PGCANAEn:NoUse PGCANAStation:NoUse PGCANABaud:NoUsekbps PGCANACRO:NoUse PGCANADTO:NoUse*/
/*PGCANBEn:NoUse PGCANBStation:NoUse PGCANBBaud:250kbps PGCANBCRO:NoUse PGCANBDTO:NoUse*/
/*PGCANCEn:NoUse PGCANCStation:NoUse PGCANCBaud:250kbps PGCANCCRO:NoUse PGCANCDTO:NoUse*/
/*PGCANDEn:NoUse PGCANDStation:NoUse PGCANDBaud:NoUsekbps PGCANDCRO:NoUse PGCANDDTO:NoUse*/
/*ECO_XCP_Note_Start
/begin IF_DATA XCP
/begin PROTOCOL_LAYER
0x0100
0x07D0
0x2710
0x3E8
0x2710
0x3E8
0x19
0x19
0x08
0x08
BYTE_ORDER_MSB_FIRST
ADDRESS_GRANULARITY_BYTE
OPTIONAL_CMD ALLOC_ODT_ENTRY
OPTIONAL_CMD ALLOC_ODT
OPTIONAL_CMD ALLOC_DAQ
OPTIONAL_CMD FREE_DAQ
OPTIONAL_CMD GET_DAQ_EVENT_INFO
OPTIONAL_CMD GET_DAQ_RESOLUTION_INFO
OPTIONAL_CMD GET_DAQ_PROCESSOR_INFO
OPTIONAL_CMD START_STOP_SYNCH
OPTIONAL_CMD START_STOP_DAQ_LIST
OPTIONAL_CMD GET_DAQ_LIST_MODE
OPTIONAL_CMD SET_DAQ_LIST_MODE
OPTIONAL_CMD WRITE_DAQ
OPTIONAL_CMD SET_DAQ_PTR
OPTIONAL_CMD CLEAR_DAQ_LIST
OPTIONAL_CMD DOWNLOAD
OPTIONAL_CMD SHORT_UPLOAD
OPTIONAL_CMD UPLOAD
OPTIONAL_CMD SET_MTA
OPTIONAL_CMD UNLOCK
OPTIONAL_CMD GET_SEED
OPTIONAL_CMD GET_ID
OPTIONAL_CMD GET_COMM_MODE_INFO
OPTIONAL_CMD BUILD_CHECKSUM
SEED_AND_KEY_EXTERNAL_FUNCTION ""
/end PROTOCOL_LAYER
/begin DAQ
DYNAMIC
0x00
0x05
0x00
OPTIMISATION_TYPE_DEFAULT
ADDRESS_EXTENSION_FREE
IDENTIFICATION_FIELD_TYPE_ABSOLUTE
GRANULARITY_ODT_ENTRY_SIZE_DAQ_BYTE
0x07
OVERLOAD_INDICATION_PID
/begin STIM
GRANULARITY_ODT_ENTRY_SIZE_STIM_BYTE
0x07
/end STIM
/begin EVENT
"5ms"
"5ms"
0x00
DAQ
0x01
0x05
0x06
0x00
/end EVENT
/begin EVENT
"20ms"
"20ms"
0x01
DAQ
0x01
0x02
0x07
0x00
/end EVENT
/begin EVENT
"50ms"
"50ms"
0x02
DAQ
0x01
0x05
0x07
0x00
/end EVENT
/begin EVENT
"100ms"
"100ms"
0x03
DAQ
0x01
0x01
0x08
0x00
/end EVENT
/begin EVENT
"200ms"
"200m"
0x04
DAQ
0x01
0x02
0x08
0x00
/end EVENT
/end DAQ
/begin PAG
0x00
/end PAG
/begin PGM
PGM_MODE_ABSOLUTE
0x00
0x00
/end PGM
/begin XCP_ON_CAN
0x0100
CAN_ID_MASTER 0x100
CAN_ID_SLAVE 0x101
BAUDRATE 250000
SAMPLE_POINT 0x4B
SAMPLE_RATE SINGLE
BTL_CYCLES 0x08
SJW 0x02
SYNC_EDGE SINGLE
/end XCP_ON_CAN
/end IF_DATA
/begin IF_DATA CANAPE_ADDRESS_UPDATE
/end IF_DATA
/begin MOD_PAR "_default_ModParComment"
/begin MEMORY_SEGMENT _ROMCAL
"calibration_rom"
DATA
FLASH
INTERN
0x00FD0000
0x8000
-1 -1 -1 -1 -1
/begin IF_DATA XCP
/begin SEGMENT
0x00
0x01
0x00
0x00
0x00
/begin CHECKSUM
XCP_CRC_16_CITT
MAX_BLOCK_SIZE 0xFFFF
EXTERNAL_FUNCTION "String.Empty"
/end CHECKSUM
/begin PAGE
0x00
ECU_ACCESS_DONT_CARE
XCP_READ_ACCESS_DONT_CARE
XCP_WRITE_ACCESS_DONT_CARE
INIT_SEGMENT 0x00
/end PAGE
/begin ADDRESS_MAPPING
0x00FD0000
0x40000000
0x8000
/end ADDRESS_MAPPING
/end SEGMENT
/end IF_DATA
/end MEMORY_SEGMENT
/begin MEMORY_SEGMENT _CODE
"ecu_code"
CODE
FLASH
INTERN
0x01000200
0x1FFA00
-1 -1 -1 -1 -1
/end MEMORY_SEGMENT
/end MOD_PAR
ECO_XCP_Note_End*/
/*ECO_CCP_Note_Start*/
/begin MOD_PAR "_default_ModParComment" ADDR_EPK 0x01000100 EPK "EcoCoder v2.9.13 R5 2024-06-26 09:46:19" /*EcoCoderINCAStart
/begin MEMORY_SEGMENT _RAMCAL
"calibration_ram"
DATA
RAM
INTERN
0x40000000
0x8000
-1 -1 -1 -1 -1
/end MEMORY_SEGMENT
EcoCoderINCAEnd*/
 /begin MEMORY_SEGMENT _ROMCAL "calibration_rom" DATA FLASH INTERN 0x00FD0000 0x8000 -1 -1 -1 -1 -1
  /begin IF_DATA ASAP1B_CCP /*EcoCoderINCAStart
ADDRESS_MAPPING 0x00FD0000 0x40000000 0x8000
EcoCoderINCAEnd*/ ADDR_MAPPING 0x00FD0000 0x40000000 0x8000 /end IF_DATA
 /end MEMORY_SEGMENT
 /begin MEMORY_SEGMENT _epk_data "epk_data" DATA FLASH INTERN 0x01000100 0xFF -1 -1 -1 -1 -1
  /begin IF_DATA ASAP1B_CCP /*EcoCoderINCAStart
ADDRESS_MAPPING 0x01000100 0x01000100 0xFF
EcoCoderINCAEnd*/ ADDR_MAPPING 0x01000100 0x01000100 0xFF /end IF_DATA
 /end MEMORY_SEGMENT
 /begin MEMORY_SEGMENT _CODE "ecu_code" CODE FLASH INTERN 0x01000200 0x1FFA00 -1 -1 -1 -1 -1 /end MEMORY_SEGMENT
/end MOD_PAR
/begin IF_DATA ASAP1B_CCP
 /begin SOURCE "20ms" 3 20 DISPLAY_IDENTIFIER DAQ2
  /begin QP_BLOB 1 LENGTH 0x20 CAN_ID_FIXED 0x101 RASTER 1 REDUCTION_ALLOWED FIRST_PID 0x3C /end QP_BLOB
 /end SOURCE
 /begin SOURCE "100ms" 3 100 DISPLAY_IDENTIFIER DAQ3
  /begin QP_BLOB 2 LENGTH 0x30 CAN_ID_FIXED 0x101 RASTER 2 REDUCTION_ALLOWED FIRST_PID 0x78 /end QP_BLOB
 /end SOURCE
 /begin RASTER "20ms" "20ms" 1 3 20 /end RASTER
 /begin RASTER "100ms" "100ms" 2 3 100 /end RASTER
 /begin SEED_KEY "" "" "" /end SEED_KEY
 /begin CHECKSUM "CRC16.dll" /end CHECKSUM
 /begin TP_BLOB 0x0201 0x0204 0x100 0x101 0x112 1 BAUDRATE 250000 SAMPLE_POINT 70 SAMPLE_RATE 1 BTL_CYCLES 10 SJW 1 SYNC_EDGE SINGLE DAQ_MODE 0 CONSISTENCY 1 ADDRESS_EXTENSION 0 RESUME_SUPPORTED STORE_SUPPORTED
  /begin CHECKSUM_PARAM /*EcoCoderINCAStart
0x9001
EcoCoderINCAEnd*/ 0x0C 0xffffffff CHECKSUM_CALCULATION ACTIVE_PAGE /end CHECKSUM_PARAM
  /begin DEFINED_PAGES 0x00 "RAM_PAGE" 0x00 0x40000000 0x8000 RAM RAM_INIT_BY_ECU /end DEFINED_PAGES
  OPTIONAL_CMD 0X5 OPTIONAL_CMD 0X8 OPTIONAL_CMD 0X9 OPTIONAL_CMD 0XC OPTIONAL_CMD 0XD OPTIONAL_CMD 0XE OPTIONAL_CMD 0XF OPTIONAL_CMD 0X10 OPTIONAL_CMD 0X11 OPTIONAL_CMD 0X12 OPTIONAL_CMD 0X13 OPTIONAL_CMD 0X18 OPTIONAL_CMD 0X19 OPTIONAL_CMD 0X20 OPTIONAL_CMD 0X21 OPTIONAL_CMD 0X22 OPTIONAL_CMD 0X23 /end TP_BLOB
/end IF_DATA
/*ECO_CCP_Note_End*/
/begin MOD_COMMON "" /* Comment */ ALIGNMENT_BYTE 1 ALIGNMENT_WORD 1 ALIGNMENT_LONG 1 ALIGNMENT_FLOAT32_IEEE 1 ALIGNMENT_FLOAT64_IEEE 1 BYTE_ORDER MSB_FIRST DEPOSIT ABSOLUTE /end MOD_COMMON
/begin RECORD_LAYOUT Scalar_BOOLEAN FNC_VALUES 1 UBYTE COLUMN_DIR DIRECT /end RECORD_LAYOUT
/begin RECORD_LAYOUT Scalar_UBYTE FNC_VALUES 1 UBYTE COLUMN_DIR DIRECT /end RECORD_LAYOUT
/begin RECORD_LAYOUT Scalar_BYTE FNC_VALUES 1 SBYTE COLUMN_DIR DIRECT /end RECORD_LAYOUT
/begin RECORD_LAYOUT Scalar_UWORD FNC_VALUES 1 UWORD COLUMN_DIR DIRECT /end RECORD_LAYOUT
/begin RECORD_LAYOUT Scalar_SWORD FNC_VALUES 1 SWORD COLUMN_DIR DIRECT /end RECORD_LAYOUT
/begin RECORD_LAYOUT Scalar_LONG FNC_VALUES 1 SLONG COLUMN_DIR DIRECT /end RECORD_LAYOUT
/begin RECORD_LAYOUT Scalar_FLOAT32_IEEE FNC_VALUES 1 FLOAT32_IEEE COLUMN_DIR DIRECT /end RECORD_LAYOUT
/begin RECORD_LAYOUT Scalar_FLOAT64_IEEE FNC_VALUES 1 FLOAT64_IEEE COLUMN_DIR DIRECT /end RECORD_LAYOUT
/begin RECORD_LAYOUT Lookup1D_BOOLEAN FNC_VALUES 1 UBYTE COLUMN_DIR DIRECT /end RECORD_LAYOUT
/begin RECORD_LAYOUT Lookup1D_X_BOOLEAN AXIS_PTS_X 1 UBYTE INDEX_INCR DIRECT /end RECORD_LAYOUT
/begin CHARACTERISTIC apddcalvlu_u16DmotSpdReq "" VALUE 0xfd027a /* @ECU_Address@apddcalvlu_u16DmotSpdReq@ */ Scalar_SWORD 0 xjmain_CM_int16 -6000.0 6000.0 /end CHARACTERISTIC
/begin CHARACTERISTIC apddcalvlu_u16PmotSpdReq "" VALUE 0xfd027c /* @ECU_Address@apddcalvlu_u16PmotSpdReq@ */ Scalar_SWORD 0 xjmain_CM_int16 -6000.0 6000.0 /end CHARACTERISTIC
/begin CHARACTERISTIC mmctcalvlu_i16DmcuSpdReq "" VALUE 0xfd0368 /* @ECU_Address@mmctcalvlu_i16DmcuSpdReq@ */ Scalar_SWORD 0 xjmain_CM_int16 -4000.0 4000.0 /end CHARACTERISTIC
/begin CHARACTERISTIC mmctcalvlu_i16PmcuSpdReq "" VALUE 0xfd036a /* @ECU_Address@mmctcalvlu_i16PmcuSpdReq@ */ Scalar_SWORD 0 xjmain_CM_int16 -6000.0 6000.0 /end CHARACTERISTIC
/begin CHARACTERISTIC apddcalvlu_fDmotTrqReq "" VALUE 0xfd0278 /* @ECU_Address@apddcalvlu_fDmotTrqReq@ */ Scalar_SWORD 0 xjmain_CM_sfix16_En2_Nm -4000.0 4000.0 /end CHARACTERISTIC
/begin CHARACTERISTIC fdstcalvlu_fDmotBrTrqLmt "" VALUE 0xfd0328 /* @ECU_Address@fdstcalvlu_fDmotBrTrqLmt@ */ Scalar_SWORD 0 xjmain_CM_sfix16_En2 -4000.0 4000.0 /end CHARACTERISTIC
/begin CHARACTERISTIC fdstcalvlu_fDmotDrTrqLmt "" VALUE 0xfd032a /* @ECU_Address@fdstcalvlu_fDmotDrTrqLmt@ */ Scalar_SWORD 0 xjmain_CM_sfix16_En2 0.0 4000.0 /end CHARACTERISTIC
/begin CHARACTERISTIC mmctcalvlu_fDmcuTrqReq "" VALUE 0xfd0364 /* @ECU_Address@mmctcalvlu_fDmcuTrqReq@ */ Scalar_SWORD 0 xjmain_CM_sfix16_En2_none -4000.0 4000.0 /end CHARACTERISTIC
/begin CHARACTERISTIC mmctcalvlu_fPmcuTrqReq "" VALUE 0xfd0366 /* @ECU_Address@mmctcalvlu_fPmcuTrqReq@ */ Scalar_SWORD 0 xjmain_CM_sfix16_En2_none -4000.0 4000.0 /end CHARACTERISTIC
/begin CHARACTERISTIC rbctcalvlu_fRgBrTrqReq "" VALUE 0xfd03f4 /* @ECU_Address@rbctcalvlu_fRgBrTrqReq@ */ Scalar_SWORD 0 xjmain_CM_sfix16_En2 -4000.0 0.0 /end CHARACTERISTIC
/begin CHARACTERISTIC scpccalvlu_fDmcuMaxDrTrq "" VALUE 0xfd0424 /* @ECU_Address@scpccalvlu_fDmcuMaxDrTrq@ */ Scalar_SWORD 0 xjmain_CM_sfix16_En2 0.0 4000.0 /end CHARACTERISTIC
/begin CHARACTERISTIC scpccalvlu_fDmcuMaxRgBrTrq "" VALUE 0xfd0426 /* @ECU_Address@scpccalvlu_fDmcuMaxRgBrTrq@ */ Scalar_SWORD 0 xjmain_CM_sfix16_En2 0.0 4000.0 /end CHARACTERISTIC
/begin CHARACTERISTIC tftacalvlu_fDmcuTrqReq "" VALUE 0xfd0430 /* @ECU_Address@tftacalvlu_fDmcuTrqReq@ */ Scalar_SWORD 0 xjmain_CM_sfix16_En2 -4000.0 4000.0 /end CHARACTERISTIC
/begin CHARACTERISTIC obccalvlu_fChgCurrSet "" VALUE 0xfd0378 /* @ECU_Address@obccalvlu_fChgCurrSet@ */ Scalar_UWORD 0 xjmain_CM_ufix16_En2 0.0 1000.0 /end CHARACTERISTIC
/begin CHARACTERISTIC glc_PDU_DCAC_TGT_SPD "" VALUE 0xfd0346 /* @ECU_Address@glc_PDU_DCAC_TGT_SPD@ */ Scalar_UWORD 0 xjmain_CM_ufix16_En3 0.0 3000.0 /end CHARACTERISTIC
/begin CHARACTERISTIC aiptc_fSkylightPressStopEngine_bar "" VALUE 0xfd0056 /* @ECU_Address@aiptc_fSkylightPressStopEngine_bar@ */ Scalar_UWORD 0 xjmain_CM_ufix16_En4_none 0.0 20.0 /end CHARACTERISTIC
/begin CHARACTERISTIC aiptcalvlu_fAirPumpPress_bar "" VALUE 0xfd0088 /* @ECU_Address@aiptcalvlu_fAirPumpPress_bar@ */ Scalar_UWORD 0 xjmain_CM_ufix16_En4_none 0.0 100.0 /end CHARACTERISTIC
/begin CHARACTERISTIC aiptcalvlu_fSkylightPress_bar "" VALUE 0xfd008e /* @ECU_Address@aiptcalvlu_fSkylightPress_bar@ */ Scalar_UWORD 0 xjmain_CM_ufix16_En4_none 0.0 100.0 /end CHARACTERISTIC
/begin CHARACTERISTIC obccalvlu_fChgVoltSet "" VALUE 0xfd037a /* @ECU_Address@obccalvlu_fChgVoltSet@ */ Scalar_UWORD 0 xjmain_CM_ufix16_En4 0.0 1000.0 /end CHARACTERISTIC
/begin CHARACTERISTIC aiptcalvlu_fHW_t "" VALUE 0xfd008c /* @ECU_Address@aiptcalvlu_fHW_t@ */ Scalar_UWORD 0 xjmain_CM_ufix16_En6_none 0.0 200.0 /end CHARACTERISTIC
/begin CHARACTERISTIC fdstcalvlu_fBattChgPwrLmt_kW "" VALUE 0xfd0324 /* @ECU_Address@fdstcalvlu_fBattChgPwrLmt_kW@ */ Scalar_UWORD 0 xjmain_CM_ufix16_En6 0.0 1000.0 /end CHARACTERISTIC
/begin CHARACTERISTIC fdstcalvlu_fBattDisChgPwrLmt_kW "" VALUE 0xfd0326 /* @ECU_Address@fdstcalvlu_fBattDisChgPwrLmt_kW@ */ Scalar_UWORD 0 xjmain_CM_ufix16_En6 0.0 1000.0 /end CHARACTERISTIC
/begin CHARACTERISTIC glc_PDU_DCDC_TGT_VOLT "" VALUE 0xfd0348 /* @ECU_Address@glc_PDU_DCDC_TGT_VOLT@ */ Scalar_UWORD 0 xjmain_CM_ufix16_En8 0.0 36.0 /end CHARACTERISTIC
/begin CHARACTERISTIC aiptc_pct_APP_Action_LP "" VALUE 0xfd0058 /* @ECU_Address@aiptc_pct_APP_Action_LP@ */ Scalar_UWORD 0 xjmain_CM_ufix16_En9_percent_ 0.0 100.0 /end CHARACTERISTIC
/begin CHARACTERISTIC aiptc_pct_App_Action_RP "" VALUE 0xfd005a /* @ECU_Address@aiptc_pct_App_Action_RP@ */ Scalar_UWORD 0 xjmain_CM_ufix16_En9_percent_ 0.0 100.0 /end CHARACTERISTIC
/begin CHARACTERISTIC aiptc_pct_DmotSpdRes_Action_LP "" VALUE 0xfd005c /* @ECU_Address@aiptc_pct_DmotSpdRes_Action_LP@ */ Scalar_UWORD 0 xjmain_CM_ufix16_En9_percent_ 0.0 100.0 /end CHARACTERISTIC
/begin CHARACTERISTIC aiptc_pct_DmotSpdRes_Action_RP "" VALUE 0xfd005e /* @ECU_Address@aiptc_pct_DmotSpdRes_Action_RP@ */ Scalar_UWORD 0 xjmain_CM_ufix16_En9_percent_ 0.0 100.0 /end CHARACTERISTIC
/begin CHARACTERISTIC aiptcalvlu_fAPPos_pct "" VALUE 0xfd0086 /* @ECU_Address@aiptcalvlu_fAPPos_pct@ */ Scalar_UWORD 0 xjmain_CM_ufix16_En9_none 0.0 100.0 /end CHARACTERISTIC
/begin CHARACTERISTIC aiptcalvlu_fDmotSpdRes_pct "" VALUE 0xfd008a /* @ECU_Address@aiptcalvlu_fDmotSpdRes_pct@ */ Scalar_UWORD 0 xjmain_CM_ufix16_En9_none 0.0 100.0 /end CHARACTERISTIC
/begin CHARACTERISTIC ciptcalvlu_I2V_u16PmotSpdHSet "" VALUE 0xfd028a /* @ECU_Address@ciptcalvlu_I2V_u16PmotSpdHSet@ */ Scalar_UWORD 0 xjmain_CM_uint16_none 0.0 6000.0 /end CHARACTERISTIC
/begin CHARACTERISTIC ciptcalvlu_I2V_u16PmotSpdLSet "" VALUE 0xfd028c /* @ECU_Address@ciptcalvlu_I2V_u16PmotSpdLSet@ */ Scalar_UWORD 0 xjmain_CM_uint16_none 0.0 6000.0 /end CHARACTERISTIC
/begin CHARACTERISTIC coptcalvlu_V2P_u16RefVolt "" VALUE 0xfd02d8 /* @ECU_Address@coptcalvlu_V2P_u16RefVolt@ */ Scalar_UWORD 0 xjmain_CM_uint16 0.0 1000.0 /end CHARACTERISTIC
/begin CHARACTERISTIC glc_OBC_OUT_CURR_MAX_A "" VALUE 0xfd0340 /* @ECU_Address@glc_OBC_OUT_CURR_MAX_A@ */ Scalar_UWORD 0 xjmain_CM_uint16 0.0 1000.0 /end CHARACTERISTIC
/begin CHARACTERISTIC glc_OBC_OUT_VOLT_MAX_V "" VALUE 0xfd0342 /* @ECU_Address@glc_OBC_OUT_VOLT_MAX_V@ */ Scalar_UWORD 0 xjmain_CM_uint16 0.0 1000.0 /end CHARACTERISTIC
/begin CHARACTERISTIC scpccalvlu_u16DmcuMaxDrSpd "" VALUE 0xfd0428 /* @ECU_Address@scpccalvlu_u16DmcuMaxDrSpd@ */ Scalar_UWORD 0 xjmain_CM_uint16 0.0 4000.0 /end CHARACTERISTIC
/begin CHARACTERISTIC wctrlcalvlu_u16PmcuSpdReq "" VALUE 0xfd043a /* @ECU_Address@wctrlcalvlu_u16PmcuSpdReq@ */ Scalar_UWORD 0 xjmain_CM_uint16 0.0 6000.0 /end CHARACTERISTIC
/begin CHARACTERISTIC FALSE_BL "" VALUE 0xfd000a /* @ECU_Address@FALSE_BL@ */ Scalar_BOOLEAN 0 xjmain_CM_boolean_none 0.0 1.0 /end CHARACTERISTIC
/begin CHARACTERISTIC TRUE_BL "" VALUE 0xfd0021 /* @ECU_Address@TRUE_BL@ */ Scalar_BOOLEAN 0 xjmain_CM_boolean_none 0.0 1.0 /end CHARACTERISTIC
/begin CHARACTERISTIC aiptcalflg_fAPPos_pct "" VALUE 0xfd0079 /* @ECU_Address@aiptcalflg_fAPPos_pct@ */ Scalar_BOOLEAN 0 xjmain_CM_boolean_none 0.0 1.0 /end CHARACTERISTIC
/begin CHARACTERISTIC aiptcalflg_fAirPumpPress_bar "" VALUE 0xfd007a /* @ECU_Address@aiptcalflg_fAirPumpPress_bar@ */ Scalar_BOOLEAN 0 xjmain_CM_boolean_none 0.0 1.0 /end CHARACTERISTIC
/begin CHARACTERISTIC aiptcalflg_fDmotSpdRes_pct "" VALUE 0xfd007b /* @ECU_Address@aiptcalflg_fDmotSpdRes_pct@ */ Scalar_BOOLEAN 0 xjmain_CM_boolean_none 0.0 1.0 /end CHARACTERISTIC
/begin CHARACTERISTIC aiptcalflg_fHW_t "" VALUE 0xfd007c /* @ECU_Address@aiptcalflg_fHW_t@ */ Scalar_BOOLEAN 0 xjmain_CM_boolean_none 0.0 1.0 /end CHARACTERISTIC
/begin CHARACTERISTIC aiptcalflg_fSkylightPress_bar "" VALUE 0xfd007d /* @ECU_Address@aiptcalflg_fSkylightPress_bar@ */ Scalar_BOOLEAN 0 xjmain_CM_boolean_none 0.0 1.0 /end CHARACTERISTIC
/begin CHARACTERISTIC aiptcalflg_isAPAction "" VALUE 0xfd007e /* @ECU_Address@aiptcalflg_isAPAction@ */ Scalar_BOOLEAN 0 xjmain_CM_boolean_none 0.0 1.0 /end CHARACTERISTIC
/begin CHARACTERISTIC aiptcalflg_isAPValid "" VALUE 0xfd007f /* @ECU_Address@aiptcalflg_isAPValid@ */ Scalar_BOOLEAN 0 xjmain_CM_boolean_none 0.0 1.0 /end CHARACTERISTIC
/begin CHARACTERISTIC aiptcalflg_isDmotSpdResAction "" VALUE 0xfd0080 /* @ECU_Address@aiptcalflg_isDmotSpdResAction@ */ Scalar_BOOLEAN 0 xjmain_CM_boolean_none 0.0 1.0 /end CHARACTERISTIC
/begin CHARACTERISTIC aiptcalflg_isDmotSpdResValid "" VALUE 0xfd0081 /* @ECU_Address@aiptcalflg_isDmotSpdResValid@ */ Scalar_BOOLEAN 0 xjmain_CM_boolean_none 0.0 1.0 /end CHARACTERISTIC
/begin CHARACTERISTIC aiptcalflg_isHWValid "" VALUE 0xfd0082 /* @ECU_Address@aiptcalflg_isHWValid@ */ Scalar_BOOLEAN 0 xjmain_CM_boolean_none 0.0 1.0 /end CHARACTERISTIC
/begin CHARACTERISTIC aiptcalflg_isWindSpdValid "" VALUE 0xfd0083 /* @ECU_Address@aiptcalflg_isWindSpdValid@ */ Scalar_BOOLEAN 0 xjmain_CM_boolean_none 0.0 1.0 /end CHARACTERISTIC
/begin CHARACTERISTIC aiptcalflg_u8WindLvl "" VALUE 0xfd0084 /* @ECU_Address@aiptcalflg_u8WindLvl@ */ Scalar_BOOLEAN 0 xjmain_CM_boolean_none 0.0 1.0 /end CHARACTERISTIC
/begin CHARACTERISTIC aiptcalvlu_isAPAction "" VALUE 0xfd0090 /* @ECU_Address@aiptcalvlu_isAPAction@ */ Scalar_BOOLEAN 0 xjmain_CM_boolean_none 0.0 1.0 /end CHARACTERISTIC
/begin CHARACTERISTIC aiptcalvlu_isAPValid "" VALUE 0xfd0091 /* @ECU_Address@aiptcalvlu_isAPValid@ */ Scalar_BOOLEAN 0 xjmain_CM_boolean_none 0.0 1.0 /end CHARACTERISTIC
/begin CHARACTERISTIC aiptcalvlu_isDmotSpdResAction "" VALUE 0xfd0092 /* @ECU_Address@aiptcalvlu_isDmotSpdResAction@ */ Scalar_BOOLEAN 0 xjmain_CM_boolean_none 0.0 1.0 /end CHARACTERISTIC
/begin CHARACTERISTIC aiptcalvlu_isDmotSpdResValid "" VALUE 0xfd0093 /* @ECU_Address@aiptcalvlu_isDmotSpdResValid@ */ Scalar_BOOLEAN 0 xjmain_CM_boolean_none 0.0 1.0 /end CHARACTERISTIC
/begin CHARACTERISTIC aiptcalvlu_isHWValid "" VALUE 0xfd0094 /* @ECU_Address@aiptcalvlu_isHWValid@ */ Scalar_BOOLEAN 0 xjmain_CM_boolean_none 0.0 1.0 /end CHARACTERISTIC
/begin CHARACTERISTIC aiptcalvlu_isWindSpdValid "" VALUE 0xfd0095 /* @ECU_Address@aiptcalvlu_isWindSpdValid@ */ Scalar_BOOLEAN 0 xjmain_CM_boolean_none 0.0 1.0 /end CHARACTERISTIC
/begin CHARACTERISTIC amctcalflg_isAirPumpRun "" VALUE 0xfd009c /* @ECU_Address@amctcalflg_isAirPumpRun@ */ Scalar_BOOLEAN 0 xjmain_CM_boolean_none 0.0 1.0 /end CHARACTERISTIC
/begin CHARACTERISTIC amctcalflg_isDcdcRun "" VALUE 0xfd009d /* @ECU_Address@amctcalflg_isDcdcRun@ */ Scalar_BOOLEAN 0 xjmain_CM_boolean_none 0.0 1.0 /end CHARACTERISTIC
/begin CHARACTERISTIC amctcalvlu_isAirPumpRun "" VALUE 0xfd009e /* @ECU_Address@amctcalvlu_isAirPumpRun@ */ Scalar_BOOLEAN 0 xjmain_CM_boolean_none 0.0 1.0 /end CHARACTERISTIC
/begin CHARACTERISTIC amctcalvlu_isDcdcRun "" VALUE 0xfd009f /* @ECU_Address@amctcalvlu_isDcdcRun@ */ Scalar_BOOLEAN 0 xjmain_CM_boolean_none 0.0 1.0 /end CHARACTERISTIC
/begin CHARACTERISTIC apddcalflg_fDmotTrqReq "" VALUE 0xfd0274 /* @ECU_Address@apddcalflg_fDmotTrqReq@ */ Scalar_BOOLEAN 0 xjmain_CM_boolean_none 0.0 1.0 /end CHARACTERISTIC
/begin CHARACTERISTIC apddcalflg_u16DmotSpdReq "" VALUE 0xfd0275 /* @ECU_Address@apddcalflg_u16DmotSpdReq@ */ Scalar_BOOLEAN 0 xjmain_CM_boolean_none 0.0 1.0 /end CHARACTERISTIC
/begin CHARACTERISTIC apddcalflg_u16PmotSpdReq "" VALUE 0xfd0276 /* @ECU_Address@apddcalflg_u16PmotSpdReq@ */ Scalar_BOOLEAN 0 xjmain_CM_boolean_none 0.0 1.0 /end CHARACTERISTIC
/begin CHARACTERISTIC ciptcalflg_I2V_u16PmotSpdHSet "" VALUE 0xfd0284 /* @ECU_Address@ciptcalflg_I2V_u16PmotSpdHSet@ */ Scalar_BOOLEAN 0 xjmain_CM_boolean_none 0.0 1.0 /end CHARACTERISTIC
/begin CHARACTERISTIC ciptcalflg_I2V_u16PmotSpdLSet "" VALUE 0xfd0285 /* @ECU_Address@ciptcalflg_I2V_u16PmotSpdLSet@ */ Scalar_BOOLEAN 0 xjmain_CM_boolean_none 0.0 1.0 /end CHARACTERISTIC
/begin CHARACTERISTIC ciptcalflg_I2V_u8ChgModeSet "" VALUE 0xfd0286 /* @ECU_Address@ciptcalflg_I2V_u8ChgModeSet@ */ Scalar_BOOLEAN 0 xjmain_CM_boolean_none 0.0 1.0 /end CHARACTERISTIC
/begin CHARACTERISTIC ciptcalflg_I2V_u8ChgOnOffCtrl "" VALUE 0xfd0287 /* @ECU_Address@ciptcalflg_I2V_u8ChgOnOffCtrl@ */ Scalar_BOOLEAN 0 xjmain_CM_boolean_none 0.0 1.0 /end CHARACTERISTIC
/begin CHARACTERISTIC ciptcalflg_I2V_u8ChgPwrSet "" VALUE 0xfd0288 /* @ECU_Address@ciptcalflg_I2V_u8ChgPwrSet@ */ Scalar_BOOLEAN 0 xjmain_CM_boolean_none 0.0 1.0 /end CHARACTERISTIC
/begin CHARACTERISTIC coptcalflg_V2P_hasMainNegRlyClosed "" VALUE 0xfd02a3 /* @ECU_Address@coptcalflg_V2P_hasMainNegRlyClosed@ */ Scalar_BOOLEAN 0 xjmain_CM_boolean 0.0 1.0 /end CHARACTERISTIC
/begin CHARACTERISTIC coptcalflg_V2P_u16RefVolt "" VALUE 0xfd02ac /* @ECU_Address@coptcalflg_V2P_u16RefVolt@ */ Scalar_BOOLEAN 0 xjmain_CM_boolean 0.0 1.0 /end CHARACTERISTIC
/begin CHARACTERISTIC coptcalflg_V2T_hasPmcuRlyClosed "" VALUE 0xfd02af /* @ECU_Address@coptcalflg_V2T_hasPmcuRlyClosed@ */ Scalar_BOOLEAN 0 xjmain_CM_boolean 0.0 1.0 /end CHARACTERISTIC
/begin CHARACTERISTIC coptcalvlu_V2P_hasMainNegRlyClosed "" VALUE 0xfd02cf /* @ECU_Address@coptcalvlu_V2P_hasMainNegRlyClosed@ */ Scalar_BOOLEAN 0 xjmain_CM_boolean 0.0 1.0 /end CHARACTERISTIC
/begin CHARACTERISTIC coptcalvlu_V2T_hasPmcuRlyClosed "" VALUE 0xfd02de /* @ECU_Address@coptcalvlu_V2T_hasPmcuRlyClosed@ */ Scalar_BOOLEAN 0 xjmain_CM_boolean 0.0 1.0 /end CHARACTERISTIC
/begin CHARACTERISTIC diptcalflg_i8GearPos "" VALUE 0xfd02eb /* @ECU_Address@diptcalflg_i8GearPos@ */ Scalar_BOOLEAN 0 xjmain_CM_boolean_none 0.0 1.0 /end CHARACTERISTIC
/begin CHARACTERISTIC diptcalflg_isAirPump "" VALUE 0xfd02ec /* @ECU_Address@diptcalflg_isAirPump@ */ Scalar_BOOLEAN 0 xjmain_CM_boolean_none 0.0 1.0 /end CHARACTERISTIC
/begin CHARACTERISTIC diptcalflg_isDmotSpdMode "" VALUE 0xfd02ed /* @ECU_Address@diptcalflg_isDmotSpdMode@ */ Scalar_BOOLEAN 0 xjmain_CM_boolean_none 0.0 1.0 /end CHARACTERISTIC
/begin CHARACTERISTIC diptcalflg_isES "" VALUE 0xfd02ee /* @ECU_Address@diptcalflg_isES@ */ Scalar_BOOLEAN 0 xjmain_CM_boolean_none 0.0 1.0 /end CHARACTERISTIC
/begin CHARACTERISTIC diptcalflg_isKl15 "" VALUE 0xfd02ef /* @ECU_Address@diptcalflg_isKl15@ */ Scalar_BOOLEAN 0 xjmain_CM_boolean_none 0.0 1.0 /end CHARACTERISTIC
/begin CHARACTERISTIC diptcalflg_isKl15_Raw "" VALUE 0xfd02f0 /* @ECU_Address@diptcalflg_isKl15_Raw@ */ Scalar_BOOLEAN 0 xjmain_CM_boolean_none 0.0 1.0 /end CHARACTERISTIC
/begin CHARACTERISTIC diptcalflg_isPmotHighSpd "" VALUE 0xfd02f1 /* @ECU_Address@diptcalflg_isPmotHighSpd@ */ Scalar_BOOLEAN 0 xjmain_CM_boolean_none 0.0 1.0 /end CHARACTERISTIC
/begin CHARACTERISTIC diptcalflg_isPmotLowSpd "" VALUE 0xfd02f2 /* @ECU_Address@diptcalflg_isPmotLowSpd@ */ Scalar_BOOLEAN 0 xjmain_CM_boolean_none 0.0 1.0 /end CHARACTERISTIC
/begin CHARACTERISTIC diptcalflg_isRegen "" VALUE 0xfd02f3 /* @ECU_Address@diptcalflg_isRegen@ */ Scalar_BOOLEAN 0 xjmain_CM_boolean_none 0.0 1.0 /end CHARACTERISTIC
/begin CHARACTERISTIC diptcalflg_isReqShutdown "" VALUE 0xfd02f4 /* @ECU_Address@diptcalflg_isReqShutdown@ */ Scalar_BOOLEAN 0 xjmain_CM_boolean_none 0.0 1.0 /end CHARACTERISTIC
/begin CHARACTERISTIC diptcalflg_isRing "" VALUE 0xfd02f5 /* @ECU_Address@diptcalflg_isRing@ */ Scalar_BOOLEAN 0 xjmain_CM_boolean_none 0.0 1.0 /end CHARACTERISTIC
/begin CHARACTERISTIC diptcalflg_isStart "" VALUE 0xfd02f6 /* @ECU_Address@diptcalflg_isStart@ */ Scalar_BOOLEAN 0 xjmain_CM_boolean_none 0.0 1.0 /end CHARACTERISTIC
/begin CHARACTERISTIC diptcalvlu_isAirPump "" VALUE 0xfd02f8 /* @ECU_Address@diptcalvlu_isAirPump@ */ Scalar_BOOLEAN 0 xjmain_CM_boolean_none 0.0 1.0 /end CHARACTERISTIC
/begin CHARACTERISTIC diptcalvlu_isDmotSpdMode "" VALUE 0xfd02f9 /* @ECU_Address@diptcalvlu_isDmotSpdMode@ */ Scalar_BOOLEAN 0 xjmain_CM_boolean_none 0.0 1.0 /end CHARACTERISTIC
/begin CHARACTERISTIC diptcalvlu_isES "" VALUE 0xfd02fa /* @ECU_Address@diptcalvlu_isES@ */ Scalar_BOOLEAN 0 xjmain_CM_boolean_none 0.0 1.0 /end CHARACTERISTIC
/begin CHARACTERISTIC diptcalvlu_isKl15 "" VALUE 0xfd02fb /* @ECU_Address@diptcalvlu_isKl15@ */ Scalar_BOOLEAN 0 xjmain_CM_boolean_none 0.0 1.0 /end CHARACTERISTIC
/begin CHARACTERISTIC diptcalvlu_isKl15_Raw "" VALUE 0xfd02fc /* @ECU_Address@diptcalvlu_isKl15_Raw@ */ Scalar_BOOLEAN 0 xjmain_CM_boolean_none 0.0 1.0 /end CHARACTERISTIC
/begin CHARACTERISTIC diptcalvlu_isPmotHighSpd "" VALUE 0xfd02fd /* @ECU_Address@diptcalvlu_isPmotHighSpd@ */ Scalar_BOOLEAN 0 xjmain_CM_boolean_none 0.0 1.0 /end CHARACTERISTIC
/begin CHARACTERISTIC diptcalvlu_isPmotLowSpd "" VALUE 0xfd02fe /* @ECU_Address@diptcalvlu_isPmotLowSpd@ */ Scalar_BOOLEAN 0 xjmain_CM_boolean_none 0.0 1.0 /end CHARACTERISTIC
/begin CHARACTERISTIC diptcalvlu_isRegen "" VALUE 0xfd02ff /* @ECU_Address@diptcalvlu_isRegen@ */ Scalar_BOOLEAN 0 xjmain_CM_boolean_none 0.0 1.0 /end CHARACTERISTIC
/begin CHARACTERISTIC diptcalvlu_isReqShutdown "" VALUE 0xfd0300 /* @ECU_Address@diptcalvlu_isReqShutdown@ */ Scalar_BOOLEAN 0 xjmain_CM_boolean_none 0.0 1.0 /end CHARACTERISTIC
/begin CHARACTERISTIC diptcalvlu_isRing "" VALUE 0xfd0301 /* @ECU_Address@diptcalvlu_isRing@ */ Scalar_BOOLEAN 0 xjmain_CM_boolean_none 0.0 1.0 /end CHARACTERISTIC
/begin CHARACTERISTIC diptcalvlu_isStart "" VALUE 0xfd0302 /* @ECU_Address@diptcalvlu_isStart@ */ Scalar_BOOLEAN 0 xjmain_CM_boolean_none 0.0 1.0 /end CHARACTERISTIC
/begin CHARACTERISTIC doptcalflg_isAirPumpInd "" VALUE 0xfd0303 /* @ECU_Address@doptcalflg_isAirPumpInd@ */ Scalar_BOOLEAN 0 xjmain_CM_boolean_none 0.0 1.0 /end CHARACTERISTIC
/begin CHARACTERISTIC doptcalflg_isBattFltInd "" VALUE 0xfd0304 /* @ECU_Address@doptcalflg_isBattFltInd@ */ Scalar_BOOLEAN 0 xjmain_CM_boolean_none 0.0 1.0 /end CHARACTERISTIC
/begin CHARACTERISTIC doptcalflg_isBattHeatInd "" VALUE 0xfd0305 /* @ECU_Address@doptcalflg_isBattHeatInd@ */ Scalar_BOOLEAN 0 xjmain_CM_boolean_none 0.0 1.0 /end CHARACTERISTIC
/begin CHARACTERISTIC doptcalflg_isDMotInd "" VALUE 0xfd0306 /* @ECU_Address@doptcalflg_isDMotInd@ */ Scalar_BOOLEAN 0 xjmain_CM_boolean_none 0.0 1.0 /end CHARACTERISTIC
/begin CHARACTERISTIC doptcalflg_isDmotFltInd "" VALUE 0xfd0307 /* @ECU_Address@doptcalflg_isDmotFltInd@ */ Scalar_BOOLEAN 0 xjmain_CM_boolean_none 0.0 1.0 /end CHARACTERISTIC
/begin CHARACTERISTIC doptcalflg_isOBCInd "" VALUE 0xfd0308 /* @ECU_Address@doptcalflg_isOBCInd@ */ Scalar_BOOLEAN 0 xjmain_CM_boolean_none 0.0 1.0 /end CHARACTERISTIC
/begin CHARACTERISTIC doptcalflg_isPduWakeUp "" VALUE 0xfd0309 /* @ECU_Address@doptcalflg_isPduWakeUp@ */ Scalar_BOOLEAN 0 xjmain_CM_boolean_none 0.0 1.0 /end CHARACTERISTIC
/begin CHARACTERISTIC doptcalflg_isPmotInd "" VALUE 0xfd030a /* @ECU_Address@doptcalflg_isPmotInd@ */ Scalar_BOOLEAN 0 xjmain_CM_boolean_none 0.0 1.0 /end CHARACTERISTIC
/begin CHARACTERISTIC doptcalflg_isRgInd "" VALUE 0xfd030b /* @ECU_Address@doptcalflg_isRgInd@ */ Scalar_BOOLEAN 0 xjmain_CM_boolean_none 0.0 1.0 /end CHARACTERISTIC
/begin CHARACTERISTIC doptcalflg_isRing "" VALUE 0xfd030c /* @ECU_Address@doptcalflg_isRing@ */ Scalar_BOOLEAN 0 xjmain_CM_boolean_none 0.0 1.0 /end CHARACTERISTIC
/begin CHARACTERISTIC doptcalflg_isStopEnginePwr "" VALUE 0xfd030d /* @ECU_Address@doptcalflg_isStopEnginePwr@ */ Scalar_BOOLEAN 0 xjmain_CM_boolean_none 0.0 1.0 /end CHARACTERISTIC
/begin CHARACTERISTIC doptcalvlu_isAirPumpInd "" VALUE 0xfd030e /* @ECU_Address@doptcalvlu_isAirPumpInd@ */ Scalar_BOOLEAN 0 xjmain_CM_boolean_none 0.0 1.0 /end CHARACTERISTIC
/begin CHARACTERISTIC doptcalvlu_isBattFltInd "" VALUE 0xfd030f /* @ECU_Address@doptcalvlu_isBattFltInd@ */ Scalar_BOOLEAN 0 xjmain_CM_boolean_none 0.0 1.0 /end CHARACTERISTIC
/begin CHARACTERISTIC doptcalvlu_isBattHeatInd "" VALUE 0xfd0310 /* @ECU_Address@doptcalvlu_isBattHeatInd@ */ Scalar_BOOLEAN 0 xjmain_CM_boolean_none 0.0 1.0 /end CHARACTERISTIC
/begin CHARACTERISTIC doptcalvlu_isDMotInd "" VALUE 0xfd0311 /* @ECU_Address@doptcalvlu_isDMotInd@ */ Scalar_BOOLEAN 0 xjmain_CM_boolean_none 0.0 1.0 /end CHARACTERISTIC
/begin CHARACTERISTIC doptcalvlu_isDmotFltInd "" VALUE 0xfd0312 /* @ECU_Address@doptcalvlu_isDmotFltInd@ */ Scalar_BOOLEAN 0 xjmain_CM_boolean_none 0.0 1.0 /end CHARACTERISTIC
/begin CHARACTERISTIC doptcalvlu_isOBCInd "" VALUE 0xfd0313 /* @ECU_Address@doptcalvlu_isOBCInd@ */ Scalar_BOOLEAN 0 xjmain_CM_boolean_none 0.0 1.0 /end CHARACTERISTIC
/begin CHARACTERISTIC doptcalvlu_isPduWakeUp "" VALUE 0xfd0314 /* @ECU_Address@doptcalvlu_isPduWakeUp@ */ Scalar_BOOLEAN 0 xjmain_CM_boolean_none 0.0 1.0 /end CHARACTERISTIC
/begin CHARACTERISTIC doptcalvlu_isPmotInd "" VALUE 0xfd0315 /* @ECU_Address@doptcalvlu_isPmotInd@ */ Scalar_BOOLEAN 0 xjmain_CM_boolean_none 0.0 1.0 /end CHARACTERISTIC
/begin CHARACTERISTIC doptcalvlu_isRgInd "" VALUE 0xfd0316 /* @ECU_Address@doptcalvlu_isRgInd@ */ Scalar_BOOLEAN 0 xjmain_CM_boolean_none 0.0 1.0 /end CHARACTERISTIC
/begin CHARACTERISTIC doptcalvlu_isRing "" VALUE 0xfd0317 /* @ECU_Address@doptcalvlu_isRing@ */ Scalar_BOOLEAN 0 xjmain_CM_boolean_none 0.0 1.0 /end CHARACTERISTIC
/begin CHARACTERISTIC doptcalvlu_isStopEnginePwr "" VALUE 0xfd0318 /* @ECU_Address@doptcalvlu_isStopEnginePwr@ */ Scalar_BOOLEAN 0 xjmain_CM_boolean_none 0.0 1.0 /end CHARACTERISTIC
/begin CHARACTERISTIC fdstcalflg_fBattChgPwrLmt_kW "" VALUE 0xfd031b /* @ECU_Address@fdstcalflg_fBattChgPwrLmt_kW@ */ Scalar_BOOLEAN 0 xjmain_CM_boolean 0.0 1.0 /end CHARACTERISTIC
/begin CHARACTERISTIC fdstcalflg_fBattDisChgPwrLmt_kW "" VALUE 0xfd031c /* @ECU_Address@fdstcalflg_fBattDisChgPwrLmt_kW@ */ Scalar_BOOLEAN 0 xjmain_CM_boolean 0.0 1.0 /end CHARACTERISTIC
/begin CHARACTERISTIC fdstcalflg_fDmotBrTrqLmt "" VALUE 0xfd031d /* @ECU_Address@fdstcalflg_fDmotBrTrqLmt@ */ Scalar_BOOLEAN 0 xjmain_CM_boolean 0.0 1.0 /end CHARACTERISTIC
/begin CHARACTERISTIC fdstcalflg_fDmotDrTrqLmt "" VALUE 0xfd031e /* @ECU_Address@fdstcalflg_fDmotDrTrqLmt@ */ Scalar_BOOLEAN 0 xjmain_CM_boolean 0.0 1.0 /end CHARACTERISTIC
/begin CHARACTERISTIC fdstcalflg_isBattHVEn "" VALUE 0xfd031f /* @ECU_Address@fdstcalflg_isBattHVEn@ */ Scalar_BOOLEAN 0 xjmain_CM_boolean 0.0 1.0 /end CHARACTERISTIC
/begin CHARACTERISTIC fdstcalflg_isDmcuEn "" VALUE 0xfd0320 /* @ECU_Address@fdstcalflg_isDmcuEn@ */ Scalar_BOOLEAN 0 xjmain_CM_boolean 0.0 1.0 /end CHARACTERISTIC
/begin CHARACTERISTIC fdstcalflg_isPmcuEn "" VALUE 0xfd0321 /* @ECU_Address@fdstcalflg_isPmcuEn@ */ Scalar_BOOLEAN 0 xjmain_CM_boolean 0.0 1.0 /end CHARACTERISTIC
/begin CHARACTERISTIC fdstcalflg_u8VehFltLvl "" VALUE 0xfd0322 /* @ECU_Address@fdstcalflg_u8VehFltLvl@ */ Scalar_BOOLEAN 0 xjmain_CM_boolean 0.0 1.0 /end CHARACTERISTIC
/begin CHARACTERISTIC fdstcalvlu_isBattHVEn "" VALUE 0xfd032c /* @ECU_Address@fdstcalvlu_isBattHVEn@ */ Scalar_BOOLEAN 0 xjmain_CM_boolean 0.0 1.0 /end CHARACTERISTIC
/begin CHARACTERISTIC fdstcalvlu_isDmcuEn "" VALUE 0xfd032d /* @ECU_Address@fdstcalvlu_isDmcuEn@ */ Scalar_BOOLEAN 0 xjmain_CM_boolean 0.0 1.0 /end CHARACTERISTIC
/begin CHARACTERISTIC fdstcalvlu_isPmcuEn "" VALUE 0xfd032e /* @ECU_Address@fdstcalvlu_isPmcuEn@ */ Scalar_BOOLEAN 0 xjmain_CM_boolean 0.0 1.0 /end CHARACTERISTIC
/begin CHARACTERISTIC gmctcalflg_i8CurrentGear "" VALUE 0xfd0358 /* @ECU_Address@gmctcalflg_i8CurrentGear@ */ Scalar_BOOLEAN 0 xjmain_CM_boolean 0.0 1.0 /end CHARACTERISTIC
/begin CHARACTERISTIC mmctcalflg_fDmcuTrqReq "" VALUE 0xfd035c /* @ECU_Address@mmctcalflg_fDmcuTrqReq@ */ Scalar_BOOLEAN 0 xjmain_CM_boolean_none 0.0 1.0 /end CHARACTERISTIC
/begin CHARACTERISTIC mmctcalflg_fPmcuTrqReq "" VALUE 0xfd035d /* @ECU_Address@mmctcalflg_fPmcuTrqReq@ */ Scalar_BOOLEAN 0 xjmain_CM_boolean_none 0.0 1.0 /end CHARACTERISTIC
/begin CHARACTERISTIC mmctcalflg_i16DmcuSpdReq "" VALUE 0xfd035e /* @ECU_Address@mmctcalflg_i16DmcuSpdReq@ */ Scalar_BOOLEAN 0 xjmain_CM_boolean 0.0 1.0 /end CHARACTERISTIC
/begin CHARACTERISTIC mmctcalflg_i16PmcuSpdReq "" VALUE 0xfd035f /* @ECU_Address@mmctcalflg_i16PmcuSpdReq@ */ Scalar_BOOLEAN 0 xjmain_CM_boolean 0.0 1.0 /end CHARACTERISTIC
/begin CHARACTERISTIC mmctcalflg_u8DmcuDirModeReq "" VALUE 0xfd0360 /* @ECU_Address@mmctcalflg_u8DmcuDirModeReq@ */ Scalar_BOOLEAN 0 xjmain_CM_boolean_none 0.0 1.0 /end CHARACTERISTIC
/begin CHARACTERISTIC mmctcalflg_u8DmcuRunModeReq "" VALUE 0xfd0361 /* @ECU_Address@mmctcalflg_u8DmcuRunModeReq@ */ Scalar_BOOLEAN 0 xjmain_CM_boolean 0.0 1.0 /end CHARACTERISTIC
/begin CHARACTERISTIC mmctcalflg_u8PmcuDirModeReq "" VALUE 0xfd0362 /* @ECU_Address@mmctcalflg_u8PmcuDirModeReq@ */ Scalar_BOOLEAN 0 xjmain_CM_boolean_none 0.0 1.0 /end CHARACTERISTIC
/begin CHARACTERISTIC mmctcalflg_u8PmcuRunModeReq "" VALUE 0xfd0363 /* @ECU_Address@mmctcalflg_u8PmcuRunModeReq@ */ Scalar_BOOLEAN 0 xjmain_CM_boolean 0.0 1.0 /end CHARACTERISTIC
/begin CHARACTERISTIC obccalflg_fChgCurrSet "" VALUE 0xfd0374 /* @ECU_Address@obccalflg_fChgCurrSet@ */ Scalar_BOOLEAN 0 xjmain_CM_boolean 0.0 1.0 /end CHARACTERISTIC
/begin CHARACTERISTIC obccalflg_fChgVoltSet "" VALUE 0xfd0375 /* @ECU_Address@obccalflg_fChgVoltSet@ */ Scalar_BOOLEAN 0 xjmain_CM_boolean 0.0 1.0 /end CHARACTERISTIC
/begin CHARACTERISTIC obccalflg_isChgStart "" VALUE 0xfd0376 /* @ECU_Address@obccalflg_isChgStart@ */ Scalar_BOOLEAN 0 xjmain_CM_boolean 0.0 1.0 /end CHARACTERISTIC
/begin CHARACTERISTIC obccalflg_u8BattChgMode "" VALUE 0xfd0377 /* @ECU_Address@obccalflg_u8BattChgMode@ */ Scalar_BOOLEAN 0 xjmain_CM_boolean 0.0 1.0 /end CHARACTERISTIC
/begin CHARACTERISTIC obccalvlu_isChgStart "" VALUE 0xfd037c /* @ECU_Address@obccalvlu_isChgStart@ */ Scalar_BOOLEAN 0 xjmain_CM_boolean 0.0 1.0 /end CHARACTERISTIC
/begin CHARACTERISTIC pooccalflg_hasBattConn "" VALUE 0xfd0398 /* @ECU_Address@pooccalflg_hasBattConn@ */ Scalar_BOOLEAN 0 xjmain_CM_boolean 0.0 1.0 /end CHARACTERISTIC
/begin CHARACTERISTIC pooccalflg_hasVehLVDown "" VALUE 0xfd0399 /* @ECU_Address@pooccalflg_hasVehLVDown@ */ Scalar_BOOLEAN 0 xjmain_CM_boolean 0.0 1.0 /end CHARACTERISTIC
/begin CHARACTERISTIC pooccalflg_hasVehRdy "" VALUE 0xfd039a /* @ECU_Address@pooccalflg_hasVehRdy@ */ Scalar_BOOLEAN 0 xjmain_CM_boolean 0.0 1.0 /end CHARACTERISTIC
/begin CHARACTERISTIC pooccalflg_isBattConn "" VALUE 0xfd039b /* @ECU_Address@pooccalflg_isBattConn@ */ Scalar_BOOLEAN 0 xjmain_CM_boolean 0.0 1.0 /end CHARACTERISTIC
/begin CHARACTERISTIC pooccalflg_isChgAllow "" VALUE 0xfd039c /* @ECU_Address@pooccalflg_isChgAllow@ */ Scalar_BOOLEAN 0 xjmain_CM_boolean 0.0 1.0 /end CHARACTERISTIC
/begin CHARACTERISTIC pooccalflg_isDcdcDcacConn "" VALUE 0xfd039d /* @ECU_Address@pooccalflg_isDcdcDcacConn@ */ Scalar_BOOLEAN 0 xjmain_CM_boolean 0.0 1.0 /end CHARACTERISTIC
/begin CHARACTERISTIC pooccalflg_isDisConnLV "" VALUE 0xfd039e /* @ECU_Address@pooccalflg_isDisConnLV@ */ Scalar_BOOLEAN 0 xjmain_CM_boolean 0.0 1.0 /end CHARACTERISTIC
/begin CHARACTERISTIC pooccalflg_isDmcuConn "" VALUE 0xfd039f /* @ECU_Address@pooccalflg_isDmcuConn@ */ Scalar_BOOLEAN 0 xjmain_CM_boolean 0.0 1.0 /end CHARACTERISTIC
/begin CHARACTERISTIC pooccalflg_isDmcuEn "" VALUE 0xfd03a0 /* @ECU_Address@pooccalflg_isDmcuEn@ */ Scalar_BOOLEAN 0 xjmain_CM_boolean 0.0 1.0 /end CHARACTERISTIC
/begin CHARACTERISTIC pooccalflg_isDmcuPreConn "" VALUE 0xfd03a1 /* @ECU_Address@pooccalflg_isDmcuPreConn@ */ Scalar_BOOLEAN 0 xjmain_CM_boolean 0.0 1.0 /end CHARACTERISTIC
/begin CHARACTERISTIC pooccalflg_isMcuDisChg "" VALUE 0xfd03a2 /* @ECU_Address@pooccalflg_isMcuDisChg@ */ Scalar_BOOLEAN 0 xjmain_CM_boolean 0.0 1.0 /end CHARACTERISTIC
/begin CHARACTERISTIC pooccalflg_isObcConn "" VALUE 0xfd03a3 /* @ECU_Address@pooccalflg_isObcConn@ */ Scalar_BOOLEAN 0 xjmain_CM_boolean 0.0 1.0 /end CHARACTERISTIC
/begin CHARACTERISTIC pooccalflg_isPmcuConn "" VALUE 0xfd03a4 /* @ECU_Address@pooccalflg_isPmcuConn@ */ Scalar_BOOLEAN 0 xjmain_CM_boolean 0.0 1.0 /end CHARACTERISTIC
/begin CHARACTERISTIC pooccalflg_isPmcuEn "" VALUE 0xfd03a5 /* @ECU_Address@pooccalflg_isPmcuEn@ */ Scalar_BOOLEAN 0 xjmain_CM_boolean 0.0 1.0 /end CHARACTERISTIC
/begin CHARACTERISTIC pooccalflg_isPmcuPreConn "" VALUE 0xfd03a6 /* @ECU_Address@pooccalflg_isPmcuPreConn@ */ Scalar_BOOLEAN 0 xjmain_CM_boolean 0.0 1.0 /end CHARACTERISTIC
/begin CHARACTERISTIC pooccalflg_isRlyFlt "" VALUE 0xfd03a7 /* @ECU_Address@pooccalflg_isRlyFlt@ */ Scalar_BOOLEAN 0 xjmain_CM_boolean 0.0 1.0 /end CHARACTERISTIC
/begin CHARACTERISTIC pooccalflg_isWarningLight "" VALUE 0xfd03a8 /* @ECU_Address@pooccalflg_isWarningLight@ */ Scalar_BOOLEAN 0 xjmain_CM_boolean 0.0 1.0 /end CHARACTERISTIC
/begin CHARACTERISTIC pooccalflg_u8StepRunFlt "" VALUE 0xfd03a9 /* @ECU_Address@pooccalflg_u8StepRunFlt@ */ Scalar_BOOLEAN 0 xjmain_CM_boolean 0.0 1.0 /end CHARACTERISTIC
/begin CHARACTERISTIC pooccalflg_u8StepRunSts "" VALUE 0xfd03aa /* @ECU_Address@pooccalflg_u8StepRunSts@ */ Scalar_BOOLEAN 0 xjmain_CM_boolean 0.0 1.0 /end CHARACTERISTIC
/begin CHARACTERISTIC pooccalvlu_hasBattConn "" VALUE 0xfd03ab /* @ECU_Address@pooccalvlu_hasBattConn@ */ Scalar_BOOLEAN 0 xjmain_CM_boolean 0.0 1.0 /end CHARACTERISTIC
/begin CHARACTERISTIC pooccalvlu_hasVehLVDown "" VALUE 0xfd03ac /* @ECU_Address@pooccalvlu_hasVehLVDown@ */ Scalar_BOOLEAN 0 xjmain_CM_boolean 0.0 1.0 /end CHARACTERISTIC
/begin CHARACTERISTIC pooccalvlu_hasVehRdy "" VALUE 0xfd03ad /* @ECU_Address@pooccalvlu_hasVehRdy@ */ Scalar_BOOLEAN 0 xjmain_CM_boolean 0.0 1.0 /end CHARACTERISTIC
/begin CHARACTERISTIC pooccalvlu_isBattConn "" VALUE 0xfd03ae /* @ECU_Address@pooccalvlu_isBattConn@ */ Scalar_BOOLEAN 0 xjmain_CM_boolean 0.0 1.0 /end CHARACTERISTIC
/begin CHARACTERISTIC pooccalvlu_isChgAllow "" VALUE 0xfd03af /* @ECU_Address@pooccalvlu_isChgAllow@ */ Scalar_BOOLEAN 0 xjmain_CM_boolean 0.0 1.0 /end CHARACTERISTIC
/begin CHARACTERISTIC pooccalvlu_isDcdcDcacConn "" VALUE 0xfd03b0 /* @ECU_Address@pooccalvlu_isDcdcDcacConn@ */ Scalar_BOOLEAN 0 xjmain_CM_boolean 0.0 1.0 /end CHARACTERISTIC
/begin CHARACTERISTIC pooccalvlu_isDisConnLV "" VALUE 0xfd03b1 /* @ECU_Address@pooccalvlu_isDisConnLV@ */ Scalar_BOOLEAN 0 xjmain_CM_boolean 0.0 1.0 /end CHARACTERISTIC
/begin CHARACTERISTIC pooccalvlu_isDmcuConn "" VALUE 0xfd03b2 /* @ECU_Address@pooccalvlu_isDmcuConn@ */ Scalar_BOOLEAN 0 xjmain_CM_boolean 0.0 1.0 /end CHARACTERISTIC
/begin CHARACTERISTIC pooccalvlu_isDmcuEn "" VALUE 0xfd03b3 /* @ECU_Address@pooccalvlu_isDmcuEn@ */ Scalar_BOOLEAN 0 xjmain_CM_boolean 0.0 1.0 /end CHARACTERISTIC
/begin CHARACTERISTIC pooccalvlu_isDmcuPreConn "" VALUE 0xfd03b4 /* @ECU_Address@pooccalvlu_isDmcuPreConn@ */ Scalar_BOOLEAN 0 xjmain_CM_boolean 0.0 1.0 /end CHARACTERISTIC
/begin CHARACTERISTIC pooccalvlu_isMcuDisChg "" VALUE 0xfd03b5 /* @ECU_Address@pooccalvlu_isMcuDisChg@ */ Scalar_BOOLEAN 0 xjmain_CM_boolean 0.0 1.0 /end CHARACTERISTIC
/begin CHARACTERISTIC pooccalvlu_isObcConn "" VALUE 0xfd03b6 /* @ECU_Address@pooccalvlu_isObcConn@ */ Scalar_BOOLEAN 0 xjmain_CM_boolean 0.0 1.0 /end CHARACTERISTIC
/begin CHARACTERISTIC pooccalvlu_isPmcuConn "" VALUE 0xfd03b7 /* @ECU_Address@pooccalvlu_isPmcuConn@ */ Scalar_BOOLEAN 0 xjmain_CM_boolean 0.0 1.0 /end CHARACTERISTIC
/begin CHARACTERISTIC pooccalvlu_isPmcuEn "" VALUE 0xfd03b8 /* @ECU_Address@pooccalvlu_isPmcuEn@ */ Scalar_BOOLEAN 0 xjmain_CM_boolean 0.0 1.0 /end CHARACTERISTIC
/begin CHARACTERISTIC pooccalvlu_isPmcuPreConn "" VALUE 0xfd03b9 /* @ECU_Address@pooccalvlu_isPmcuPreConn@ */ Scalar_BOOLEAN 0 xjmain_CM_boolean 0.0 1.0 /end CHARACTERISTIC
/begin CHARACTERISTIC pooccalvlu_isRlyFlt "" VALUE 0xfd03ba /* @ECU_Address@pooccalvlu_isRlyFlt@ */ Scalar_BOOLEAN 0 xjmain_CM_boolean 0.0 1.0 /end CHARACTERISTIC
/begin CHARACTERISTIC pooccalvlu_isWarningLight "" VALUE 0xfd03bb /* @ECU_Address@pooccalvlu_isWarningLight@ */ Scalar_BOOLEAN 0 xjmain_CM_boolean 0.0 1.0 /end CHARACTERISTIC
/begin CHARACTERISTIC rbctcalflg_fRgBrTrqReq "" VALUE 0xfd03f1 /* @ECU_Address@rbctcalflg_fRgBrTrqReq@ */ Scalar_BOOLEAN 0 xjmain_CM_boolean 0.0 1.0 /end CHARACTERISTIC
/begin CHARACTERISTIC rbctcalflg_isRegen "" VALUE 0xfd03f2 /* @ECU_Address@rbctcalflg_isRegen@ */ Scalar_BOOLEAN 0 xjmain_CM_boolean 0.0 1.0 /end CHARACTERISTIC
/begin CHARACTERISTIC rbctcalvlu_isRegen "" VALUE 0xfd03f6 /* @ECU_Address@rbctcalvlu_isRegen@ */ Scalar_BOOLEAN 0 xjmain_CM_boolean 0.0 1.0 /end CHARACTERISTIC
/begin CHARACTERISTIC scpccalflg_fDmcuMaxDrTrq "" VALUE 0xfd0421 /* @ECU_Address@scpccalflg_fDmcuMaxDrTrq@ */ Scalar_BOOLEAN 0 xjmain_CM_boolean 0.0 1.0 /end CHARACTERISTIC
/begin CHARACTERISTIC scpccalflg_fDmcuMaxRgBrTrq "" VALUE 0xfd0422 /* @ECU_Address@scpccalflg_fDmcuMaxRgBrTrq@ */ Scalar_BOOLEAN 0 xjmain_CM_boolean 0.0 1.0 /end CHARACTERISTIC
/begin CHARACTERISTIC scpccalflg_u16DmcuMaxDrSpd "" VALUE 0xfd0423 /* @ECU_Address@scpccalflg_u16DmcuMaxDrSpd@ */ Scalar_BOOLEAN 0 xjmain_CM_boolean 0.0 1.0 /end CHARACTERISTIC
/begin CHARACTERISTIC tftacalflg_fDmcuTrqReq "" VALUE 0xfd042e /* @ECU_Address@tftacalflg_fDmcuTrqReq@ */ Scalar_BOOLEAN 0 xjmain_CM_boolean 0.0 1.0 /end CHARACTERISTIC
/begin CHARACTERISTIC tftacalflg_i8DmcuTrqReqMode "" VALUE 0xfd042f /* @ECU_Address@tftacalflg_i8DmcuTrqReqMode@ */ Scalar_BOOLEAN 0 xjmain_CM_boolean 0.0 1.0 /end CHARACTERISTIC
/begin CHARACTERISTIC wctrlcalflg_i8PmcuSpdReqMode "" VALUE 0xfd0436 /* @ECU_Address@wctrlcalflg_i8PmcuSpdReqMode@ */ Scalar_BOOLEAN 0 xjmain_CM_boolean 0.0 1.0 /end CHARACTERISTIC
/begin CHARACTERISTIC wctrlcalflg_u16PmcuSpdReq "" VALUE 0xfd0437 /* @ECU_Address@wctrlcalflg_u16PmcuSpdReq@ */ Scalar_BOOLEAN 0 xjmain_CM_boolean 0.0 1.0 /end CHARACTERISTIC
/begin CHARACTERISTIC diptcalvlu_i8GearPos "" VALUE 0xfd02f7 /* @ECU_Address@diptcalvlu_i8GearPos@ */ Scalar_BYTE 0 xjmain_CM_int8_none -1.0 4.0 /end CHARACTERISTIC
/begin CHARACTERISTIC gmctcalvlu_i8CurrentGear "" VALUE 0xfd0359 /* @ECU_Address@gmctcalvlu_i8CurrentGear@ */ Scalar_BYTE 0 xjmain_CM_int8 -1.0 4.0 /end CHARACTERISTIC
/begin CHARACTERISTIC tftacalvlu_i8DmcuTrqReqMode "" VALUE 0xfd0432 /* @ECU_Address@tftacalvlu_i8DmcuTrqReqMode@ */ Scalar_BYTE 0 xjmain_CM_int8 0.0 4.0 /end CHARACTERISTIC
/begin CHARACTERISTIC wctrlcalvlu_i8PmcuSpdReqMode "" VALUE 0xfd0438 /* @ECU_Address@wctrlcalvlu_i8PmcuSpdReqMode@ */ Scalar_BYTE 0 xjmain_CM_int8 0.0 4.0 /end CHARACTERISTIC
/begin CHARACTERISTIC APP_STATUS_NORM "" VALUE 0xfd0000 /* @ECU_Address@APP_STATUS_NORM@ */ Scalar_UBYTE 0 xjmain_CM_uint8 0.0 0.0 /end CHARACTERISTIC
/begin CHARACTERISTIC APP_STATUS_SHUTDOWN "" VALUE 0xfd0001 /* @ECU_Address@APP_STATUS_SHUTDOWN@ */ Scalar_UBYTE 0 xjmain_CM_uint8 1.0 3.0 /end CHARACTERISTIC
/begin CHARACTERISTIC APP_STATUS_SOFTRESET "" VALUE 0xfd0002 /* @ECU_Address@APP_STATUS_SOFTRESET@ */ Scalar_UBYTE 0 xjmain_CM_uint8 0.0 3.0 /end CHARACTERISTIC
/begin CHARACTERISTIC GEAR_N "" VALUE 0xfd0014 /* @ECU_Address@GEAR_N@ */ Scalar_UBYTE 0 xjmain_CM_uint8 0.0 4.0 /end CHARACTERISTIC
/begin CHARACTERISTIC aiptc_range_HW_t "" VALUE 0xfd0078 /* @ECU_Address@aiptc_range_HW_t@ */ Scalar_UBYTE 0 xjmain_CM_uint8_t 0.0 200.0 /end CHARACTERISTIC
/begin CHARACTERISTIC aiptcalvlu_u8WindLvl "" VALUE 0xfd0096 /* @ECU_Address@aiptcalvlu_u8WindLvl@ */ Scalar_UBYTE 0 xjmain_CM_uint8_none 0.0 100.0 /end CHARACTERISTIC
/begin CHARACTERISTIC ciptcalvlu_I2V_u8ChgModeSet "" VALUE 0xfd028e /* @ECU_Address@ciptcalvlu_I2V_u8ChgModeSet@ */ Scalar_UBYTE 0 xjmain_CM_uint8_none 0.0 5.0 /end CHARACTERISTIC
/begin CHARACTERISTIC ciptcalvlu_I2V_u8ChgOnOffCtrl "" VALUE 0xfd028f /* @ECU_Address@ciptcalvlu_I2V_u8ChgOnOffCtrl@ */ Scalar_UBYTE 0 xjmain_CM_uint8_none 0.0 5.0 /end CHARACTERISTIC
/begin CHARACTERISTIC ciptcalvlu_I2V_u8ChgPwrSet "" VALUE 0xfd0290 /* @ECU_Address@ciptcalvlu_I2V_u8ChgPwrSet@ */ Scalar_UBYTE 0 xjmain_CM_uint8_none 0.0 200.0 /end CHARACTERISTIC
/begin CHARACTERISTIC fdstcalvlu_u8VehFltLvl "" VALUE 0xfd032f /* @ECU_Address@fdstcalvlu_u8VehFltLvl@ */ Scalar_UBYTE 0 xjmain_CM_uint8 0.0 255.0 /end CHARACTERISTIC
/begin CHARACTERISTIC glc_OBC_RATING_PWR_kW "" VALUE 0xfd0344 /* @ECU_Address@glc_OBC_RATING_PWR_kW@ */ Scalar_UBYTE 0 xjmain_CM_uint8 0.0 200.0 /end CHARACTERISTIC
/begin CHARACTERISTIC mmctcalvlu_u8DmcuDirModeReq "" VALUE 0xfd036c /* @ECU_Address@mmctcalvlu_u8DmcuDirModeReq@ */ Scalar_UBYTE 0 xjmain_CM_uint8_none 0.0 255.0 /end CHARACTERISTIC
/begin CHARACTERISTIC mmctcalvlu_u8DmcuRunModeReq "" VALUE 0xfd036d /* @ECU_Address@mmctcalvlu_u8DmcuRunModeReq@ */ Scalar_UBYTE 0 xjmain_CM_uint8 0.0 255.0 /end CHARACTERISTIC
/begin CHARACTERISTIC mmctcalvlu_u8PmcuDirModeReq "" VALUE 0xfd036e /* @ECU_Address@mmctcalvlu_u8PmcuDirModeReq@ */ Scalar_UBYTE 0 xjmain_CM_uint8_none 0.0 255.0 /end CHARACTERISTIC
/begin CHARACTERISTIC mmctcalvlu_u8PmcuRunModeReq "" VALUE 0xfd036f /* @ECU_Address@mmctcalvlu_u8PmcuRunModeReq@ */ Scalar_UBYTE 0 xjmain_CM_uint8 0.0 255.0 /end CHARACTERISTIC
/begin CHARACTERISTIC obccalvlu_u8BattChgMode "" VALUE 0xfd037d /* @ECU_Address@obccalvlu_u8BattChgMode@ */ Scalar_UBYTE 0 xjmain_CM_uint8 0.0 5.0 /end CHARACTERISTIC
/begin CHARACTERISTIC pooccalvlu_u8StepRunFlt "" VALUE 0xfd03bc /* @ECU_Address@pooccalvlu_u8StepRunFlt@ */ Scalar_UBYTE 0 xjmain_CM_uint8 0.0 255.0 /end CHARACTERISTIC
/begin CHARACTERISTIC pooccalvlu_u8StepRunSts "" VALUE 0xfd03bd /* @ECU_Address@pooccalvlu_u8StepRunSts@ */ Scalar_UBYTE 0 xjmain_CM_uint8 0.0 255.0 /end CHARACTERISTIC
/begin MEASUREMENT hldmsr_T2V_fPmcuNegTrgLmt "" FLOAT64_IEEE xjmain_CM_double 0 0 -1.7E+308 1.7E+308 ECU_ADDRESS 0x400081b0 /* @ECU_Address@hldmsr_T2V_fPmcuNegTrgLmt@ */ /end MEASUREMENT
/begin MEASUREMENT hldmsr_B2V_u8ReqHVPwrOff "" FLOAT64_IEEE xjmain_CM_double 0 0 -1.7E+308 1.7E+308 ECU_ADDRESS 0x40008170 /* @ECU_Address@hldmsr_B2V_u8ReqHVPwrOff@ */ /end MEASUREMENT
/begin MEASUREMENT hldmsr_B2V_u8BattCanLifeSig "" FLOAT64_IEEE xjmain_CM_double 0 0 -1.7E+308 1.7E+308 ECU_ADDRESS 0x40008158 /* @ECU_Address@hldmsr_B2V_u8BattCanLifeSig@ */ /end MEASUREMENT
/begin MEASUREMENT hldmsr_T2V_fPmotDcVoltAct "" FLOAT32_IEEE xjmain_CM_single 0 0 -3.4E+38 3.4E+38 ECU_ADDRESS 0x400081bc /* @ECU_Address@hldmsr_T2V_fPmotDcVoltAct@ */ /end MEASUREMENT
/begin MEASUREMENT hldmsr_AI_AccPedalRaw "" UWORD xjmain_CM_uint16 0 0 0 65535 ECU_ADDRESS 0x4000812c /* @ECU_Address@hldmsr_AI_AccPedalRaw@ */ /end MEASUREMENT
/begin MEASUREMENT hldmsr_AI_DmotSpdResRaw "" UWORD xjmain_CM_uint16 0 0 0 65535 ECU_ADDRESS 0x40008132 /* @ECU_Address@hldmsr_AI_DmotSpdResRaw@ */ /end MEASUREMENT
/begin MEASUREMENT hldmsr_AI_AccPedal "" UWORD xjmain_CM_uint16 0 0 0 65535 ECU_ADDRESS 0x4000812a /* @ECU_Address@hldmsr_AI_AccPedal@ */ /end MEASUREMENT
/begin MEASUREMENT hldmsr_AI_DmotSpdRes "" UWORD xjmain_CM_uint16 0 0 0 65535 ECU_ADDRESS 0x40008130 /* @ECU_Address@hldmsr_AI_DmotSpdRes@ */ /end MEASUREMENT
/begin MEASUREMENT hldmsr_I2V_u16PmotSpdLSet "" UWORD xjmain_CM_uint16 0 0 0 65535 ECU_ADDRESS 0x40008188 /* @ECU_Address@hldmsr_I2V_u16PmotSpdLSet@ */ /end MEASUREMENT
/begin MEASUREMENT hldmsr_I2V_u16PmotSpdHSet "" UWORD xjmain_CM_uint16 0 0 0 65535 ECU_ADDRESS 0x40008186 /* @ECU_Address@hldmsr_I2V_u16PmotSpdHSet@ */ /end MEASUREMENT
/begin MEASUREMENT mmctmsr_i16DmcuSpdReq "" UWORD xjmain_CM_uint16 0 0 0 65535 ECU_ADDRESS 0x40008218 /* @ECU_Address@mmctmsr_i16DmcuSpdReq@ */ /end MEASUREMENT
/begin MEASUREMENT mmctmsr_i16PmcuSpdReq "" UWORD xjmain_CM_uint16 0 0 0 65535 ECU_ADDRESS 0x4000821a /* @ECU_Address@mmctmsr_i16PmcuSpdReq@ */ /end MEASUREMENT
/begin MEASUREMENT apddmsr_u16PmotSpdReq "" UWORD xjmain_CM_uint16 0 0 0 65535 ECU_ADDRESS 0x4000801a /* @ECU_Address@apddmsr_u16PmotSpdReq@ */ /end MEASUREMENT
/begin MEASUREMENT apddmsr_u16DmotSpdReq "" UWORD xjmain_CM_uint16 0 0 0 65535 ECU_ADDRESS 0x40008018 /* @ECU_Address@apddmsr_u16DmotSpdReq@ */ /end MEASUREMENT
/begin MEASUREMENT scpcmsr_u16DmcuMaxDrSpd "" UWORD xjmain_CM_uint16 0 0 0 65535 ECU_ADDRESS 0x4000824c /* @ECU_Address@scpcmsr_u16DmcuMaxDrSpd@ */ /end MEASUREMENT
/begin MEASUREMENT hldmsr_B2V_fBattCellMaxVolt "" UWORD xjmain_CM_ufix16_En9 0 0 0 127.998046875 ECU_ADDRESS 0x4000813e /* @ECU_Address@hldmsr_B2V_fBattCellMaxVolt@ */ /end MEASUREMENT
/begin MEASUREMENT hldmsr_B2V_fBattCellMinVolt "" UWORD xjmain_CM_ufix16_En9 0 0 0 127.998046875 ECU_ADDRESS 0x40008140 /* @ECU_Address@hldmsr_B2V_fBattCellMinVolt@ */ /end MEASUREMENT
/begin MEASUREMENT aiptmsr_fAPPos_pct "" UWORD xjmain_CM_ufix16_En9 0 0 0 127.998046875 ECU_ADDRESS 0x40008002 /* @ECU_Address@aiptmsr_fAPPos_pct@ */ /end MEASUREMENT
/begin MEASUREMENT aiptmsr_fDmotSpdRes_pct "" UWORD xjmain_CM_ufix16_En9 0 0 0 127.998046875 ECU_ADDRESS 0x40008006 /* @ECU_Address@aiptmsr_fDmotSpdRes_pct@ */ /end MEASUREMENT
/begin MEASUREMENT fdstmsr_fBattChgPwrLmt_kW "" UWORD xjmain_CM_ufix16_En6 0 0 0 1023.984375 ECU_ADDRESS 0x400080fc /* @ECU_Address@fdstmsr_fBattChgPwrLmt_kW@ */ /end MEASUREMENT
/begin MEASUREMENT fdstmsr_fBattDisChgPwrLmt_kW "" UWORD xjmain_CM_ufix16_En6 0 0 0 1023.984375 ECU_ADDRESS 0x400080fe /* @ECU_Address@fdstmsr_fBattDisChgPwrLmt_kW@ */ /end MEASUREMENT
/begin MEASUREMENT aiptmsr_fHW_t "" UWORD xjmain_CM_ufix16_En6 0 0 0 1023.984375 ECU_ADDRESS 0x40008008 /* @ECU_Address@aiptmsr_fHW_t@ */ /end MEASUREMENT
/begin MEASUREMENT hldmsr_T2V_fDmotAcCurrAct "" UWORD xjmain_CM_ufix16_En4 0 0 0 4095.9375 ECU_ADDRESS 0x400081a8 /* @ECU_Address@hldmsr_T2V_fDmotAcCurrAct@ */ /end MEASUREMENT
/begin MEASUREMENT hldmsr_T2V_fPmotAcCurrAct "" UWORD xjmain_CM_ufix16_En4 0 0 0 4095.9375 ECU_ADDRESS 0x400081ba /* @ECU_Address@hldmsr_T2V_fPmotAcCurrAct@ */ /end MEASUREMENT
/begin MEASUREMENT hldmsr_B2V_fBattChgCurrPeak "" UWORD xjmain_CM_ufix16_En4 0 0 0 4095.9375 ECU_ADDRESS 0x40008144 /* @ECU_Address@hldmsr_B2V_fBattChgCurrPeak@ */ /end MEASUREMENT
/begin MEASUREMENT hldmsr_B2V_fBattDisChgCurrCont "" UWORD xjmain_CM_ufix16_En4 0 0 0 4095.9375 ECU_ADDRESS 0x40008146 /* @ECU_Address@hldmsr_B2V_fBattDisChgCurrCont@ */ /end MEASUREMENT
/begin MEASUREMENT hldmsr_B2V_fBattChgCurrCont "" UWORD xjmain_CM_ufix16_En4 0 0 0 4095.9375 ECU_ADDRESS 0x40008142 /* @ECU_Address@hldmsr_B2V_fBattChgCurrCont@ */ /end MEASUREMENT
/begin MEASUREMENT hldmsr_B2V_fBattDisChgCurrPeak "" UWORD xjmain_CM_ufix16_En4 0 0 0 4095.9375 ECU_ADDRESS 0x40008148 /* @ECU_Address@hldmsr_B2V_fBattDisChgCurrPeak@ */ /end MEASUREMENT
/begin MEASUREMENT hldmsr_B2V_fBattSOC "" UWORD xjmain_CM_ufix16_En4 0 0 0 4095.9375 ECU_ADDRESS 0x4000814e /* @ECU_Address@hldmsr_B2V_fBattSOC@ */ /end MEASUREMENT
/begin MEASUREMENT hldmsr_B2V_fBattPackVolt "" UWORD xjmain_CM_ufix16_En4 0 0 0 4095.9375 ECU_ADDRESS 0x4000814c /* @ECU_Address@hldmsr_B2V_fBattPackVolt@ */ /end MEASUREMENT
/begin MEASUREMENT hldmsr_O2B_fChgOutVoltAct "" UWORD xjmain_CM_ufix16_En4 0 0 0 4095.9375 ECU_ADDRESS 0x40008190 /* @ECU_Address@hldmsr_O2B_fChgOutVoltAct@ */ /end MEASUREMENT
/begin MEASUREMENT hldmsr_O2B_fChgOutCurrAct "" UWORD xjmain_CM_ufix16_En4 0 0 0 4095.9375 ECU_ADDRESS 0x4000818e /* @ECU_Address@hldmsr_O2B_fChgOutCurrAct@ */ /end MEASUREMENT
/begin MEASUREMENT hldmsr_B2V_fBattAvaiMaxVolt "" UWORD xjmain_CM_ufix16_En4 0 0 0 4095.9375 ECU_ADDRESS 0x4000813c /* @ECU_Address@hldmsr_B2V_fBattAvaiMaxVolt@ */ /end MEASUREMENT
/begin MEASUREMENT aiptmsr_fAirPumpPress_bar "" UWORD xjmain_CM_ufix16_En4 0 0 0 4095.9375 ECU_ADDRESS 0x40008004 /* @ECU_Address@aiptmsr_fAirPumpPress_bar@ */ /end MEASUREMENT
/begin MEASUREMENT aiptmsr_fSkylightPress_bar "" UWORD xjmain_CM_ufix16_En4 0 0 0 4095.9375 ECU_ADDRESS 0x4000800a /* @ECU_Address@aiptmsr_fSkylightPress_bar@ */ /end MEASUREMENT
/begin MEASUREMENT hldmsr_B2V_fBattPackCurr "" SWORD xjmain_CM_sfix16_En4 0 0 -2048.0 2047.9375 ECU_ADDRESS 0x4000814a /* @ECU_Address@hldmsr_B2V_fBattPackCurr@ */ /end MEASUREMENT
/begin MEASUREMENT hldmsr_T2V_fPmotTrqAct "" SWORD xjmain_CM_sfix16_En2 0 0 -8192.0 8191.75 ECU_ADDRESS 0x400081c0 /* @ECU_Address@hldmsr_T2V_fPmotTrqAct@ */ /end MEASUREMENT
/begin MEASUREMENT hldmsr_T2V_fPmcuPosTrgLmt "" SWORD xjmain_CM_sfix16_En2 0 0 -8192.0 8191.75 ECU_ADDRESS 0x400081b8 /* @ECU_Address@hldmsr_T2V_fPmcuPosTrgLmt@ */ /end MEASUREMENT
/begin MEASUREMENT hldmsr_T2V_i16DmotTrqAct "" SWORD xjmain_CM_sfix16_En2 0 0 -8192.0 8191.75 ECU_ADDRESS 0x400081d0 /* @ECU_Address@hldmsr_T2V_i16DmotTrqAct@ */ /end MEASUREMENT
/begin MEASUREMENT hldmsr_T2V_fDmcuPosTrgLmt "" SWORD xjmain_CM_sfix16_En2 0 0 -8192.0 8191.75 ECU_ADDRESS 0x400081a6 /* @ECU_Address@hldmsr_T2V_fDmcuPosTrgLmt@ */ /end MEASUREMENT
/begin MEASUREMENT hldmsr_T2V_fDmcuNegTrgLmt "" SWORD xjmain_CM_sfix16_En2 0 0 -8192.0 8191.75 ECU_ADDRESS 0x400081a4 /* @ECU_Address@hldmsr_T2V_fDmcuNegTrgLmt@ */ /end MEASUREMENT
/begin MEASUREMENT mmctmsr_fDmcuTrqReq "" SWORD xjmain_CM_sfix16_En2 0 0 -8192.0 8191.75 ECU_ADDRESS 0x40008214 /* @ECU_Address@mmctmsr_fDmcuTrqReq@ */ /end MEASUREMENT
/begin MEASUREMENT mmctmsr_fPmcuTrqReq "" SWORD xjmain_CM_sfix16_En2 0 0 -8192.0 8191.75 ECU_ADDRESS 0x40008216 /* @ECU_Address@mmctmsr_fPmcuTrqReq@ */ /end MEASUREMENT
/begin MEASUREMENT tftamsr_fDmcuTrqReq "" SWORD xjmain_CM_sfix16_En2 0 0 -8192.0 8191.75 ECU_ADDRESS 0x40008250 /* @ECU_Address@tftamsr_fDmcuTrqReq@ */ /end MEASUREMENT
/begin MEASUREMENT rbctmsr_fRgBrTrqReq "" SWORD xjmain_CM_sfix16_En2 0 0 -8192.0 8191.75 ECU_ADDRESS 0x40008244 /* @ECU_Address@rbctmsr_fRgBrTrqReq@ */ /end MEASUREMENT
/begin MEASUREMENT apddmsr_fDmotTrqReq "" SWORD xjmain_CM_sfix16_En2 0 0 -8192.0 8191.75 ECU_ADDRESS 0x40008016 /* @ECU_Address@apddmsr_fDmotTrqReq@ */ /end MEASUREMENT
/begin MEASUREMENT scpcmsr_fDmcuMaxDrTrq "" SWORD xjmain_CM_sfix16_En2 0 0 -8192.0 8191.75 ECU_ADDRESS 0x40008248 /* @ECU_Address@scpcmsr_fDmcuMaxDrTrq@ */ /end MEASUREMENT
/begin MEASUREMENT scpcmsr_fDmcuMaxRgBrTrq "" SWORD xjmain_CM_sfix16_En2 0 0 -8192.0 8191.75 ECU_ADDRESS 0x4000824a /* @ECU_Address@scpcmsr_fDmcuMaxRgBrTrq@ */ /end MEASUREMENT
/begin MEASUREMENT fdstmsr_fDmotBrTrqLmt "" SWORD xjmain_CM_sfix16_En2 0 0 -8192.0 8191.75 ECU_ADDRESS 0x40008100 /* @ECU_Address@fdstmsr_fDmotBrTrqLmt@ */ /end MEASUREMENT
/begin MEASUREMENT fdstmsr_fDmotDrTrqLmt "" SWORD xjmain_CM_sfix16_En2 0 0 -8192.0 8191.75 ECU_ADDRESS 0x40008102 /* @ECU_Address@fdstmsr_fDmotDrTrqLmt@ */ /end MEASUREMENT
/begin MEASUREMENT hldmsr_T2V_i16PmotSpdAct "" SWORD xjmain_CM_int16 0 0 -32768 32767 ECU_ADDRESS 0x400081d4 /* @ECU_Address@hldmsr_T2V_i16PmotSpdAct@ */ /end MEASUREMENT
/begin MEASUREMENT hldmsr_T2V_i16DmotSpdAct "" SWORD xjmain_CM_int16 0 0 -32768 32767 ECU_ADDRESS 0x400081cc /* @ECU_Address@hldmsr_T2V_i16DmotSpdAct@ */ /end MEASUREMENT
/begin MEASUREMENT hldmsr_T2V_i16DmotTmptAct "" SWORD xjmain_CM_int16 0 0 -32768 32767 ECU_ADDRESS 0x400081ce /* @ECU_Address@hldmsr_T2V_i16DmotTmptAct@ */ /end MEASUREMENT
/begin MEASUREMENT hldmsr_T2V_i16DmcuTmptAct "" SWORD xjmain_CM_int16 0 0 -32768 32767 ECU_ADDRESS 0x400081ca /* @ECU_Address@hldmsr_T2V_i16DmcuTmptAct@ */ /end MEASUREMENT
/begin MEASUREMENT hldmsr_T2V_i16PmotTmptAct "" SWORD xjmain_CM_int16 0 0 -32768 32767 ECU_ADDRESS 0x400081d6 /* @ECU_Address@hldmsr_T2V_i16PmotTmptAct@ */ /end MEASUREMENT
/begin MEASUREMENT hldmsr_T2V_i16PmcuTmptAct "" SWORD xjmain_CM_int16 0 0 -32768 32767 ECU_ADDRESS 0x400081d2 /* @ECU_Address@hldmsr_T2V_i16PmcuTmptAct@ */ /end MEASUREMENT
/begin MEASUREMENT hldmsr_B2V_i16BattCellAvgTmpt "" SWORD xjmain_CM_int16 0 0 -32768 32767 ECU_ADDRESS 0x40008150 /* @ECU_Address@hldmsr_B2V_i16BattCellAvgTmpt@ */ /end MEASUREMENT
/begin MEASUREMENT hldmsr_T2V_u8PmcuCanLifeSig "" UBYTE xjmain_CM_uint8 0 0 0 255 ECU_ADDRESS 0x400081df /* @ECU_Address@hldmsr_T2V_u8PmcuCanLifeSig@ */ /end MEASUREMENT
/begin MEASUREMENT hldmsr_T2V_u8PmotRunSts "" UBYTE xjmain_CM_uint8 0 0 0 255 ECU_ADDRESS 0x400081e2 /* @ECU_Address@hldmsr_T2V_u8PmotRunSts@ */ /end MEASUREMENT
/begin MEASUREMENT hldmsr_T2V_u8PmcuFltLvl "" UBYTE xjmain_CM_uint8 0 0 0 255 ECU_ADDRESS 0x400081e1 /* @ECU_Address@hldmsr_T2V_u8PmcuFltLvl@ */ /end MEASUREMENT
/begin MEASUREMENT hldmsr_T2V_u8PmcuFltCode "" UBYTE xjmain_CM_uint8 0 0 0 255 ECU_ADDRESS 0x400081e0 /* @ECU_Address@hldmsr_T2V_u8PmcuFltCode@ */ /end MEASUREMENT
/begin MEASUREMENT hldmsr_T2V_u8DmotRunSts "" UBYTE xjmain_CM_uint8 0 0 0 255 ECU_ADDRESS 0x400081dd /* @ECU_Address@hldmsr_T2V_u8DmotRunSts@ */ /end MEASUREMENT
/begin MEASUREMENT hldmsr_T2V_u8DmcuCanLifeSig "" UBYTE xjmain_CM_uint8 0 0 0 255 ECU_ADDRESS 0x400081da /* @ECU_Address@hldmsr_T2V_u8DmcuCanLifeSig@ */ /end MEASUREMENT
/begin MEASUREMENT hldmsr_T2V_u8DmcuFltLvl "" UBYTE xjmain_CM_uint8 0 0 0 255 ECU_ADDRESS 0x400081dc /* @ECU_Address@hldmsr_T2V_u8DmcuFltLvl@ */ /end MEASUREMENT
/begin MEASUREMENT hldmsr_B2V_u8MainNegRlySts "" UBYTE xjmain_CM_uint8 0 0 0 255 ECU_ADDRESS 0x4000816a /* @ECU_Address@hldmsr_B2V_u8MainNegRlySts@ */ /end MEASUREMENT
/begin MEASUREMENT hldmsr_B2V_u8FCPosRly1Sts "" UBYTE xjmain_CM_uint8 0 0 0 255 ECU_ADDRESS 0x40008168 /* @ECU_Address@hldmsr_B2V_u8FCPosRly1Sts@ */ /end MEASUREMENT
/begin MEASUREMENT hldmsr_B2V_u8FCNegRly1Sts "" UBYTE xjmain_CM_uint8 0 0 0 255 ECU_ADDRESS 0x40008166 /* @ECU_Address@hldmsr_B2V_u8FCNegRly1Sts@ */ /end MEASUREMENT
/begin MEASUREMENT hldmsr_B2V_u8FCPosRly2Sts "" UBYTE xjmain_CM_uint8 0 0 0 255 ECU_ADDRESS 0x40008169 /* @ECU_Address@hldmsr_B2V_u8FCPosRly2Sts@ */ /end MEASUREMENT
/begin MEASUREMENT hldmsr_B2V_u8FCNegRly2Sts "" UBYTE xjmain_CM_uint8 0 0 0 255 ECU_ADDRESS 0x40008167 /* @ECU_Address@hldmsr_B2V_u8FCNegRly2Sts@ */ /end MEASUREMENT
/begin MEASUREMENT hldmsr_B2V_u8PTCPosRlySts "" UBYTE xjmain_CM_uint8 0 0 0 255 ECU_ADDRESS 0x4000816c /* @ECU_Address@hldmsr_B2V_u8PTCPosRlySts@ */ /end MEASUREMENT
/begin MEASUREMENT hldmsr_B2V_u8PTCNegRlySts "" UBYTE xjmain_CM_uint8 0 0 0 255 ECU_ADDRESS 0x4000816b /* @ECU_Address@hldmsr_B2V_u8PTCNegRlySts@ */ /end MEASUREMENT
/begin MEASUREMENT hldmsr_B2V_u8CurrentHVSts "" UBYTE xjmain_CM_uint8 0 0 0 255 ECU_ADDRESS 0x40008163 /* @ECU_Address@hldmsr_B2V_u8CurrentHVSts@ */ /end MEASUREMENT
/begin MEASUREMENT hldmsr_B2V_u8DCChgConnSts "" UBYTE xjmain_CM_uint8 0 0 0 255 ECU_ADDRESS 0x40008165 /* @ECU_Address@hldmsr_B2V_u8DCChgConnSts@ */ /end MEASUREMENT
/begin MEASUREMENT hldmsr_B2V_u8CurrentChgSts "" UBYTE xjmain_CM_uint8 0 0 0 255 ECU_ADDRESS 0x40008162 /* @ECU_Address@hldmsr_B2V_u8CurrentChgSts@ */ /end MEASUREMENT
/begin MEASUREMENT hldmsr_B2V_u8CurrentHeatSts "" UBYTE xjmain_CM_uint8 0 0 0 255 ECU_ADDRESS 0x40008164 /* @ECU_Address@hldmsr_B2V_u8CurrentHeatSts@ */ /end MEASUREMENT
/begin MEASUREMENT hldmsr_T2V_u8GearFltLvl "" UBYTE xjmain_CM_uint8 0 0 0 255 ECU_ADDRESS 0x400081de /* @ECU_Address@hldmsr_T2V_u8GearFltLvl@ */ /end MEASUREMENT
/begin MEASUREMENT hldmsr_T2V_u8DmcuFltCode "" UBYTE xjmain_CM_uint8 0 0 0 255 ECU_ADDRESS 0x400081db /* @ECU_Address@hldmsr_T2V_u8DmcuFltCode@ */ /end MEASUREMENT
/begin MEASUREMENT hldmsr_B2V_u8BattFltCode "" UBYTE xjmain_CM_uint8 0 0 0 255 ECU_ADDRESS 0x40008160 /* @ECU_Address@hldmsr_B2V_u8BattFltCode@ */ /end MEASUREMENT
/begin MEASUREMENT hldmsr_B2V_u8BattFltLvl "" UBYTE xjmain_CM_uint8 0 0 0 255 ECU_ADDRESS 0x40008161 /* @ECU_Address@hldmsr_B2V_u8BattFltLvl@ */ /end MEASUREMENT
/begin MEASUREMENT hldmsr_I2V_u8ChgPwrSet "" UBYTE xjmain_CM_uint8 0 0 0 255 ECU_ADDRESS 0x4000818c /* @ECU_Address@hldmsr_I2V_u8ChgPwrSet@ */ /end MEASUREMENT
/begin MEASUREMENT hldmsr_I2V_u8ChgModeSet "" UBYTE xjmain_CM_uint8 0 0 0 255 ECU_ADDRESS 0x4000818a /* @ECU_Address@hldmsr_I2V_u8ChgModeSet@ */ /end MEASUREMENT
/begin MEASUREMENT hldmsr_I2V_u8ChgOnOffCtrl "" UBYTE xjmain_CM_uint8 0 0 0 255 ECU_ADDRESS 0x4000818b /* @ECU_Address@hldmsr_I2V_u8ChgOnOffCtrl@ */ /end MEASUREMENT
/begin MEASUREMENT hldmsr_P2V_u8DcacRunSts "" UBYTE xjmain_CM_uint8 0 0 0 255 ECU_ADDRESS 0x4000819c /* @ECU_Address@hldmsr_P2V_u8DcacRunSts@ */ /end MEASUREMENT
/begin MEASUREMENT hldmsr_B2O_u8ChgOnOffCtrl "" UBYTE xjmain_CM_uint8 0 0 0 255 ECU_ADDRESS 0x4000813a /* @ECU_Address@hldmsr_B2O_u8ChgOnOffCtrl@ */ /end MEASUREMENT
/begin MEASUREMENT appmsr_u8RunStatus "" UBYTE xjmain_CM_uint8 0 0 0.0 3.0 ECU_ADDRESS 0x40008030 /* @ECU_Address@appmsr_u8RunStatus@ */ /end MEASUREMENT
/begin MEASUREMENT mmctmsr_u8DmcuRunModeReq "" UBYTE xjmain_CM_uint8 0 0 0 255 ECU_ADDRESS 0x4000821d /* @ECU_Address@mmctmsr_u8DmcuRunModeReq@ */ /end MEASUREMENT
/begin MEASUREMENT mmctmsr_u8DmcuDirModeReq "" UBYTE xjmain_CM_uint8 0 0 0 255 ECU_ADDRESS 0x4000821c /* @ECU_Address@mmctmsr_u8DmcuDirModeReq@ */ /end MEASUREMENT
/begin MEASUREMENT mmctmsr_u8PmcuRunModeReq "" UBYTE xjmain_CM_uint8 0 0 0 255 ECU_ADDRESS 0x4000821f /* @ECU_Address@mmctmsr_u8PmcuRunModeReq@ */ /end MEASUREMENT
/begin MEASUREMENT mmctmsr_u8PmcuDirModeReq "" UBYTE xjmain_CM_uint8 0 0 0 255 ECU_ADDRESS 0x4000821e /* @ECU_Address@mmctmsr_u8PmcuDirModeReq@ */ /end MEASUREMENT
/begin MEASUREMENT poocmsr_u8StepRunSts "" UBYTE xjmain_CM_uint8 0 0 0 255 ECU_ADDRESS 0x40008243 /* @ECU_Address@poocmsr_u8StepRunSts@ */ /end MEASUREMENT
/begin MEASUREMENT poocmsr_u8StepRunFlt "" UBYTE xjmain_CM_uint8 0 0 0 255 ECU_ADDRESS 0x40008242 /* @ECU_Address@poocmsr_u8StepRunFlt@ */ /end MEASUREMENT
/begin MEASUREMENT fdstmsr_u8VehFltLvl "" UBYTE xjmain_CM_uint8 0 0 0 255 ECU_ADDRESS 0x40008107 /* @ECU_Address@fdstmsr_u8VehFltLvl@ */ /end MEASUREMENT
/begin MEASUREMENT aiptmsr_u8WindLvl "" UBYTE xjmain_CM_uint8 0 0 0 255 ECU_ADDRESS 0x40008013 /* @ECU_Address@aiptmsr_u8WindLvl@ */ /end MEASUREMENT
/begin MEASUREMENT hldmsr_T2V_i8SelectGear "" SBYTE xjmain_CM_int8 0 0 -128 127 ECU_ADDRESS 0x400081d9 /* @ECU_Address@hldmsr_T2V_i8SelectGear@ */ /end MEASUREMENT
/begin MEASUREMENT hldmsr_T2V_i8CurrentGear "" SBYTE xjmain_CM_int8 0 0 -128 127 ECU_ADDRESS 0x400081d8 /* @ECU_Address@hldmsr_T2V_i8CurrentGear@ */ /end MEASUREMENT
/begin MEASUREMENT tftamsr_i8DmcuTrqReqMode "" SBYTE xjmain_CM_int8 0 0 -128 127 ECU_ADDRESS 0x40008252 /* @ECU_Address@tftamsr_i8DmcuTrqReqMode@ */ /end MEASUREMENT
/begin MEASUREMENT gmctmsr_i8CurrentGear "" SBYTE xjmain_CM_int8 0 0 -128 127 ECU_ADDRESS 0x40008128 /* @ECU_Address@gmctmsr_i8CurrentGear@ */ /end MEASUREMENT
/begin MEASUREMENT diptmsr_i8GearPos "" SBYTE xjmain_CM_int8 0 0 -128 127 ECU_ADDRESS 0x400080e5 /* @ECU_Address@diptmsr_i8GearPos@ */ /end MEASUREMENT
/begin MEASUREMENT hldmsr_T2V_hasPmotStart "" UBYTE xjmain_CM_boolean 0 0 0 1 ECU_ADDRESS 0x400081c8 /* @ECU_Address@hldmsr_T2V_hasPmotStart@ */ /end MEASUREMENT
/begin MEASUREMENT hldmsr_T2V_hasPmcuDisChg "" UBYTE xjmain_CM_boolean 0 0 0 1 ECU_ADDRESS 0x400081c4 /* @ECU_Address@hldmsr_T2V_hasPmcuDisChg@ */ /end MEASUREMENT
/begin MEASUREMENT hldmsr_T2V_hasPmotFlt "" UBYTE xjmain_CM_boolean 0 0 0 1 ECU_ADDRESS 0x400081c6 /* @ECU_Address@hldmsr_T2V_hasPmotFlt@ */ /end MEASUREMENT
/begin MEASUREMENT hldmsr_T2V_hasPmotEn "" UBYTE xjmain_CM_boolean 0 0 0 1 ECU_ADDRESS 0x400081c5 /* @ECU_Address@hldmsr_T2V_hasPmotEn@ */ /end MEASUREMENT
/begin MEASUREMENT hldmsr_T2V_hasPmotSpdMode "" UBYTE xjmain_CM_boolean 0 0 0 1 ECU_ADDRESS 0x400081c7 /* @ECU_Address@hldmsr_T2V_hasPmotSpdMode@ */ /end MEASUREMENT
/begin MEASUREMENT hldmsr_DI_Start "" UBYTE xjmain_CM_boolean 0 0 0 1 ECU_ADDRESS 0x40008185 /* @ECU_Address@hldmsr_DI_Start@ */ /end MEASUREMENT
/begin MEASUREMENT hldmsr_DI_GearR "" UBYTE xjmain_CM_boolean 0 0 0 1 ECU_ADDRESS 0x4000817f /* @ECU_Address@hldmsr_DI_GearR@ */ /end MEASUREMENT
/begin MEASUREMENT hldmsr_DI_GearD1 "" UBYTE xjmain_CM_boolean 0 0 0 1 ECU_ADDRESS 0x4000817b /* @ECU_Address@hldmsr_DI_GearD1@ */ /end MEASUREMENT
/begin MEASUREMENT hldmsr_DI_GearD2 "" UBYTE xjmain_CM_boolean 0 0 0 1 ECU_ADDRESS 0x4000817c /* @ECU_Address@hldmsr_DI_GearD2@ */ /end MEASUREMENT
/begin MEASUREMENT hldmsr_DI_GearD3 "" UBYTE xjmain_CM_boolean 0 0 0 1 ECU_ADDRESS 0x4000817d /* @ECU_Address@hldmsr_DI_GearD3@ */ /end MEASUREMENT
/begin MEASUREMENT hldmsr_DI_GearD4 "" UBYTE xjmain_CM_boolean 0 0 0 1 ECU_ADDRESS 0x4000817e /* @ECU_Address@hldmsr_DI_GearD4@ */ /end MEASUREMENT
/begin MEASUREMENT hldmsr_DI_PmotLowSpd "" UBYTE xjmain_CM_boolean 0 0 0 1 ECU_ADDRESS 0x40008182 /* @ECU_Address@hldmsr_DI_PmotLowSpd@ */ /end MEASUREMENT
/begin MEASUREMENT hldmsr_DI_PmotHighSpd "" UBYTE xjmain_CM_boolean 0 0 0 1 ECU_ADDRESS 0x40008181 /* @ECU_Address@hldmsr_DI_PmotHighSpd@ */ /end MEASUREMENT
/begin MEASUREMENT hldmsr_DI_AirPump "" UBYTE xjmain_CM_boolean 0 0 0 1 ECU_ADDRESS 0x40008178 /* @ECU_Address@hldmsr_DI_AirPump@ */ /end MEASUREMENT
/begin MEASUREMENT hldmsr_DI_Regen "" UBYTE xjmain_CM_boolean 0 0 0 1 ECU_ADDRESS 0x40008183 /* @ECU_Address@hldmsr_DI_Regen@ */ /end MEASUREMENT
/begin MEASUREMENT hldmsr_DI_Ring "" UBYTE xjmain_CM_boolean 0 0 0 1 ECU_ADDRESS 0x40008184 /* @ECU_Address@hldmsr_DI_Ring@ */ /end MEASUREMENT
/begin MEASUREMENT hldmsr_DI_ES "" UBYTE xjmain_CM_boolean 0 0 0 1 ECU_ADDRESS 0x4000817a /* @ECU_Address@hldmsr_DI_ES@ */ /end MEASUREMENT
/begin MEASUREMENT hldmsr_DI_DmotSpdMode "" UBYTE xjmain_CM_boolean 0 0 0 1 ECU_ADDRESS 0x40008179 /* @ECU_Address@hldmsr_DI_DmotSpdMode@ */ /end MEASUREMENT
/begin MEASUREMENT hldmsr_T2V_hasDmcuDisChg "" UBYTE xjmain_CM_boolean 0 0 0 1 ECU_ADDRESS 0x400081c2 /* @ECU_Address@hldmsr_T2V_hasDmcuDisChg@ */ /end MEASUREMENT
/begin MEASUREMENT hldmsr_T2V_hasDmotEn "" UBYTE xjmain_CM_boolean 0 0 0 1 ECU_ADDRESS 0x400081c3 /* @ECU_Address@hldmsr_T2V_hasDmotEn@ */ /end MEASUREMENT
/begin MEASUREMENT hldmsr_P2V_hasPduRdy "" UBYTE xjmain_CM_boolean 0 0 0 1 ECU_ADDRESS 0x40008199 /* @ECU_Address@hldmsr_P2V_hasPduRdy@ */ /end MEASUREMENT
/begin MEASUREMENT hldmsr_O2B_hasChgHwFlt "" UBYTE xjmain_CM_boolean 0 0 0 1 ECU_ADDRESS 0x40008193 /* @ECU_Address@hldmsr_O2B_hasChgHwFlt@ */ /end MEASUREMENT
/begin MEASUREMENT hldmsr_O2B_hasChgOvrTmptFlt "" UBYTE xjmain_CM_boolean 0 0 0 1 ECU_ADDRESS 0x40008196 /* @ECU_Address@hldmsr_O2B_hasChgOvrTmptFlt@ */ /end MEASUREMENT
/begin MEASUREMENT hldmsr_O2B_hasChgInVoltFlt "" UBYTE xjmain_CM_boolean 0 0 0 1 ECU_ADDRESS 0x40008194 /* @ECU_Address@hldmsr_O2B_hasChgInVoltFlt@ */ /end MEASUREMENT
/begin MEASUREMENT hldmsr_O2B_hasChgSlfChkFlt "" UBYTE xjmain_CM_boolean 0 0 0 1 ECU_ADDRESS 0x40008197 /* @ECU_Address@hldmsr_O2B_hasChgSlfChkFlt@ */ /end MEASUREMENT
/begin MEASUREMENT hldmsr_O2B_hasChgOff "" UBYTE xjmain_CM_boolean 0 0 0 1 ECU_ADDRESS 0x40008195 /* @ECU_Address@hldmsr_O2B_hasChgOff@ */ /end MEASUREMENT
/begin MEASUREMENT hldmsr_O2B_hasChgCanFlt "" UBYTE xjmain_CM_boolean 0 0 0 1 ECU_ADDRESS 0x40008192 /* @ECU_Address@hldmsr_O2B_hasChgCanFlt@ */ /end MEASUREMENT
/begin MEASUREMENT hldmsr_O2B_hasChgWakeUp "" UBYTE xjmain_CM_boolean 0 0 0 1 ECU_ADDRESS 0x40008198 /* @ECU_Address@hldmsr_O2B_hasChgWakeUp@ */ /end MEASUREMENT
/begin MEASUREMENT rbctmsr_isRegen "" UBYTE xjmain_CM_boolean 0 0 0 1 ECU_ADDRESS 0x40008246 /* @ECU_Address@rbctmsr_isRegen@ */ /end MEASUREMENT
/begin MEASUREMENT poocmsr_isDmcuConn "" UBYTE xjmain_CM_boolean 0 0 0 1 ECU_ADDRESS 0x40008238 /* @ECU_Address@poocmsr_isDmcuConn@ */ /end MEASUREMENT
/begin MEASUREMENT poocmsr_isDisConnLV "" UBYTE xjmain_CM_boolean 0 0 0 1 ECU_ADDRESS 0x40008237 /* @ECU_Address@poocmsr_isDisConnLV@ */ /end MEASUREMENT
/begin MEASUREMENT poocmsr_hasVehRdy "" UBYTE xjmain_CM_boolean 0 0 0 1 ECU_ADDRESS 0x40008233 /* @ECU_Address@poocmsr_hasVehRdy@ */ /end MEASUREMENT
/begin MEASUREMENT poocmsr_isDcdcDcacConn "" UBYTE xjmain_CM_boolean 0 0 0 1 ECU_ADDRESS 0x40008236 /* @ECU_Address@poocmsr_isDcdcDcacConn@ */ /end MEASUREMENT
/begin MEASUREMENT poocmsr_isObcConn "" UBYTE xjmain_CM_boolean 0 0 0 1 ECU_ADDRESS 0x4000823c /* @ECU_Address@poocmsr_isObcConn@ */ /end MEASUREMENT
/begin MEASUREMENT poocmsr_hasVehLVDown "" UBYTE xjmain_CM_boolean 0 0 0 1 ECU_ADDRESS 0x40008232 /* @ECU_Address@poocmsr_hasVehLVDown@ */ /end MEASUREMENT
/begin MEASUREMENT poocmsr_isPmcuEn "" UBYTE xjmain_CM_boolean 0 0 0 1 ECU_ADDRESS 0x4000823e /* @ECU_Address@poocmsr_isPmcuEn@ */ /end MEASUREMENT
/begin MEASUREMENT poocmsr_isDmcuPreConn "" UBYTE xjmain_CM_boolean 0 0 0 1 ECU_ADDRESS 0x4000823a /* @ECU_Address@poocmsr_isDmcuPreConn@ */ /end MEASUREMENT
/begin MEASUREMENT poocmsr_isPmcuPreConn "" UBYTE xjmain_CM_boolean 0 0 0 1 ECU_ADDRESS 0x4000823f /* @ECU_Address@poocmsr_isPmcuPreConn@ */ /end MEASUREMENT
/begin MEASUREMENT poocmsr_isPmcuConn "" UBYTE xjmain_CM_boolean 0 0 0 1 ECU_ADDRESS 0x4000823d /* @ECU_Address@poocmsr_isPmcuConn@ */ /end MEASUREMENT
/begin MEASUREMENT poocmsr_isBattConn "" UBYTE xjmain_CM_boolean 0 0 0 1 ECU_ADDRESS 0x40008234 /* @ECU_Address@poocmsr_isBattConn@ */ /end MEASUREMENT
/begin MEASUREMENT poocmsr_hasBattConn "" UBYTE xjmain_CM_boolean 0 0 0 1 ECU_ADDRESS 0x40008231 /* @ECU_Address@poocmsr_hasBattConn@ */ /end MEASUREMENT
/begin MEASUREMENT poocmsr_isDmcuEn "" UBYTE xjmain_CM_boolean 0 0 0 1 ECU_ADDRESS 0x40008239 /* @ECU_Address@poocmsr_isDmcuEn@ */ /end MEASUREMENT
/begin MEASUREMENT poocmsr_isChgAllow "" UBYTE xjmain_CM_boolean 0 0 0 1 ECU_ADDRESS 0x40008235 /* @ECU_Address@poocmsr_isChgAllow@ */ /end MEASUREMENT
/begin MEASUREMENT poocmsr_isWarningLight "" UBYTE xjmain_CM_boolean 0 0 0 1 ECU_ADDRESS 0x40008241 /* @ECU_Address@poocmsr_isWarningLight@ */ /end MEASUREMENT
/begin MEASUREMENT poocmsr_isMcuDisChg "" UBYTE xjmain_CM_boolean 0 0 0 1 ECU_ADDRESS 0x4000823b /* @ECU_Address@poocmsr_isMcuDisChg@ */ /end MEASUREMENT
/begin MEASUREMENT poocmsr_isRlyFlt "" UBYTE xjmain_CM_boolean 0 0 0 1 ECU_ADDRESS 0x40008240 /* @ECU_Address@poocmsr_isRlyFlt@ */ /end MEASUREMENT
/begin MEASUREMENT fdstmsr_isBattHVEn "" UBYTE xjmain_CM_boolean 0 0 0 1 ECU_ADDRESS 0x40008104 /* @ECU_Address@fdstmsr_isBattHVEn@ */ /end MEASUREMENT
/begin MEASUREMENT fdstmsr_isDmcuEn "" UBYTE xjmain_CM_boolean 0 0 0 1 ECU_ADDRESS 0x40008105 /* @ECU_Address@fdstmsr_isDmcuEn@ */ /end MEASUREMENT
/begin MEASUREMENT fdstmsr_isPmcuEn "" UBYTE xjmain_CM_boolean 0 0 0 1 ECU_ADDRESS 0x40008106 /* @ECU_Address@fdstmsr_isPmcuEn@ */ /end MEASUREMENT
/begin MEASUREMENT aiptmsr_isAPValid "" UBYTE xjmain_CM_boolean 0 0 0 1 ECU_ADDRESS 0x4000800d /* @ECU_Address@aiptmsr_isAPValid@ */ /end MEASUREMENT
/begin MEASUREMENT aiptmsr_isAPAction "" UBYTE xjmain_CM_boolean 0 0 0 1 ECU_ADDRESS 0x4000800c /* @ECU_Address@aiptmsr_isAPAction@ */ /end MEASUREMENT
/begin MEASUREMENT aiptmsr_isHWValid "" UBYTE xjmain_CM_boolean 0 0 0 1 ECU_ADDRESS 0x40008010 /* @ECU_Address@aiptmsr_isHWValid@ */ /end MEASUREMENT
/begin MEASUREMENT aiptmsr_isWindSpdValid "" UBYTE xjmain_CM_boolean 0 0 0 1 ECU_ADDRESS 0x40008012 /* @ECU_Address@aiptmsr_isWindSpdValid@ */ /end MEASUREMENT
/begin MEASUREMENT aiptmsr_isStopEnginePwr "" UBYTE xjmain_CM_boolean 0 0 0 1 ECU_ADDRESS 0x40008011 /* @ECU_Address@aiptmsr_isStopEnginePwr@ */ /end MEASUREMENT
/begin MEASUREMENT aiptmsr_isDmotSpdResAction "" UBYTE xjmain_CM_boolean 0 0 0 1 ECU_ADDRESS 0x4000800e /* @ECU_Address@aiptmsr_isDmotSpdResAction@ */ /end MEASUREMENT
/begin MEASUREMENT aiptmsr_isDmotSpdResValid "" UBYTE xjmain_CM_boolean 0 0 0 1 ECU_ADDRESS 0x4000800f /* @ECU_Address@aiptmsr_isDmotSpdResValid@ */ /end MEASUREMENT
/begin MEASUREMENT diptmsr_isPmotLowSpd "" UBYTE xjmain_CM_boolean 0 0 0 1 ECU_ADDRESS 0x400080ec /* @ECU_Address@diptmsr_isPmotLowSpd@ */ /end MEASUREMENT
/begin MEASUREMENT diptmsr_isPmotHighSpd "" UBYTE xjmain_CM_boolean 0 0 0 1 ECU_ADDRESS 0x400080eb /* @ECU_Address@diptmsr_isPmotHighSpd@ */ /end MEASUREMENT
/begin MEASUREMENT diptmsr_isES "" UBYTE xjmain_CM_boolean 0 0 0 1 ECU_ADDRESS 0x400080e8 /* @ECU_Address@diptmsr_isES@ */ /end MEASUREMENT
/begin MEASUREMENT diptmsr_isStart "" UBYTE xjmain_CM_boolean 0 0 0 1 ECU_ADDRESS 0x400080f0 /* @ECU_Address@diptmsr_isStart@ */ /end MEASUREMENT
/begin MEASUREMENT diptmsr_isReqShutdown "" UBYTE xjmain_CM_boolean 0 0 0 1 ECU_ADDRESS 0x400080ee /* @ECU_Address@diptmsr_isReqShutdown@ */ /end MEASUREMENT
/begin MEASUREMENT diptmsr_isKl15 "" UBYTE xjmain_CM_boolean 0 0 0 1 ECU_ADDRESS 0x400080e9 /* @ECU_Address@diptmsr_isKl15@ */ /end MEASUREMENT
/begin MEASUREMENT diptmsr_isKl15_Raw "" UBYTE xjmain_CM_boolean 0 0 0 1 ECU_ADDRESS 0x400080ea /* @ECU_Address@diptmsr_isKl15_Raw@ */ /end MEASUREMENT
/begin MEASUREMENT diptmsr_isRegen "" UBYTE xjmain_CM_boolean 0 0 0 1 ECU_ADDRESS 0x400080ed /* @ECU_Address@diptmsr_isRegen@ */ /end MEASUREMENT
/begin MEASUREMENT diptmsr_isAirPump "" UBYTE xjmain_CM_boolean 0 0 0 1 ECU_ADDRESS 0x400080e6 /* @ECU_Address@diptmsr_isAirPump@ */ /end MEASUREMENT
/begin MEASUREMENT diptmsr_isRing "" UBYTE xjmain_CM_boolean 0 0 0 1 ECU_ADDRESS 0x400080ef /* @ECU_Address@diptmsr_isRing@ */ /end MEASUREMENT
/begin MEASUREMENT diptmsr_isDmotSpdMode "" UBYTE xjmain_CM_boolean 0 0 0 1 ECU_ADDRESS 0x400080e7 /* @ECU_Address@diptmsr_isDmotSpdMode@ */ /end MEASUREMENT
/begin MEASUREMENT coptmsr_V2P_u16RefVolt "" UWORD xjmain_CM_uint16 0 0 0 65535 ECU_ADDRESS 0x400080d0 /* @ECU_Address@coptmsr_V2P_u16RefVolt@ */ /end MEASUREMENT
/begin MEASUREMENT coptmsr_V2P_hasMainNegRlyClosed "" UBYTE xjmain_CM_boolean 0 0 0 1 ECU_ADDRESS 0x400080c7 /* @ECU_Address@coptmsr_V2P_hasMainNegRlyClosed@ */ /end MEASUREMENT
/begin MEASUREMENT coptmsr_V2T_hasPmcuRlyClosed "" UBYTE xjmain_CM_boolean 0 0 0 1 ECU_ADDRESS 0x400080d6 /* @ECU_Address@coptmsr_V2T_hasPmcuRlyClosed@ */ /end MEASUREMENT
/begin MEASUREMENT doptmsr_isDMotInd "" UBYTE xjmain_CM_boolean 0 0 0 1 ECU_ADDRESS 0x400080f4 /* @ECU_Address@doptmsr_isDMotInd@ */ /end MEASUREMENT
/begin MEASUREMENT doptmsr_isPduWakeUp "" UBYTE xjmain_CM_boolean 0 0 0 1 ECU_ADDRESS 0x400080f7 /* @ECU_Address@doptmsr_isPduWakeUp@ */ /end MEASUREMENT
/begin MEASUREMENT doptmsr_isOBCInd "" UBYTE xjmain_CM_boolean 0 0 0 1 ECU_ADDRESS 0x400080f6 /* @ECU_Address@doptmsr_isOBCInd@ */ /end MEASUREMENT
/begin MEASUREMENT doptmsr_isRgInd "" UBYTE xjmain_CM_boolean 0 0 0 1 ECU_ADDRESS 0x400080f9 /* @ECU_Address@doptmsr_isRgInd@ */ /end MEASUREMENT
/begin MEASUREMENT doptmsr_isPmotInd "" UBYTE xjmain_CM_boolean 0 0 0 1 ECU_ADDRESS 0x400080f8 /* @ECU_Address@doptmsr_isPmotInd@ */ /end MEASUREMENT
/begin MEASUREMENT doptmsr_isAirPumpInd "" UBYTE xjmain_CM_boolean 0 0 0 1 ECU_ADDRESS 0x400080f1 /* @ECU_Address@doptmsr_isAirPumpInd@ */ /end MEASUREMENT
/begin MEASUREMENT doptmsr_isStopEnginePwr "" UBYTE xjmain_CM_boolean 0 0 0 1 ECU_ADDRESS 0x400080fb /* @ECU_Address@doptmsr_isStopEnginePwr@ */ /end MEASUREMENT
/begin MEASUREMENT doptmsr_isBattHeatInd "" UBYTE xjmain_CM_boolean 0 0 0 1 ECU_ADDRESS 0x400080f3 /* @ECU_Address@doptmsr_isBattHeatInd@ */ /end MEASUREMENT
/begin MEASUREMENT doptmsr_isDmotFltInd "" UBYTE xjmain_CM_boolean 0 0 0 1 ECU_ADDRESS 0x400080f5 /* @ECU_Address@doptmsr_isDmotFltInd@ */ /end MEASUREMENT
/begin MEASUREMENT doptmsr_isBattFltInd "" UBYTE xjmain_CM_boolean 0 0 0 1 ECU_ADDRESS 0x400080f2 /* @ECU_Address@doptmsr_isBattFltInd@ */ /end MEASUREMENT
/begin MEASUREMENT doptmsr_isRing "" UBYTE xjmain_CM_boolean 0 0 0 1 ECU_ADDRESS 0x400080fa /* @ECU_Address@doptmsr_isRing@ */ /end MEASUREMENT
/begin MEASUREMENT amctmsr_isAirPumpRun "" UBYTE xjmain_CM_boolean 0 0 0 1 ECU_ADDRESS 0x40008014 /* @ECU_Address@amctmsr_isAirPumpRun@ */ /end MEASUREMENT
/begin MEASUREMENT amctmsr_isDcdcRun "" UBYTE xjmain_CM_boolean 0 0 0 1 ECU_ADDRESS 0x40008015 /* @ECU_Address@amctmsr_isDcdcRun@ */ /end MEASUREMENT
/begin MEASUREMENT wctrlmsr_u16PmcuSpdReq "" UWORD xjmain_CM_uint16 0 0 0 65535 ECU_ADDRESS 0x4000825a /* @ECU_Address@wctrlmsr_u16PmcuSpdReq@ */ /end MEASUREMENT
/begin MEASUREMENT wctrlmsr_i8PmcuSpdReqMode "" SBYTE xjmain_CM_int8 0 0 -128 127 ECU_ADDRESS 0x40008258 /* @ECU_Address@wctrlmsr_i8PmcuSpdReqMode@ */ /end MEASUREMENT
/begin MEASUREMENT obcmsr_fChgVoltSet "" UWORD xjmain_CM_ufix16_En4 0 0 0 4095.9375 ECU_ADDRESS 0x40008226 /* @ECU_Address@obcmsr_fChgVoltSet@ */ /end MEASUREMENT
/begin MEASUREMENT obcmsr_fChgCurrSet "" UWORD xjmain_CM_ufix16_En2 0 0 0 16383.75 ECU_ADDRESS 0x40008224 /* @ECU_Address@obcmsr_fChgCurrSet@ */ /end MEASUREMENT
/begin MEASUREMENT obcmsr_u8BattChgMode "" UBYTE xjmain_CM_uint8 0 0 0 255 ECU_ADDRESS 0x40008229 /* @ECU_Address@obcmsr_u8BattChgMode@ */ /end MEASUREMENT
/begin MEASUREMENT obcmsr_isChgStart "" UBYTE xjmain_CM_boolean 0 0 0 1 ECU_ADDRESS 0x40008228 /* @ECU_Address@obcmsr_isChgStart@ */ /end MEASUREMENT
/begin MEASUREMENT ciptmsr_O2B_fChgOutPwrAct_kW "" UWORD xjmain_CM_uint16 0 0 0 65535 ECU_ADDRESS 0x4000806a /* @ECU_Address@ciptmsr_O2B_fChgOutPwrAct_kW@ */ /end MEASUREMENT
/begin MEASUREMENT ciptmsr_I2V_u16PmotSpdHSet "" UWORD xjmain_CM_uint16 0 0 0 65535 ECU_ADDRESS 0x40008060 /* @ECU_Address@ciptmsr_I2V_u16PmotSpdHSet@ */ /end MEASUREMENT
/begin MEASUREMENT ciptmsr_I2V_u16PmotSpdLSet "" UWORD xjmain_CM_uint16 0 0 0 65535 ECU_ADDRESS 0x40008062 /* @ECU_Address@ciptmsr_I2V_u16PmotSpdLSet@ */ /end MEASUREMENT
/begin MEASUREMENT ciptmsr_B2V_fBattCellMaxVolt "" UWORD xjmain_CM_ufix16_En9 0 0 0 127.998046875 ECU_ADDRESS 0x40008032 /* @ECU_Address@ciptmsr_B2V_fBattCellMaxVolt@ */ /end MEASUREMENT
/begin MEASUREMENT ciptmsr_B2V_fBattCellMinVolt "" UWORD xjmain_CM_ufix16_En9 0 0 0 127.998046875 ECU_ADDRESS 0x40008034 /* @ECU_Address@ciptmsr_B2V_fBattCellMinVolt@ */ /end MEASUREMENT
/begin MEASUREMENT ciptmsr_B2V_fBattMaxDisChgPwr_kW "" UWORD xjmain_CM_ufix16_En6 0 0 0 1023.984375 ECU_ADDRESS 0x40008044 /* @ECU_Address@ciptmsr_B2V_fBattMaxDisChgPwr_kW@ */ /end MEASUREMENT
/begin MEASUREMENT ciptmsr_B2V_fBattMaxChgPwr_kW "" UWORD xjmain_CM_ufix16_En6 0 0 0 1023.984375 ECU_ADDRESS 0x40008042 /* @ECU_Address@ciptmsr_B2V_fBattMaxChgPwr_kW@ */ /end MEASUREMENT
/begin MEASUREMENT ciptmsr_B2V_fBattContDisChgPwr_kW "" UWORD xjmain_CM_ufix16_En6 0 0 0 1023.984375 ECU_ADDRESS 0x4000803c /* @ECU_Address@ciptmsr_B2V_fBattContDisChgPwr_kW@ */ /end MEASUREMENT
/begin MEASUREMENT ciptmsr_B2V_fBattContChgPwr_kW "" UWORD xjmain_CM_ufix16_En6 0 0 0 1023.984375 ECU_ADDRESS 0x4000803a /* @ECU_Address@ciptmsr_B2V_fBattContChgPwr_kW@ */ /end MEASUREMENT
/begin MEASUREMENT ciptmsr_T2V_fDmotAcCurrAct "" UWORD xjmain_CM_ufix16_En4 0 0 0 4095.9375 ECU_ADDRESS 0x40008086 /* @ECU_Address@ciptmsr_T2V_fDmotAcCurrAct@ */ /end MEASUREMENT
/begin MEASUREMENT ciptmsr_O2B_fChgOutCurrAct "" UWORD xjmain_CM_ufix16_En4 0 0 0 4095.9375 ECU_ADDRESS 0x40008068 /* @ECU_Address@ciptmsr_O2B_fChgOutCurrAct@ */ /end MEASUREMENT
/begin MEASUREMENT ciptmsr_O2B_fChgOutVoltAct "" UWORD xjmain_CM_ufix16_En4 0 0 0 4095.9375 ECU_ADDRESS 0x4000806c /* @ECU_Address@ciptmsr_O2B_fChgOutVoltAct@ */ /end MEASUREMENT
/begin MEASUREMENT ciptmsr_T2V_fPmotAcCurrAct "" UWORD xjmain_CM_ufix16_En4 0 0 0 4095.9375 ECU_ADDRESS 0x4000808e /* @ECU_Address@ciptmsr_T2V_fPmotAcCurrAct@ */ /end MEASUREMENT
/begin MEASUREMENT ciptmsr_B2V_fBattSOC "" UWORD xjmain_CM_ufix16_En4 0 0 0 4095.9375 ECU_ADDRESS 0x4000804a /* @ECU_Address@ciptmsr_B2V_fBattSOC@ */ /end MEASUREMENT
/begin MEASUREMENT ciptmsr_B2V_fBattDisChgCurrPeak "" UWORD xjmain_CM_ufix16_En4 0 0 0 4095.9375 ECU_ADDRESS 0x40008040 /* @ECU_Address@ciptmsr_B2V_fBattDisChgCurrPeak@ */ /end MEASUREMENT
/begin MEASUREMENT ciptmsr_B2V_fBattPackVolt "" UWORD xjmain_CM_ufix16_En4 0 0 0 4095.9375 ECU_ADDRESS 0x40008048 /* @ECU_Address@ciptmsr_B2V_fBattPackVolt@ */ /end MEASUREMENT
/begin MEASUREMENT ciptmsr_B2V_fBattChgCurrPeak "" UWORD xjmain_CM_ufix16_En4 0 0 0 4095.9375 ECU_ADDRESS 0x40008038 /* @ECU_Address@ciptmsr_B2V_fBattChgCurrPeak@ */ /end MEASUREMENT
/begin MEASUREMENT ciptmsr_B2V_fBattDisChgCurrCont "" UWORD xjmain_CM_ufix16_En4 0 0 0 4095.9375 ECU_ADDRESS 0x4000803e /* @ECU_Address@ciptmsr_B2V_fBattDisChgCurrCont@ */ /end MEASUREMENT
/begin MEASUREMENT ciptmsr_B2V_fBattChgCurrCont "" UWORD xjmain_CM_ufix16_En4 0 0 0 4095.9375 ECU_ADDRESS 0x40008036 /* @ECU_Address@ciptmsr_B2V_fBattChgCurrCont@ */ /end MEASUREMENT
/begin MEASUREMENT ciptmsr_B2V_fBattPackCurr "" SWORD xjmain_CM_sfix16_En4 0 0 -2048.0 2047.9375 ECU_ADDRESS 0x40008046 /* @ECU_Address@ciptmsr_B2V_fBattPackCurr@ */ /end MEASUREMENT
/begin MEASUREMENT ciptmsr_T2V_fDmotTrqAct "" SWORD xjmain_CM_sfix16_En2 0 0 -8192.0 8191.75 ECU_ADDRESS 0x40008088 /* @ECU_Address@ciptmsr_T2V_fDmotTrqAct@ */ /end MEASUREMENT
/begin MEASUREMENT ciptmsr_T2V_fDmcuPosTrgLmt "" SWORD xjmain_CM_sfix16_En2 0 0 -8192.0 8191.75 ECU_ADDRESS 0x40008084 /* @ECU_Address@ciptmsr_T2V_fDmcuPosTrgLmt@ */ /end MEASUREMENT
/begin MEASUREMENT ciptmsr_T2V_fDmcuNegTrgLmt "" SWORD xjmain_CM_sfix16_En2 0 0 -8192.0 8191.75 ECU_ADDRESS 0x40008082 /* @ECU_Address@ciptmsr_T2V_fDmcuNegTrgLmt@ */ /end MEASUREMENT
/begin MEASUREMENT ciptmsr_T2V_fPmotTrqAct "" SWORD xjmain_CM_sfix16_En2 0 0 -8192.0 8191.75 ECU_ADDRESS 0x40008090 /* @ECU_Address@ciptmsr_T2V_fPmotTrqAct@ */ /end MEASUREMENT
/begin MEASUREMENT ciptmsr_T2V_fPmcuPosTrgLmt "" SWORD xjmain_CM_sfix16_En2 0 0 -8192.0 8191.75 ECU_ADDRESS 0x4000808c /* @ECU_Address@ciptmsr_T2V_fPmcuPosTrgLmt@ */ /end MEASUREMENT
/begin MEASUREMENT ciptmsr_T2V_fPmcuNegTrgLmt "" SWORD xjmain_CM_sfix16_En2 0 0 -8192.0 8191.75 ECU_ADDRESS 0x4000808a /* @ECU_Address@ciptmsr_T2V_fPmcuNegTrgLmt@ */ /end MEASUREMENT
/begin MEASUREMENT ciptmsr_T2V_i16DmotSpdAct "" SWORD xjmain_CM_int16 0 0 -32768 32767 ECU_ADDRESS 0x4000809a /* @ECU_Address@ciptmsr_T2V_i16DmotSpdAct@ */ /end MEASUREMENT
/begin MEASUREMENT ciptmsr_T2V_i16DmotTmptAct "" SWORD xjmain_CM_int16 0 0 -32768 32767 ECU_ADDRESS 0x4000809c /* @ECU_Address@ciptmsr_T2V_i16DmotTmptAct@ */ /end MEASUREMENT
/begin MEASUREMENT ciptmsr_T2V_i16DmcuTmptAct "" SWORD xjmain_CM_int16 0 0 -32768 32767 ECU_ADDRESS 0x40008098 /* @ECU_Address@ciptmsr_T2V_i16DmcuTmptAct@ */ /end MEASUREMENT
/begin MEASUREMENT ciptmsr_T2V_i16PmotSpdAct "" SWORD xjmain_CM_int16 0 0 -32768 32767 ECU_ADDRESS 0x400080a0 /* @ECU_Address@ciptmsr_T2V_i16PmotSpdAct@ */ /end MEASUREMENT
/begin MEASUREMENT ciptmsr_T2V_i16PmotTmptAct "" SWORD xjmain_CM_int16 0 0 -32768 32767 ECU_ADDRESS 0x400080a2 /* @ECU_Address@ciptmsr_T2V_i16PmotTmptAct@ */ /end MEASUREMENT
/begin MEASUREMENT ciptmsr_T2V_i16PmcuTmptAct "" SWORD xjmain_CM_int16 0 0 -32768 32767 ECU_ADDRESS 0x4000809e /* @ECU_Address@ciptmsr_T2V_i16PmcuTmptAct@ */ /end MEASUREMENT
/begin MEASUREMENT ciptmsr_B2V_i16BattCellAvgTmpt "" SWORD xjmain_CM_int16 0 0 -32768 32767 ECU_ADDRESS 0x4000804e /* @ECU_Address@ciptmsr_B2V_i16BattCellAvgTmpt@ */ /end MEASUREMENT
/begin MEASUREMENT ciptmsr_T2V_u8DmotRunSts "" UBYTE xjmain_CM_uint8 0 0 0 255 ECU_ADDRESS 0x400080a9 /* @ECU_Address@ciptmsr_T2V_u8DmotRunSts@ */ /end MEASUREMENT
/begin MEASUREMENT ciptmsr_T2V_u8PmotRunSts "" UBYTE xjmain_CM_uint8 0 0 0 255 ECU_ADDRESS 0x400080ae /* @ECU_Address@ciptmsr_T2V_u8PmotRunSts@ */ /end MEASUREMENT
/begin MEASUREMENT ciptmsr_T2V_u8DmcuFltLvl "" UBYTE xjmain_CM_uint8 0 0 0 255 ECU_ADDRESS 0x400080a8 /* @ECU_Address@ciptmsr_T2V_u8DmcuFltLvl@ */ /end MEASUREMENT
/begin MEASUREMENT ciptmsr_B2V_u8FCNegRly1Sts "" UBYTE xjmain_CM_uint8 0 0 0 3.0 ECU_ADDRESS 0x40008057 /* @ECU_Address@ciptmsr_B2V_u8FCNegRly1Sts@ */ /end MEASUREMENT
/begin MEASUREMENT ciptmsr_B2V_u8FCPosRly1Sts "" UBYTE xjmain_CM_uint8 0 0 0 3.0 ECU_ADDRESS 0x40008059 /* @ECU_Address@ciptmsr_B2V_u8FCPosRly1Sts@ */ /end MEASUREMENT
/begin MEASUREMENT ciptmsr_B2V_u8FCPosRly2Sts "" UBYTE xjmain_CM_uint8 0 0 0 3.0 ECU_ADDRESS 0x4000805a /* @ECU_Address@ciptmsr_B2V_u8FCPosRly2Sts@ */ /end MEASUREMENT
/begin MEASUREMENT ciptmsr_B2V_u8FCNegRly2Sts "" UBYTE xjmain_CM_uint8 0 0 0 3.0 ECU_ADDRESS 0x40008058 /* @ECU_Address@ciptmsr_B2V_u8FCNegRly2Sts@ */ /end MEASUREMENT
/begin MEASUREMENT ciptmsr_T2V_u8PmcuFltLvl "" UBYTE xjmain_CM_uint8 0 0 0 255 ECU_ADDRESS 0x400080ad /* @ECU_Address@ciptmsr_T2V_u8PmcuFltLvl@ */ /end MEASUREMENT
/begin MEASUREMENT ciptmsr_T2V_u8GearFltLvl "" UBYTE xjmain_CM_uint8 0 0 0 255 ECU_ADDRESS 0x400080aa /* @ECU_Address@ciptmsr_T2V_u8GearFltLvl@ */ /end MEASUREMENT
/begin MEASUREMENT ciptmsr_T2V_u8DmcuFltCode "" UBYTE xjmain_CM_uint8 0 0 0 255 ECU_ADDRESS 0x400080a7 /* @ECU_Address@ciptmsr_T2V_u8DmcuFltCode@ */ /end MEASUREMENT
/begin MEASUREMENT ciptmsr_T2V_u8PmcuFltCode "" UBYTE xjmain_CM_uint8 0 0 0 255 ECU_ADDRESS 0x400080ac /* @ECU_Address@ciptmsr_T2V_u8PmcuFltCode@ */ /end MEASUREMENT
/begin MEASUREMENT ciptmsr_B2V_u8MainNegRlySts "" UBYTE xjmain_CM_uint8 0 0 0 3.0 ECU_ADDRESS 0x4000805b /* @ECU_Address@ciptmsr_B2V_u8MainNegRlySts@ */ /end MEASUREMENT
/begin MEASUREMENT ciptmsr_B2V_u8PTCPosRlySts "" UBYTE xjmain_CM_uint8 0 0 0 3.0 ECU_ADDRESS 0x4000805d /* @ECU_Address@ciptmsr_B2V_u8PTCPosRlySts@ */ /end MEASUREMENT
/begin MEASUREMENT ciptmsr_B2V_u8PTCNegRlySts "" UBYTE xjmain_CM_uint8 0 0 0 3.0 ECU_ADDRESS 0x4000805c /* @ECU_Address@ciptmsr_B2V_u8PTCNegRlySts@ */ /end MEASUREMENT
/begin MEASUREMENT ciptmsr_B2V_u8CurrentHVSts "" UBYTE xjmain_CM_uint8 0 0 0 15.0 ECU_ADDRESS 0x40008054 /* @ECU_Address@ciptmsr_B2V_u8CurrentHVSts@ */ /end MEASUREMENT
/begin MEASUREMENT ciptmsr_B2V_u8DCChgConnSts "" UBYTE xjmain_CM_uint8 0 0 0 3.0 ECU_ADDRESS 0x40008056 /* @ECU_Address@ciptmsr_B2V_u8DCChgConnSts@ */ /end MEASUREMENT
/begin MEASUREMENT ciptmsr_B2V_u8CurrentChgSts "" UBYTE xjmain_CM_uint8 0 0 0 255 ECU_ADDRESS 0x40008053 /* @ECU_Address@ciptmsr_B2V_u8CurrentChgSts@ */ /end MEASUREMENT
/begin MEASUREMENT ciptmsr_B2V_u8CurrentHeatSts "" UBYTE xjmain_CM_uint8 0 0 0 3.0 ECU_ADDRESS 0x40008055 /* @ECU_Address@ciptmsr_B2V_u8CurrentHeatSts@ */ /end MEASUREMENT
/begin MEASUREMENT ciptmsr_B2V_u8BattFltCode "" UBYTE xjmain_CM_uint8 0 0 0 255 ECU_ADDRESS 0x40008051 /* @ECU_Address@ciptmsr_B2V_u8BattFltCode@ */ /end MEASUREMENT
/begin MEASUREMENT ciptmsr_B2V_u8BattFltLvl "" UBYTE xjmain_CM_uint8 0 0 0 15.0 ECU_ADDRESS 0x40008052 /* @ECU_Address@ciptmsr_B2V_u8BattFltLvl@ */ /end MEASUREMENT
/begin MEASUREMENT ciptmsr_B2O_u8ChgOnOffCtrl "" UBYTE xjmain_CM_uint8 0 0 0 3.0 ECU_ADDRESS 0x40008031 /* @ECU_Address@ciptmsr_B2O_u8ChgOnOffCtrl@ */ /end MEASUREMENT
/begin MEASUREMENT ciptmsr_P2V_u8DmcuRlySts "" UBYTE xjmain_CM_uint8 0 0 0 255 ECU_ADDRESS 0x4000807d /* @ECU_Address@ciptmsr_P2V_u8DmcuRlySts@ */ /end MEASUREMENT
/begin MEASUREMENT ciptmsr_P2V_u8DcdcPreRlySts "" UBYTE xjmain_CM_uint8 0 0 0 255 ECU_ADDRESS 0x4000807a /* @ECU_Address@ciptmsr_P2V_u8DcdcPreRlySts@ */ /end MEASUREMENT
/begin MEASUREMENT ciptmsr_P2V_u8ObcRlySts "" UBYTE xjmain_CM_uint8 0 0 0 255 ECU_ADDRESS 0x4000807f /* @ECU_Address@ciptmsr_P2V_u8ObcRlySts@ */ /end MEASUREMENT
/begin MEASUREMENT ciptmsr_P2V_u8ObcPreRlySts "" UBYTE xjmain_CM_uint8 0 0 0 255 ECU_ADDRESS 0x4000807e /* @ECU_Address@ciptmsr_P2V_u8ObcPreRlySts@ */ /end MEASUREMENT
/begin MEASUREMENT ciptmsr_P2V_u8DmcuPreRlySts "" UBYTE xjmain_CM_uint8 0 0 0 255 ECU_ADDRESS 0x4000807c /* @ECU_Address@ciptmsr_P2V_u8DmcuPreRlySts@ */ /end MEASUREMENT
/begin MEASUREMENT ciptmsr_P2V_u8DcdcRlySts "" UBYTE xjmain_CM_uint8 0 0 0 255 ECU_ADDRESS 0x4000807b /* @ECU_Address@ciptmsr_P2V_u8DcdcRlySts@ */ /end MEASUREMENT
/begin MEASUREMENT ciptmsr_P2V_u8DcdcFltLvl "" UBYTE xjmain_CM_uint8 0 0 0 255 ECU_ADDRESS 0x40008079 /* @ECU_Address@ciptmsr_P2V_u8DcdcFltLvl@ */ /end MEASUREMENT
/begin MEASUREMENT ciptmsr_P2V_u8DcacFltLvl "" UBYTE xjmain_CM_uint8 0 0 0 255 ECU_ADDRESS 0x40008076 /* @ECU_Address@ciptmsr_P2V_u8DcacFltLvl@ */ /end MEASUREMENT
/begin MEASUREMENT ciptmsr_P2V_u8DcacRunSts "" UBYTE xjmain_CM_uint8 0 0 0 255 ECU_ADDRESS 0x40008078 /* @ECU_Address@ciptmsr_P2V_u8DcacRunSts@ */ /end MEASUREMENT
/begin MEASUREMENT ciptmsr_I2V_u8ChgPwrSet_kW "" UBYTE xjmain_CM_uint8 0 0 0 255 ECU_ADDRESS 0x40008066 /* @ECU_Address@ciptmsr_I2V_u8ChgPwrSet_kW@ */ /end MEASUREMENT
/begin MEASUREMENT ciptmsr_I2V_u8ChgModeSet "" UBYTE xjmain_CM_uint8 0 0 0 255 ECU_ADDRESS 0x40008064 /* @ECU_Address@ciptmsr_I2V_u8ChgModeSet@ */ /end MEASUREMENT
/begin MEASUREMENT ciptmsr_I2V_u8ChgOnOffCtrl "" UBYTE xjmain_CM_uint8 0 0 0 255 ECU_ADDRESS 0x40008065 /* @ECU_Address@ciptmsr_I2V_u8ChgOnOffCtrl@ */ /end MEASUREMENT
/begin MEASUREMENT ciptmsr_P2V_u8DcacRlySts "" UBYTE xjmain_CM_uint8 0 0 0 255 ECU_ADDRESS 0x40008077 /* @ECU_Address@ciptmsr_P2V_u8DcacRlySts@ */ /end MEASUREMENT
/begin MEASUREMENT ciptmsr_P2V_u8PmcuRlySts "" UBYTE xjmain_CM_uint8 0 0 0 255 ECU_ADDRESS 0x40008081 /* @ECU_Address@ciptmsr_P2V_u8PmcuRlySts@ */ /end MEASUREMENT
/begin MEASUREMENT ciptmsr_P2V_u8PmcuPreRlySts "" UBYTE xjmain_CM_uint8 0 0 0 255 ECU_ADDRESS 0x40008080 /* @ECU_Address@ciptmsr_P2V_u8PmcuPreRlySts@ */ /end MEASUREMENT
/begin MEASUREMENT ciptmsr_T2V_i8SelectGear "" SBYTE xjmain_CM_int8 0 0 -128 127 ECU_ADDRESS 0x400080a5 /* @ECU_Address@ciptmsr_T2V_i8SelectGear@ */ /end MEASUREMENT
/begin MEASUREMENT ciptmsr_T2V_i8CurrentGear "" SBYTE xjmain_CM_int8 0 0 -128 127 ECU_ADDRESS 0x400080a4 /* @ECU_Address@ciptmsr_T2V_i8CurrentGear@ */ /end MEASUREMENT
/begin MEASUREMENT ciptmsr_T2V_hasDmcuNoFlt "" UBYTE xjmain_CM_boolean 0 0 0 1 ECU_ADDRESS 0x40008093 /* @ECU_Address@ciptmsr_T2V_hasDmcuNoFlt@ */ /end MEASUREMENT
/begin MEASUREMENT ciptmsr_T2V_hasDmcuDisChg "" UBYTE xjmain_CM_boolean 0 0 0 1 ECU_ADDRESS 0x40008092 /* @ECU_Address@ciptmsr_T2V_hasDmcuDisChg@ */ /end MEASUREMENT
/begin MEASUREMENT ciptmsr_T2V_hasDmotEn "" UBYTE xjmain_CM_boolean 0 0 0 1 ECU_ADDRESS 0x40008094 /* @ECU_Address@ciptmsr_T2V_hasDmotEn@ */ /end MEASUREMENT
/begin MEASUREMENT ciptmsr_T2V_hasPmcuNoFlt "" UBYTE xjmain_CM_boolean 0 0 0 1 ECU_ADDRESS 0x40008096 /* @ECU_Address@ciptmsr_T2V_hasPmcuNoFlt@ */ /end MEASUREMENT
/begin MEASUREMENT ciptmsr_O2B_hasChgOn "" UBYTE xjmain_CM_boolean 0 0 0 1 ECU_ADDRESS 0x40008071 /* @ECU_Address@ciptmsr_O2B_hasChgOn@ */ /end MEASUREMENT
/begin MEASUREMENT ciptmsr_T2V_hasPmcuDisChg "" UBYTE xjmain_CM_boolean 0 0 0 1 ECU_ADDRESS 0x40008095 /* @ECU_Address@ciptmsr_T2V_hasPmcuDisChg@ */ /end MEASUREMENT
/begin MEASUREMENT ciptmsr_B2V_hasFCRlyClosed "" UBYTE xjmain_CM_boolean 0 0 0 1 ECU_ADDRESS 0x4000804c /* @ECU_Address@ciptmsr_B2V_hasFCRlyClosed@ */ /end MEASUREMENT
/begin MEASUREMENT ciptmsr_T2V_hasPmotEn "" UBYTE xjmain_CM_boolean 0 0 0 1 ECU_ADDRESS 0x40008097 /* @ECU_Address@ciptmsr_T2V_hasPmotEn@ */ /end MEASUREMENT
/begin MEASUREMENT ciptmsr_O2B_hasChgHwFlt "" UBYTE xjmain_CM_boolean 0 0 0 1 ECU_ADDRESS 0x4000806f /* @ECU_Address@ciptmsr_O2B_hasChgHwFlt@ */ /end MEASUREMENT
/begin MEASUREMENT ciptmsr_O2B_hasChgOvrTmptFlt "" UBYTE xjmain_CM_boolean 0 0 0 1 ECU_ADDRESS 0x40008072 /* @ECU_Address@ciptmsr_O2B_hasChgOvrTmptFlt@ */ /end MEASUREMENT
/begin MEASUREMENT ciptmsr_O2B_hasChgInVoltFlt "" UBYTE xjmain_CM_boolean 0 0 0 1 ECU_ADDRESS 0x40008070 /* @ECU_Address@ciptmsr_O2B_hasChgInVoltFlt@ */ /end MEASUREMENT
/begin MEASUREMENT ciptmsr_O2B_hasChgSlfChkFlt "" UBYTE xjmain_CM_boolean 0 0 0 1 ECU_ADDRESS 0x40008073 /* @ECU_Address@ciptmsr_O2B_hasChgSlfChkFlt@ */ /end MEASUREMENT
/begin MEASUREMENT ciptmsr_O2B_hasChgCanFlt "" UBYTE xjmain_CM_boolean 0 0 0 1 ECU_ADDRESS 0x4000806e /* @ECU_Address@ciptmsr_O2B_hasChgCanFlt@ */ /end MEASUREMENT
/begin MEASUREMENT ciptmsr_O2B_hasChgWakeUp "" UBYTE xjmain_CM_boolean 0 0 0 1 ECU_ADDRESS 0x40008074 /* @ECU_Address@ciptmsr_O2B_hasChgWakeUp@ */ /end MEASUREMENT
/begin MEASUREMENT ciptmsr_B2V_u8ReqHVPwrOff "" UBYTE xjmain_CM_boolean 0 0 0 1 ECU_ADDRESS 0x4000805e /* @ECU_Address@ciptmsr_B2V_u8ReqHVPwrOff@ */ /end MEASUREMENT
/begin MEASUREMENT ciptmsr_P2V_hasPduRdy "" UBYTE xjmain_CM_boolean 0 0 0 1 ECU_ADDRESS 0x40008075 /* @ECU_Address@ciptmsr_P2V_hasPduRdy@ */ /end MEASUREMENT
/begin COMPU_METHOD xjmain_CM_ufix16_En9_percent_ "Q = V*512.000000" RAT_FUNC "%12.9" "%" COEFFS 0 512.000000 0.000000 0 0 1.000000 /end COMPU_METHOD
/begin COMPU_METHOD xjmain_CM_ufix16_En9 "Q = V*512.000000" RAT_FUNC "%12.9" "" COEFFS 0 512.000000 0.000000 0 0 1.000000 /end COMPU_METHOD
/begin COMPU_METHOD xjmain_CM_int16 "Q = V" RAT_FUNC "%5.0" "" COEFFS 0 1 0 0 0 1 /end COMPU_METHOD
/begin COMPU_METHOD xjmain_CM_sfix16_En2_Nm "Q = V*4.000000" RAT_FUNC "%7.2" "Nm" COEFFS 0 4.000000 0.000000 0 0 1.000000 /end COMPU_METHOD
/begin COMPU_METHOD xjmain_CM_sfix16_En2 "Q = V*4.000000" RAT_FUNC "%7.2" "" COEFFS 0 4.000000 0.000000 0 0 1.000000 /end COMPU_METHOD
/begin COMPU_METHOD xjmain_CM_sfix16_En2_none "Q = V*4.000000" RAT_FUNC "%7.2" "none" COEFFS 0 4.000000 0.000000 0 0 1.000000 /end COMPU_METHOD
/begin COMPU_METHOD xjmain_CM_ufix16_En2 "Q = V*4.000000" RAT_FUNC "%7.2" "" COEFFS 0 4.000000 0.000000 0 0 1.000000 /end COMPU_METHOD
/begin COMPU_METHOD xjmain_CM_ufix16_En3 "Q = V*8.000000" RAT_FUNC "%7.3" "" COEFFS 0 8.000000 0.000000 0 0 1.000000 /end COMPU_METHOD
/begin COMPU_METHOD xjmain_CM_ufix16_En4_none "Q = V*16.000000" RAT_FUNC "%8.4" "none" COEFFS 0 16.000000 0.000000 0 0 1.000000 /end COMPU_METHOD
/begin COMPU_METHOD xjmain_CM_ufix16_En4 "Q = V*16.000000" RAT_FUNC "%8.4" "" COEFFS 0 16.000000 0.000000 0 0 1.000000 /end COMPU_METHOD
/begin COMPU_METHOD xjmain_CM_ufix16_En6_none "Q = V*64.000000" RAT_FUNC "%10.6" "none" COEFFS 0 64.000000 0.000000 0 0 1.000000 /end COMPU_METHOD
/begin COMPU_METHOD xjmain_CM_ufix16_En6 "Q = V*64.000000" RAT_FUNC "%10.6" "" COEFFS 0 64.000000 0.000000 0 0 1.000000 /end COMPU_METHOD
/begin COMPU_METHOD xjmain_CM_ufix16_En8 "Q = V*256.000000" RAT_FUNC "%11.8" "" COEFFS 0 256.000000 0.000000 0 0 1.000000 /end COMPU_METHOD
/begin COMPU_METHOD xjmain_CM_ufix16_En9_none "Q = V*512.000000" RAT_FUNC "%12.9" "none" COEFFS 0 512.000000 0.000000 0 0 1.000000 /end COMPU_METHOD
/begin COMPU_METHOD xjmain_CM_uint16 "Q = V" RAT_FUNC "%5.0" "" COEFFS 0 1 0 0 0 1 /end COMPU_METHOD
/begin COMPU_METHOD xjmain_CM_uint16_none "Q = V" RAT_FUNC "%5.0" "none" COEFFS 0 1 0 0 0 1 /end COMPU_METHOD
/begin COMPU_METHOD xjmain_CM_boolean_none "Q = V" RAT_FUNC "%1.0" "none" COEFFS 0 1 0 0 0 1 /end COMPU_METHOD
/begin COMPU_METHOD xjmain_CM_boolean "Q = V" RAT_FUNC "%1.0" "" COEFFS 0 1 0 0 0 1 /end COMPU_METHOD
/begin COMPU_METHOD xjmain_CM_int8 "Q = V" RAT_FUNC "%3.0" "" COEFFS 0 1 0 0 0 1 /end COMPU_METHOD
/begin COMPU_METHOD xjmain_CM_int8_none "Q = V" RAT_FUNC "%3.0" "none" COEFFS 0 1 0 0 0 1 /end COMPU_METHOD
/begin COMPU_METHOD xjmain_CM_uint8 "Q = V" RAT_FUNC "%3.0" "" COEFFS 0 1 0 0 0 1 /end COMPU_METHOD
/begin COMPU_METHOD xjmain_CM_uint8_t "Q = V" RAT_FUNC "%3.0" "t" COEFFS 0 1 0 0 0 1 /end COMPU_METHOD
/begin COMPU_METHOD xjmain_CM_uint8_none "Q = V" RAT_FUNC "%3.0" "none" COEFFS 0 1 0 0 0 1 /end COMPU_METHOD
/begin COMPU_METHOD xjmain_CM_double "Q = V" RAT_FUNC "%15.10" "" COEFFS 0 1 0 0 0 1 /end COMPU_METHOD
/begin COMPU_METHOD xjmain_CM_single "Q = V" RAT_FUNC "%8.6" "" COEFFS 0 1 0 0 0 1 /end COMPU_METHOD
/begin COMPU_METHOD xjmain_CM_sfix16_En4 "Q = V*16.000000" RAT_FUNC "%8.4" "" COEFFS 0 16.000000 0.000000 0 0 1.000000 /end COMPU_METHOD
/begin GROUP xjmain "xjmain" /* Root */ ROOT /begin SUB_GROUP Root_GOTO Root_Power_Management_Example Root_VarIn /end SUB_GROUP /end GROUP
/begin GROUP Root_GOTO "xjmain/GOTO"
 /begin SUB_GROUP S4_aipt_calibration S4_amct S4_apdd_calibration S4_cipt_calibration S4_copt_calibration S4_dipt S4_dopt S4_fdst_calibration S4_gmct_calibration S4_incc_calibration S4_mmct_calibration S4_obc_calibration S4_pooc S4_rbct_calibration S4_rtos_calibration S4_scpc_calibration S4_tfta_calibration S4_wctrl /end SUB_GROUP
/end GROUP
/begin GROUP Root_Power_Management_Example "xjmain/Power Management Example" /begin SUB_GROUP S5_Power_Off_Management /end SUB_GROUP /end GROUP
/begin GROUP Root_VarIn "xjmain/VarIn" /begin SUB_GROUP S6_ActIn /end SUB_GROUP /end GROUP
/begin GROUP S4_aipt_calibration "xjmain/GOTO/aipt_calibration"
 /begin SUB_GROUP S22_AirPSig2Diagnosis_fault S22_AirPSig2_pct_conversion S22_AirPSigDiagnosis_fault S22_AirPSig_pct_conversion S22_AnemoSigDiagnosis_fault S22_AppDiagnosis_fault S22_DmotSpdResDiagnosis_fault S22_DmotSpdRes_pct_conversion S22_Filter_AP S22_Filter_AirPSig S22_Filter_AirPSig2 S22_Filter_DmotSpdRes S22_Filter_HP S22_Filter_WindSig S22_HP_pct_conversion S22_Hysteresis S22_Hysteresis1 S22_Selection_AP S22_Selection_AirPSig S22_Selection_AirPSig2 S22_Selection_DmotSpdRes S22_Selection_HP S22_Selection_WindSig S22_WindSig_pct_conversion S22_app_pct_conversion S22_hoist_weight_sgn_fault /end SUB_GROUP
 /begin REF_CHARACTERISTIC aiptc_fSkylightPressStopEngine_bar aiptc_pct_APP_Action_LP aiptc_pct_App_Action_RP aiptc_pct_DmotSpdRes_Action_LP aiptc_pct_DmotSpdRes_Action_RP aiptc_range_HW_t aiptcalflg_fAPPos_pct aiptcalflg_fAirPumpPress_bar aiptcalflg_fDmotSpdRes_pct aiptcalflg_fHW_t aiptcalflg_fSkylightPress_bar aiptcalflg_isAPAction aiptcalflg_isAPValid aiptcalflg_isDmotSpdResAction aiptcalflg_isDmotSpdResValid aiptcalflg_isHWValid aiptcalflg_isWindSpdValid aiptcalflg_u8WindLvl aiptcalvlu_fAPPos_pct aiptcalvlu_fAirPumpPress_bar aiptcalvlu_fDmotSpdRes_pct aiptcalvlu_fHW_t aiptcalvlu_fSkylightPress_bar aiptcalvlu_isAPAction aiptcalvlu_isAPValid aiptcalvlu_isDmotSpdResAction aiptcalvlu_isDmotSpdResValid aiptcalvlu_isHWValid aiptcalvlu_isWindSpdValid aiptcalvlu_u8WindLvl /end REF_CHARACTERISTIC
 /begin REF_MEASUREMENT aiptmsr_fAPPos_pct aiptmsr_fAirPumpPress_bar aiptmsr_fDmotSpdRes_pct aiptmsr_fHW_t aiptmsr_fSkylightPress_bar aiptmsr_isAPAction aiptmsr_isAPValid aiptmsr_isDmotSpdResAction aiptmsr_isDmotSpdResValid aiptmsr_isHWValid aiptmsr_isStopEnginePwr aiptmsr_isWindSpdValid aiptmsr_u8WindLvl /end REF_MEASUREMENT
/end GROUP
/begin GROUP S4_amct "xjmain/GOTO/amct" /begin SUB_GROUP S23_DCACCtrl S23_DCDCCtrl /end SUB_GROUP
 /begin REF_CHARACTERISTIC amctcalflg_isAirPumpRun amctcalflg_isDcdcRun amctcalvlu_isAirPumpRun amctcalvlu_isDcdcRun /end REF_CHARACTERISTIC
 /begin REF_MEASUREMENT amctmsr_isAirPumpRun amctmsr_isDcdcRun /end REF_MEASUREMENT
/end GROUP
/begin GROUP S4_apdd_calibration "xjmain/GOTO/apdd_calibration" /begin SUB_GROUP S24_PumpMotor_interp S24_apdd_main /end SUB_GROUP
 /begin REF_CHARACTERISTIC apddcalflg_fDmotTrqReq apddcalflg_u16DmotSpdReq apddcalflg_u16PmotSpdReq apddcalvlu_fDmotTrqReq apddcalvlu_u16DmotSpdReq apddcalvlu_u16PmotSpdReq /end REF_CHARACTERISTIC
 /begin REF_MEASUREMENT apddmsr_fDmotTrqReq apddmsr_u16DmotSpdReq apddmsr_u16PmotSpdReq /end REF_MEASUREMENT
/end GROUP
/begin GROUP S4_cipt_calibration "xjmain/GOTO/cipt_calibration" /begin SUB_GROUP S25_Roll_counter S25_Roll_counter1 S25_bmscounter /end SUB_GROUP
 /begin REF_CHARACTERISTIC ciptcalflg_I2V_u16PmotSpdHSet ciptcalflg_I2V_u16PmotSpdLSet ciptcalflg_I2V_u8ChgModeSet ciptcalflg_I2V_u8ChgOnOffCtrl ciptcalflg_I2V_u8ChgPwrSet ciptcalvlu_I2V_u16PmotSpdHSet ciptcalvlu_I2V_u16PmotSpdLSet ciptcalvlu_I2V_u8ChgModeSet ciptcalvlu_I2V_u8ChgOnOffCtrl ciptcalvlu_I2V_u8ChgPwrSet glc_OBC_OUT_CURR_MAX_A glc_OBC_OUT_VOLT_MAX_V glc_OBC_RATING_PWR_kW /end REF_CHARACTERISTIC
 /begin REF_MEASUREMENT ciptmsr_B2O_u8ChgOnOffCtrl ciptmsr_B2V_fBattCellMaxVolt ciptmsr_B2V_fBattCellMinVolt ciptmsr_B2V_fBattChgCurrCont ciptmsr_B2V_fBattChgCurrPeak ciptmsr_B2V_fBattContChgPwr_kW ciptmsr_B2V_fBattContDisChgPwr_kW ciptmsr_B2V_fBattDisChgCurrCont ciptmsr_B2V_fBattDisChgCurrPeak ciptmsr_B2V_fBattMaxChgPwr_kW ciptmsr_B2V_fBattMaxDisChgPwr_kW ciptmsr_B2V_fBattPackCurr ciptmsr_B2V_fBattPackVolt ciptmsr_B2V_fBattSOC ciptmsr_B2V_hasFCRlyClosed ciptmsr_B2V_i16BattCellAvgTmpt ciptmsr_B2V_u8BattFltCode ciptmsr_B2V_u8BattFltLvl ciptmsr_B2V_u8CurrentChgSts ciptmsr_B2V_u8CurrentHVSts ciptmsr_B2V_u8CurrentHeatSts ciptmsr_B2V_u8DCChgConnSts ciptmsr_B2V_u8FCNegRly1Sts ciptmsr_B2V_u8FCNegRly2Sts ciptmsr_B2V_u8FCPosRly1Sts ciptmsr_B2V_u8FCPosRly2Sts ciptmsr_B2V_u8MainNegRlySts ciptmsr_B2V_u8PTCNegRlySts ciptmsr_B2V_u8PTCPosRlySts ciptmsr_B2V_u8ReqHVPwrOff ciptmsr_I2V_u16PmotSpdHSet ciptmsr_I2V_u16PmotSpdLSet ciptmsr_I2V_u8ChgModeSet ciptmsr_I2V_u8ChgOnOffCtrl ciptmsr_I2V_u8ChgPwrSet_kW ciptmsr_O2B_fChgOutCurrAct ciptmsr_O2B_fChgOutPwrAct_kW ciptmsr_O2B_fChgOutVoltAct ciptmsr_O2B_hasChgCanFlt ciptmsr_O2B_hasChgHwFlt ciptmsr_O2B_hasChgInVoltFlt ciptmsr_O2B_hasChgOn ciptmsr_O2B_hasChgOvrTmptFlt ciptmsr_O2B_hasChgSlfChkFlt ciptmsr_O2B_hasChgWakeUp ciptmsr_P2V_hasPduRdy ciptmsr_P2V_u8DcacFltLvl ciptmsr_P2V_u8DcacRlySts ciptmsr_P2V_u8DcacRunSts ciptmsr_P2V_u8DcdcFltLvl ciptmsr_P2V_u8DcdcPreRlySts ciptmsr_P2V_u8DcdcRlySts ciptmsr_P2V_u8DmcuPreRlySts ciptmsr_P2V_u8DmcuRlySts ciptmsr_P2V_u8ObcPreRlySts ciptmsr_P2V_u8ObcRlySts ciptmsr_P2V_u8PmcuPreRlySts ciptmsr_P2V_u8PmcuRlySts ciptmsr_T2V_fDmcuNegTrgLmt ciptmsr_T2V_fDmcuPosTrgLmt ciptmsr_T2V_fDmotAcCurrAct ciptmsr_T2V_fDmotTrqAct ciptmsr_T2V_fPmcuNegTrgLmt ciptmsr_T2V_fPmcuPosTrgLmt ciptmsr_T2V_fPmotAcCurrAct ciptmsr_T2V_fPmotTrqAct ciptmsr_T2V_hasDmcuDisChg ciptmsr_T2V_hasDmcuNoFlt ciptmsr_T2V_hasDmotEn ciptmsr_T2V_hasPmcuDisChg ciptmsr_T2V_hasPmcuNoFlt ciptmsr_T2V_hasPmotEn ciptmsr_T2V_i16DmcuTmptAct ciptmsr_T2V_i16DmotSpdAct ciptmsr_T2V_i16DmotTmptAct ciptmsr_T2V_i16PmcuTmptAct ciptmsr_T2V_i16PmotSpdAct ciptmsr_T2V_i16PmotTmptAct ciptmsr_T2V_i8CurrentGear ciptmsr_T2V_i8SelectGear ciptmsr_T2V_u8DmcuFltCode ciptmsr_T2V_u8DmcuFltLvl ciptmsr_T2V_u8DmotRunSts ciptmsr_T2V_u8GearFltLvl ciptmsr_T2V_u8PmcuFltCode ciptmsr_T2V_u8PmcuFltLvl ciptmsr_T2V_u8PmotRunSts /end REF_MEASUREMENT
/end GROUP
/begin GROUP S4_copt_calibration "xjmain/GOTO/copt_calibration"
 /begin SUB_GROUP S26_0X1824D9D0 S26_0X1827D9D0 S26_0x180256EF S26_Engine_Information S26_INCC_0x18F101D0 S26_V2BMS S26_V2DMCU S26_V2OBC S26_V2PMCU /end SUB_GROUP
 /begin REF_CHARACTERISTIC coptcalflg_V2P_hasMainNegRlyClosed coptcalflg_V2P_u16RefVolt coptcalflg_V2T_hasPmcuRlyClosed coptcalvlu_V2P_hasMainNegRlyClosed coptcalvlu_V2P_u16RefVolt coptcalvlu_V2T_hasPmcuRlyClosed glc_PDU_DCAC_TGT_SPD glc_PDU_DCDC_TGT_VOLT /end REF_CHARACTERISTIC
 /begin REF_MEASUREMENT coptmsr_V2P_hasMainNegRlyClosed coptmsr_V2P_u16RefVolt coptmsr_V2T_hasPmcuRlyClosed /end REF_MEASUREMENT
/end GROUP
/begin GROUP S4_dipt "xjmain/GOTO/dipt"
 /begin SUB_GROUP S27_GetAppInfo S27_debounce1 S27_debounce10 S27_debounce11 S27_debounce12 S27_debounce13 S27_debounce14 S27_debounce15 S27_debounce2 S27_debounce3 S27_debounce4 S27_debounce5 S27_debounce6 S27_debounce7 S27_debounce8 S27_debounce9 /end SUB_GROUP
 /begin REF_CHARACTERISTIC diptcalflg_i8GearPos diptcalflg_isAirPump diptcalflg_isDmotSpdMode diptcalflg_isES diptcalflg_isKl15 diptcalflg_isKl15_Raw diptcalflg_isPmotHighSpd diptcalflg_isPmotLowSpd diptcalflg_isRegen diptcalflg_isReqShutdown diptcalflg_isRing diptcalflg_isStart diptcalvlu_i8GearPos diptcalvlu_isAirPump diptcalvlu_isDmotSpdMode diptcalvlu_isES diptcalvlu_isKl15 diptcalvlu_isKl15_Raw diptcalvlu_isPmotHighSpd diptcalvlu_isPmotLowSpd diptcalvlu_isRegen diptcalvlu_isReqShutdown diptcalvlu_isRing diptcalvlu_isStart /end REF_CHARACTERISTIC
 /begin REF_MEASUREMENT diptmsr_i8GearPos diptmsr_isAirPump diptmsr_isDmotSpdMode diptmsr_isES diptmsr_isKl15 diptmsr_isKl15_Raw diptmsr_isPmotHighSpd diptmsr_isPmotLowSpd diptmsr_isRegen diptmsr_isReqShutdown diptmsr_isRing diptmsr_isStart /end REF_MEASUREMENT
/end GROUP
/begin GROUP S4_dopt "xjmain/GOTO/dopt" /begin SUB_GROUP S28_dopt_main /end SUB_GROUP
 /begin REF_CHARACTERISTIC doptcalflg_isAirPumpInd doptcalflg_isBattFltInd doptcalflg_isBattHeatInd doptcalflg_isDMotInd doptcalflg_isDmotFltInd doptcalflg_isOBCInd doptcalflg_isPduWakeUp doptcalflg_isPmotInd doptcalflg_isRgInd doptcalflg_isRing doptcalflg_isStopEnginePwr doptcalvlu_isAirPumpInd doptcalvlu_isBattFltInd doptcalvlu_isBattHeatInd doptcalvlu_isDMotInd doptcalvlu_isDmotFltInd doptcalvlu_isOBCInd doptcalvlu_isPduWakeUp doptcalvlu_isPmotInd doptcalvlu_isRgInd doptcalvlu_isRing doptcalvlu_isStopEnginePwr /end REF_CHARACTERISTIC
 /begin REF_MEASUREMENT doptmsr_isAirPumpInd doptmsr_isBattFltInd doptmsr_isBattHeatInd doptmsr_isDMotInd doptmsr_isDmotFltInd doptmsr_isOBCInd doptmsr_isPduWakeUp doptmsr_isPmotInd doptmsr_isRgInd doptmsr_isRing doptmsr_isStopEnginePwr /end REF_MEASUREMENT
/end GROUP
/begin GROUP S4_fdst_calibration "xjmain/GOTO/fdst_calibration" /begin SUB_GROUP S29_ComponentFault S29_InputSignals /end SUB_GROUP
 /begin REF_CHARACTERISTIC fdstcalflg_fBattChgPwrLmt_kW fdstcalflg_fBattDisChgPwrLmt_kW fdstcalflg_fDmotBrTrqLmt fdstcalflg_fDmotDrTrqLmt fdstcalflg_isBattHVEn fdstcalflg_isDmcuEn fdstcalflg_isPmcuEn fdstcalflg_u8VehFltLvl fdstcalvlu_fBattChgPwrLmt_kW fdstcalvlu_fBattDisChgPwrLmt_kW fdstcalvlu_fDmotBrTrqLmt fdstcalvlu_fDmotDrTrqLmt fdstcalvlu_isBattHVEn fdstcalvlu_isDmcuEn fdstcalvlu_isPmcuEn fdstcalvlu_u8VehFltLvl /end REF_CHARACTERISTIC
 /begin REF_MEASUREMENT fdstmsr_fBattChgPwrLmt_kW fdstmsr_fBattDisChgPwrLmt_kW fdstmsr_fDmotBrTrqLmt fdstmsr_fDmotDrTrqLmt fdstmsr_isBattHVEn fdstmsr_isDmcuEn fdstmsr_isPmcuEn fdstmsr_u8VehFltLvl /end REF_MEASUREMENT
/end GROUP
/begin GROUP S4_gmct_calibration "xjmain/GOTO/gmct_calibration" /begin REF_CHARACTERISTIC gmctcalflg_i8CurrentGear gmctcalvlu_i8CurrentGear /end REF_CHARACTERISTIC /begin REF_MEASUREMENT gmctmsr_i8CurrentGear /end REF_MEASUREMENT /end GROUP
/begin GROUP S4_incc_calibration "xjmain/GOTO/incc_calibration"
 /begin SUB_GROUP S31_AppValid S31_DMCU_FaultLevel S31_PMCU_FaultLevel S31_RunTime1 S31_Windlevel S31_can_bus_fault S31_hoistspd S31_system_ready S31_vcu_fault S31_veh_message /end SUB_GROUP
/end GROUP
/begin GROUP S4_mmct_calibration "xjmain/GOTO/mmct_calibration" /begin SUB_GROUP S32_mmct_Pmot S32_mmct_main /end SUB_GROUP
 /begin REF_CHARACTERISTIC GEAR_N mmctcalflg_fDmcuTrqReq mmctcalflg_fPmcuTrqReq mmctcalflg_i16DmcuSpdReq mmctcalflg_i16PmcuSpdReq mmctcalflg_u8DmcuDirModeReq mmctcalflg_u8DmcuRunModeReq mmctcalflg_u8PmcuDirModeReq mmctcalflg_u8PmcuRunModeReq mmctcalvlu_fDmcuTrqReq mmctcalvlu_fPmcuTrqReq mmctcalvlu_i16DmcuSpdReq mmctcalvlu_i16PmcuSpdReq mmctcalvlu_u8DmcuDirModeReq mmctcalvlu_u8DmcuRunModeReq mmctcalvlu_u8PmcuDirModeReq mmctcalvlu_u8PmcuRunModeReq /end REF_CHARACTERISTIC
 /begin REF_MEASUREMENT mmctmsr_fDmcuTrqReq mmctmsr_fPmcuTrqReq mmctmsr_i16DmcuSpdReq mmctmsr_i16PmcuSpdReq mmctmsr_u8DmcuDirModeReq mmctmsr_u8DmcuRunModeReq mmctmsr_u8PmcuDirModeReq mmctmsr_u8PmcuRunModeReq /end REF_MEASUREMENT
/end GROUP
/begin GROUP S4_obc_calibration "xjmain/GOTO/obc_calibration" /begin SUB_GROUP S33_obc_main /end SUB_GROUP
 /begin REF_CHARACTERISTIC obccalflg_fChgCurrSet obccalflg_fChgVoltSet obccalflg_isChgStart obccalflg_u8BattChgMode obccalvlu_fChgCurrSet obccalvlu_fChgVoltSet obccalvlu_isChgStart obccalvlu_u8BattChgMode /end REF_CHARACTERISTIC
 /begin REF_MEASUREMENT obcmsr_fChgCurrSet obcmsr_fChgVoltSet obcmsr_isChgStart obcmsr_u8BattChgMode /end REF_MEASUREMENT
/end GROUP
/begin GROUP S4_pooc "xjmain/GOTO/pooc" /begin SUB_GROUP S34_pooc_calibration /end SUB_GROUP
 /begin REF_CHARACTERISTIC pooccalflg_hasBattConn pooccalflg_hasVehLVDown pooccalflg_hasVehRdy pooccalflg_isBattConn pooccalflg_isChgAllow pooccalflg_isDcdcDcacConn pooccalflg_isDisConnLV pooccalflg_isDmcuConn pooccalflg_isDmcuEn pooccalflg_isDmcuPreConn pooccalflg_isMcuDisChg pooccalflg_isObcConn pooccalflg_isPmcuConn pooccalflg_isPmcuEn pooccalflg_isPmcuPreConn pooccalflg_isRlyFlt pooccalflg_isWarningLight pooccalflg_u8StepRunFlt pooccalflg_u8StepRunSts pooccalvlu_hasBattConn pooccalvlu_hasVehLVDown pooccalvlu_hasVehRdy pooccalvlu_isBattConn pooccalvlu_isChgAllow pooccalvlu_isDcdcDcacConn pooccalvlu_isDisConnLV pooccalvlu_isDmcuConn pooccalvlu_isDmcuEn pooccalvlu_isDmcuPreConn pooccalvlu_isMcuDisChg pooccalvlu_isObcConn pooccalvlu_isPmcuConn pooccalvlu_isPmcuEn pooccalvlu_isPmcuPreConn pooccalvlu_isRlyFlt pooccalvlu_isWarningLight pooccalvlu_u8StepRunFlt pooccalvlu_u8StepRunSts /end REF_CHARACTERISTIC
 /begin REF_MEASUREMENT poocmsr_hasBattConn poocmsr_hasVehLVDown poocmsr_hasVehRdy poocmsr_isBattConn poocmsr_isChgAllow poocmsr_isDcdcDcacConn poocmsr_isDisConnLV poocmsr_isDmcuConn poocmsr_isDmcuEn poocmsr_isDmcuPreConn poocmsr_isMcuDisChg poocmsr_isObcConn poocmsr_isPmcuConn poocmsr_isPmcuEn poocmsr_isPmcuPreConn poocmsr_isRlyFlt poocmsr_isWarningLight poocmsr_u8StepRunFlt poocmsr_u8StepRunSts /end REF_MEASUREMENT
/end GROUP
/begin GROUP S4_rbct_calibration "xjmain/GOTO/rbct_calibration" /begin SUB_GROUP S35_rbct_main /end SUB_GROUP
 /begin REF_CHARACTERISTIC rbctcalflg_fRgBrTrqReq rbctcalflg_isRegen rbctcalvlu_fRgBrTrqReq rbctcalvlu_isRegen /end REF_CHARACTERISTIC
 /begin REF_MEASUREMENT rbctmsr_fRgBrTrqReq rbctmsr_isRegen /end REF_MEASUREMENT
/end GROUP
/begin GROUP S4_rtos_calibration "xjmain/GOTO/rtos_calibration" /begin SUB_GROUP S36_debounce4 /end SUB_GROUP
 /begin REF_CHARACTERISTIC APP_STATUS_NORM APP_STATUS_SHUTDOWN APP_STATUS_SOFTRESET FALSE_BL TRUE_BL /end REF_CHARACTERISTIC
 /begin REF_MEASUREMENT appmsr_u8RunStatus /end REF_MEASUREMENT
/end GROUP
/begin GROUP S4_scpc_calibration "xjmain/GOTO/scpc_calibration" /begin SUB_GROUP S37_brake S37_drive /end SUB_GROUP
 /begin REF_CHARACTERISTIC scpccalflg_fDmcuMaxDrTrq scpccalflg_fDmcuMaxRgBrTrq scpccalflg_u16DmcuMaxDrSpd scpccalvlu_fDmcuMaxDrTrq scpccalvlu_fDmcuMaxRgBrTrq scpccalvlu_u16DmcuMaxDrSpd /end REF_CHARACTERISTIC
 /begin REF_MEASUREMENT scpcmsr_fDmcuMaxDrTrq scpcmsr_fDmcuMaxRgBrTrq scpcmsr_u16DmcuMaxDrSpd /end REF_MEASUREMENT
/end GROUP
/begin GROUP S4_tfta_calibration "xjmain/GOTO/tfta_calibration"
 /begin SUB_GROUP S38_final_limit S38_torque_damping S38_tq_syn_and_limitation /end SUB_GROUP
 /begin REF_CHARACTERISTIC tftacalflg_fDmcuTrqReq tftacalflg_i8DmcuTrqReqMode tftacalvlu_fDmcuTrqReq tftacalvlu_i8DmcuTrqReqMode /end REF_CHARACTERISTIC
 /begin REF_MEASUREMENT tftamsr_fDmcuTrqReq tftamsr_i8DmcuTrqReqMode /end REF_MEASUREMENT
/end GROUP
/begin GROUP S4_wctrl "xjmain/GOTO/wctrl" /begin SUB_GROUP S39_final_limit /end SUB_GROUP
 /begin REF_CHARACTERISTIC wctrlcalflg_i8PmcuSpdReqMode wctrlcalflg_u16PmcuSpdReq wctrlcalvlu_i8PmcuSpdReqMode wctrlcalvlu_u16PmcuSpdReq /end REF_CHARACTERISTIC
 /begin REF_MEASUREMENT wctrlmsr_i8PmcuSpdReqMode wctrlmsr_u16PmcuSpdReq /end REF_MEASUREMENT
/end GROUP
/begin GROUP S5_Power_Off_Management "xjmain/Power Management Example/Power Off Management" /begin SUB_GROUP S295_Get_flgKeyOn S295_TOfD_xxxx1 /end SUB_GROUP /end GROUP
/begin GROUP S6_ActIn "xjmain/VarIn/ActIn"
 /begin SUB_GROUP S327_Subsystem_Reference S327_Subsystem_Reference1 S327_Subsystem_Reference2 S327_Subsystem_Reference3 S327_Subsystem_Reference4 S327_Subsystem_Reference5 S327_Subsystem_Reference6 S327_Subsystem_Reference7 S327_Subsystem_Reference8 S327_hld_aipt2 S327_hld_dipt /end SUB_GROUP
 /begin REF_MEASUREMENT hldmsr_AI_AccPedal hldmsr_AI_AccPedalRaw hldmsr_AI_DmotSpdRes hldmsr_AI_DmotSpdResRaw hldmsr_B2O_u8ChgOnOffCtrl hldmsr_B2V_fBattAvaiMaxVolt hldmsr_B2V_fBattCellMaxVolt hldmsr_B2V_fBattCellMinVolt hldmsr_B2V_fBattChgCurrCont hldmsr_B2V_fBattChgCurrPeak hldmsr_B2V_fBattDisChgCurrCont hldmsr_B2V_fBattDisChgCurrPeak hldmsr_B2V_fBattPackCurr hldmsr_B2V_fBattPackVolt hldmsr_B2V_fBattSOC hldmsr_B2V_i16BattCellAvgTmpt hldmsr_B2V_u8BattCanLifeSig hldmsr_B2V_u8BattFltCode hldmsr_B2V_u8BattFltLvl hldmsr_B2V_u8CurrentChgSts hldmsr_B2V_u8CurrentHVSts hldmsr_B2V_u8CurrentHeatSts hldmsr_B2V_u8DCChgConnSts hldmsr_B2V_u8FCNegRly1Sts hldmsr_B2V_u8FCNegRly2Sts hldmsr_B2V_u8FCPosRly1Sts hldmsr_B2V_u8FCPosRly2Sts hldmsr_B2V_u8MainNegRlySts hldmsr_B2V_u8PTCNegRlySts hldmsr_B2V_u8PTCPosRlySts hldmsr_B2V_u8ReqHVPwrOff hldmsr_DI_AirPump hldmsr_DI_DmotSpdMode hldmsr_DI_ES hldmsr_DI_GearD1 hldmsr_DI_GearD2 hldmsr_DI_GearD3 hldmsr_DI_GearD4 hldmsr_DI_GearR hldmsr_DI_PmotHighSpd hldmsr_DI_PmotLowSpd hldmsr_DI_Regen hldmsr_DI_Ring hldmsr_DI_Start hldmsr_I2V_u16PmotSpdHSet hldmsr_I2V_u16PmotSpdLSet hldmsr_I2V_u8ChgModeSet hldmsr_I2V_u8ChgOnOffCtrl hldmsr_I2V_u8ChgPwrSet hldmsr_O2B_fChgOutCurrAct hldmsr_O2B_fChgOutVoltAct hldmsr_O2B_hasChgCanFlt hldmsr_O2B_hasChgHwFlt hldmsr_O2B_hasChgInVoltFlt hldmsr_O2B_hasChgOff hldmsr_O2B_hasChgOvrTmptFlt hldmsr_O2B_hasChgSlfChkFlt hldmsr_O2B_hasChgWakeUp hldmsr_P2V_hasPduRdy hldmsr_P2V_u8DcacRunSts hldmsr_T2V_fDmcuNegTrgLmt hldmsr_T2V_fDmcuPosTrgLmt hldmsr_T2V_fDmotAcCurrAct hldmsr_T2V_fPmcuNegTrgLmt hldmsr_T2V_fPmcuPosTrgLmt hldmsr_T2V_fPmotAcCurrAct hldmsr_T2V_fPmotDcVoltAct hldmsr_T2V_fPmotTrqAct hldmsr_T2V_hasDmcuDisChg hldmsr_T2V_hasDmotEn hldmsr_T2V_hasPmcuDisChg hldmsr_T2V_hasPmotEn hldmsr_T2V_hasPmotFlt hldmsr_T2V_hasPmotSpdMode hldmsr_T2V_hasPmotStart hldmsr_T2V_i16DmcuTmptAct hldmsr_T2V_i16DmotSpdAct hldmsr_T2V_i16DmotTmptAct hldmsr_T2V_i16DmotTrqAct hldmsr_T2V_i16PmcuTmptAct hldmsr_T2V_i16PmotSpdAct hldmsr_T2V_i16PmotTmptAct hldmsr_T2V_i8CurrentGear hldmsr_T2V_i8SelectGear hldmsr_T2V_u8DmcuCanLifeSig hldmsr_T2V_u8DmcuFltCode hldmsr_T2V_u8DmcuFltLvl hldmsr_T2V_u8DmotRunSts hldmsr_T2V_u8GearFltLvl hldmsr_T2V_u8PmcuCanLifeSig hldmsr_T2V_u8PmcuFltCode hldmsr_T2V_u8PmcuFltLvl hldmsr_T2V_u8PmotRunSts /end REF_MEASUREMENT
/end GROUP
/begin GROUP S22_Hysteresis "xjmain/GOTO/aipt_calibration/Hysteresis" /begin REF_CHARACTERISTIC FALSE_BL TRUE_BL /end REF_CHARACTERISTIC /end GROUP
/begin GROUP S22_Hysteresis1 "xjmain/GOTO/aipt_calibration/Hysteresis1" /begin REF_CHARACTERISTIC FALSE_BL TRUE_BL /end REF_CHARACTERISTIC /end GROUP
/begin GROUP S32_mmct_main "xjmain/GOTO/mmct_calibration/mmct_main" /begin REF_CHARACTERISTIC GEAR_N /end REF_CHARACTERISTIC /end GROUP
/begin GROUP S33_obc_main "xjmain/GOTO/obc_calibration/obc_main" /begin REF_CHARACTERISTIC glc_OBC_OUT_CURR_MAX_A glc_OBC_OUT_VOLT_MAX_V /end REF_CHARACTERISTIC /end GROUP
/begin GROUP S34_pooc_calibration "xjmain/GOTO/pooc/pooc_calibration" /begin REF_CHARACTERISTIC GEAR_N /end REF_CHARACTERISTIC /end GROUP
/end MODULE
/end PROJECT
/* (add any file trailer comments here) */ /* EOF xjmain.a2l */
