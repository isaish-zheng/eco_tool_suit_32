ASAP2_VERSION 1 31
/begin PROJECT ProjectName "Project Comment Goes Here"
/begin HEADER "Header Comments go here" /end HEADER
/begin MODULE ModuleName "Module Comment Goes Here"
/begin MOD_COMMON "" /* Comment */ ALIGNMENT_BYTE 1 ALIGNMENT_WORD 1 ALIGNMENT_LONG 1 ALIGNMENT_FLOAT32_IEEE 1 ALIGNMENT_FLOAT64_IEEE 1 BYTE_ORDER MSB_FIRST DEPOSIT ABSOLUTE /end MOD_COMMON
/begin RECORD_LAYOUT Scalar_BOOLEAN FNC_VALUES 1 UBYTE COLUMN_DIR DIRECT /end RECORD_LAYOUT
/begin RECORD_LAYOUT Scalar_UBYTE FNC_VALUES 1 UBYTE COLUMN_DIR DIRECT /end RECORD_LAYOUT
/begin RECORD_LAYOUT Scalar_BYTE FNC_VALUES 1 SBYTE COLUMN_DIR DIRECT /end RECORD_LAYOUT
/begin RECORD_LAYOUT Scalar_UWORD FNC_VALUES 1 UWORD COLUMN_DIR DIRECT /end RECORD_LAYOUT
/begin RECORD_LAYOUT Scalar_SWORD FNC_VALUES 1 SWORD COLUMN_DIR DIRECT /end RECORD_LAYOUT
/begin RECORD_LAYOUT Scalar_ULONG FNC_VALUES 1 ULONG COLUMN_DIR DIRECT /end RECORD_LAYOUT
/begin RECORD_LAYOUT Lookup1D_BYTE FNC_VALUES 1 SBYTE COLUMN_DIR DIRECT /end RECORD_LAYOUT
/begin RECORD_LAYOUT Lookup1D_X_BYTE AXIS_PTS_X 1 SBYTE INDEX_INCR DIRECT /end RECORD_LAYOUT
/begin RECORD_LAYOUT Lookup1D_UBYTE FNC_VALUES 1 UBYTE COLUMN_DIR DIRECT /end RECORD_LAYOUT
/begin RECORD_LAYOUT Lookup1D_X_UBYTE AXIS_PTS_X 1 UBYTE INDEX_INCR DIRECT /end RECORD_LAYOUT
/begin RECORD_LAYOUT Lookup1D_UWORD FNC_VALUES 1 UWORD COLUMN_DIR DIRECT /end RECORD_LAYOUT
/begin RECORD_LAYOUT Lookup1D_X_UWORD AXIS_PTS_X 1 UWORD INDEX_INCR DIRECT /end RECORD_LAYOUT
/begin RECORD_LAYOUT Lookup1D_WORD FNC_VALUES 1 SWORD COLUMN_DIR DIRECT /end RECORD_LAYOUT
/begin RECORD_LAYOUT Lookup1D_X_WORD AXIS_PTS_X 1 SWORD INDEX_INCR DIRECT /end RECORD_LAYOUT
/begin RECORD_LAYOUT Lookup1D_ULONG FNC_VALUES 1 ULONG COLUMN_DIR DIRECT /end RECORD_LAYOUT
/begin RECORD_LAYOUT Lookup1D_X_ULONG AXIS_PTS_X 1 ULONG INDEX_INCR DIRECT /end RECORD_LAYOUT
/begin RECORD_LAYOUT Lookup1D_SLONG FNC_VALUES 1 SLONG COLUMN_DIR DIRECT /end RECORD_LAYOUT
/begin RECORD_LAYOUT Lookup1D_X_LONG AXIS_PTS_X 1 SLONG INDEX_INCR DIRECT /end RECORD_LAYOUT
/begin RECORD_LAYOUT Lookup1D_FLOAT32_IEEE FNC_VALUES 1 FLOAT32_IEEE COLUMN_DIR DIRECT /end RECORD_LAYOUT
/begin RECORD_LAYOUT Lookup1D_X_FLOAT32_IEEE AXIS_PTS_X 1 FLOAT32_IEEE INDEX_INCR DIRECT /end RECORD_LAYOUT
/begin RECORD_LAYOUT Lookup1D_FLOAT64_IEEE FNC_VALUES 1 FLOAT64_IEEE COLUMN_DIR DIRECT /end RECORD_LAYOUT
/begin RECORD_LAYOUT Lookup1D_X_FLOAT64_IEEE AXIS_PTS_X 1 FLOAT64_IEEE INDEX_INCR DIRECT /end RECORD_LAYOUT
/begin RECORD_LAYOUT Lookup2D_BOOLEAN FNC_VALUES 1 UBYTE COLUMN_DIR DIRECT /end RECORD_LAYOUT
/begin RECORD_LAYOUT Lookup2D_X_BOOLEAN AXIS_PTS_X 1 UBYTE INDEX_INCR DIRECT /end RECORD_LAYOUT
/begin RECORD_LAYOUT Lookup2D_UBYTE FNC_VALUES 1 UBYTE COLUMN_DIR DIRECT /end RECORD_LAYOUT
/begin RECORD_LAYOUT Lookup2D_X_UBYTE AXIS_PTS_X 1 UBYTE INDEX_INCR DIRECT /end RECORD_LAYOUT
/begin RECORD_LAYOUT Lookup2D_BYTE FNC_VALUES 1 SBYTE COLUMN_DIR DIRECT /end RECORD_LAYOUT
/begin RECORD_LAYOUT Lookup2D_X_BYTE AXIS_PTS_X 1 SBYTE INDEX_INCR DIRECT /end RECORD_LAYOUT
/begin RECORD_LAYOUT Lookup2D_UWORD FNC_VALUES 1 UWORD COLUMN_DIR DIRECT /end RECORD_LAYOUT
/begin RECORD_LAYOUT Lookup2D_X_UWORD AXIS_PTS_X 1 UWORD INDEX_INCR DIRECT /end RECORD_LAYOUT
/begin RECORD_LAYOUT Lookup2D_WORD FNC_VALUES 1 SWORD COLUMN_DIR DIRECT /end RECORD_LAYOUT
/begin RECORD_LAYOUT Lookup2D_X_WORD AXIS_PTS_X 1 SWORD INDEX_INCR DIRECT /end RECORD_LAYOUT
/begin RECORD_LAYOUT Lookup2D_ULONG FNC_VALUES 1 ULONG COLUMN_DIR DIRECT /end RECORD_LAYOUT
/begin RECORD_LAYOUT Lookup2D_X_ULONG AXIS_PTS_X 1 ULONG INDEX_INCR DIRECT /end RECORD_LAYOUT
/begin RECORD_LAYOUT Lookup2D_LONG FNC_VALUES 1 SLONG COLUMN_DIR DIRECT /end RECORD_LAYOUT
/begin RECORD_LAYOUT Lookup2D_X_LONG AXIS_PTS_X 1 SLONG INDEX_INCR DIRECT /end RECORD_LAYOUT
/begin RECORD_LAYOUT Lookup2D_FLOAT32_IEEE FNC_VALUES 1 FLOAT32_IEEE COLUMN_DIR DIRECT /end RECORD_LAYOUT
/begin RECORD_LAYOUT Lookup2D_X_FLOAT32_IEEE AXIS_PTS_X 1 FLOAT32_IEEE INDEX_INCR DIRECT /end RECORD_LAYOUT
/begin RECORD_LAYOUT Lookup2D_FLOAT64_IEEE FNC_VALUES 1 FLOAT64_IEEE COLUMN_DIR DIRECT /end RECORD_LAYOUT
/begin RECORD_LAYOUT Lookup2D_X_FLOAT64_IEEE AXIS_PTS_X 1 FLOAT64_IEEE INDEX_INCR DIRECT /end RECORD_LAYOUT
/begin CHARACTERISTIC apddc_Lk2D_DmotAppCoef_fCoef_pct_z "" /* Characteristic Type */ MAP 0xfd00d6 /* @ECU_Address@apddc_Lk2D_DmotAppCoef_fCoef_pct_z@ */ Lookup2D_UWORD /* Maxdiff */ 0 xjmain_CM_ufix16_En8_none 0.0 100.0
 /begin AXIS_DESCR /* Description of X-Axis Points */ COM_AXIS aiptmsr_fAPPos_pct xjmain_CM_ufix16_En9_percent_ 16 0.0 100.0 AXIS_PTS_REF apddc_Lk2D_DmotAppCoef_fAppPos_pct_y /end AXIS_DESCR
 /begin AXIS_DESCR /* Description of Y-Axis Points */ COM_AXIS NO_INPUT_QUANTITY xjmain_CM_int16_rpm 12 0.0 4000.0 AXIS_PTS_REF apddc_Lk2D_DmotAppCoef_i16Spd_x /end AXIS_DESCR
/end CHARACTERISTIC
/begin CHARACTERISTIC rbctc_Lk1D_RgTrqCoef_fCoef_y "" /* Characteristic Type */ CURVE 0xfd03c6 /* @ECU_Address@rbctc_Lk1D_RgTrqCoef_fCoef_y@ */ Lookup1D_UWORD /* Maxdiff */ 0 xjmain_CM_ufix16_En9 0.0 1.0
 /begin AXIS_DESCR /* Description of X-Axis Points */ COM_AXIS NO_INPUT_QUANTITY xjmain_CM_int16 8 0.0 4000.0 AXIS_PTS_REF rbctc_Lk1D_RgTrqCoef_i16Spd_x /end AXIS_DESCR
/end CHARACTERISTIC
/begin CHARACTERISTIC appc_u32Version "" VALUE 0xfd0280 /* @ECU_Address@appc_u32Version@ */ Scalar_ULONG 0 xjmain_CM_uint32 0 4294967295 /end CHARACTERISTIC
/begin CHARACTERISTIC apddc_Lk1D_DmotMaxTrq_i16Spd_x "" VAL_BLK 0xfd00a0 /* @ECU_Address@apddc_Lk1D_DmotMaxTrq_i16Spd_x@ */ Scalar_SWORD 0 xjmain_CM_int16_rpm 0.0 4000.0 NUMBER 11 /end CHARACTERISTIC
/begin CHARACTERISTIC apddc_i16PmotHighSpd "" VALUE 0xfd0270 /* @ECU_Address@apddc_i16PmotHighSpd@ */ Scalar_SWORD 0 xjmain_CM_int16_rpm 0.0 6000.0 /end CHARACTERISTIC
/begin CHARACTERISTIC apddc_i16PmotLowSpd "" VALUE 0xfd0272 /* @ECU_Address@apddc_i16PmotLowSpd@ */ Scalar_SWORD 0 xjmain_CM_int16_rpm 0.0 6000.0 /end CHARACTERISTIC
/begin CHARACTERISTIC coptcalvlu_V2T_i16DmcuSpdReq "" VALUE 0xfd02e0 /* @ECU_Address@coptcalvlu_V2T_i16DmcuSpdReq@ */ Scalar_SWORD 0 xjmain_CM_int16_rpm -4000.0 4000.0 /end CHARACTERISTIC
/begin CHARACTERISTIC glc_i16DMCU_MAX_SPD_LMT "" VALUE 0xfd0356 /* @ECU_Address@glc_i16DMCU_MAX_SPD_LMT@ */ Scalar_SWORD 0 xjmain_CM_int16 -4000.0 4000.0 /end CHARACTERISTIC
/begin CHARACTERISTIC mmctc_i16DmcuSpdLmtOfD4 "" VALUE 0xfd035a /* @ECU_Address@mmctc_i16DmcuSpdLmtOfD4@ */ Scalar_SWORD 0 xjmain_CM_int16 -4000.0 4000.0 /end CHARACTERISTIC
/begin CHARACTERISTIC rbctc_i16MaxRgPwr_kW "" VALUE 0xfd03ec /* @ECU_Address@rbctc_i16MaxRgPwr_kW@ */ Scalar_SWORD 0 xjmain_CM_int16 -400.0 400.0 /end CHARACTERISTIC
/begin CHARACTERISTIC scpcc_Lk2D_DmotBrEff_i16Spd_y "" VAL_BLK 0xfd03f8 /* @ECU_Address@scpcc_Lk2D_DmotBrEff_i16Spd_y@ */ Scalar_SWORD 0 xjmain_CM_int16 0.0 6000.0 NUMBER 10 /end CHARACTERISTIC
/begin CHARACTERISTIC scpcc_Lk2D_DmotDrEff_i16Spd_y "" VAL_BLK 0xfd040c /* @ECU_Address@scpcc_Lk2D_DmotDrEff_i16Spd_y@ */ Scalar_SWORD 0 xjmain_CM_int16 0.0 6000.0 NUMBER 10 /end CHARACTERISTIC
/begin CHARACTERISTIC aiptc_phy_APP_LowLmt_Err "" VALUE 0xfd0060 /* @ECU_Address@aiptc_phy_APP_LowLmt_Err@ */ Scalar_SWORD 0 xjmain_CM_sfix16_En13_V -1.0 1.0 /end CHARACTERISTIC
/begin CHARACTERISTIC aiptc_phy_APP_UpLmt_Err "" VALUE 0xfd0064 /* @ECU_Address@aiptc_phy_APP_UpLmt_Err@ */ Scalar_SWORD 0 xjmain_CM_sfix16_En13_V -1.0 1.0 /end CHARACTERISTIC
/begin CHARACTERISTIC aiptc_phy_DmotSpdRes_LowLmt_Err "" VALUE 0xfd0068 /* @ECU_Address@aiptc_phy_DmotSpdRes_LowLmt_Err@ */ Scalar_SWORD 0 xjmain_CM_sfix16_En13_V -1.0 1.0 /end CHARACTERISTIC
/begin CHARACTERISTIC aiptc_phy_DmotSpdRes_UpLmt_Err "" VALUE 0xfd006c /* @ECU_Address@aiptc_phy_DmotSpdRes_UpLmt_Err@ */ Scalar_SWORD 0 xjmain_CM_sfix16_En13_V -1.0 1.0 /end CHARACTERISTIC
/begin CHARACTERISTIC aiptc_phy_HW_LowLmt_Err "" VALUE 0xfd0070 /* @ECU_Address@aiptc_phy_HW_LowLmt_Err@ */ Scalar_SWORD 0 xjmain_CM_sfix16_En13_V -1.0 1.0 /end CHARACTERISTIC
/begin CHARACTERISTIC aiptc_phy_HW_UpLmt_Err "" VALUE 0xfd0074 /* @ECU_Address@aiptc_phy_HW_UpLmt_Err@ */ Scalar_SWORD 0 xjmain_CM_sfix16_En13_V -1.0 1.0 /end CHARACTERISTIC
/begin CHARACTERISTIC coptcalvlu_V2T_fDmcuTrqReq "" VALUE 0xfd02da /* @ECU_Address@coptcalvlu_V2T_fDmcuTrqReq@ */ Scalar_SWORD 0 xjmain_CM_sfix16_En2_Nm -4000.0 4000.0 /end CHARACTERISTIC
/begin CHARACTERISTIC coptcalvlu_V2T_fPmcuTrqReq "" VALUE 0xfd02dc /* @ECU_Address@coptcalvlu_V2T_fPmcuTrqReq@ */ Scalar_SWORD 0 xjmain_CM_sfix16_En2_Nm -4000.0 4000.0 /end CHARACTERISTIC
/begin CHARACTERISTIC poocc_fBattCurrLow "" VALUE 0xfd037e /* @ECU_Address@poocc_fBattCurrLow@ */ Scalar_SWORD 0 xjmain_CM_sfix16_En3 -1000.0 1000.0 /end CHARACTERISTIC
/begin CHARACTERISTIC rbctc_Hys_fDmcuMaxRgTrq_off "" VALUE 0xfd03c2 /* @ECU_Address@rbctc_Hys_fDmcuMaxRgTrq_off@ */ Scalar_SWORD 0 xjmain_CM_sfix16_En3 -4000.0 4000.0 /end CHARACTERISTIC
/begin CHARACTERISTIC rbctc_Hys_fDmcuMaxRgTrq_on "" VALUE 0xfd03c4 /* @ECU_Address@rbctc_Hys_fDmcuMaxRgTrq_on@ */ Scalar_SWORD 0 xjmain_CM_sfix16_En3 -4000.0 4000.0 /end CHARACTERISTIC
/begin CHARACTERISTIC rbctc_fMaxRgTrq "" VALUE 0xfd03e6 /* @ECU_Address@rbctc_fMaxRgTrq@ */ Scalar_SWORD 0 xjmain_CM_sfix16_En3 -4000.0 4000.0 /end CHARACTERISTIC
/begin CHARACTERISTIC rbctc_fRgBrTrqReqMaxLmt "" VALUE 0xfd03e8 /* @ECU_Address@rbctc_fRgBrTrqReqMaxLmt@ */ Scalar_SWORD 0 xjmain_CM_sfix16_En3 -4000.0 4000.0 /end CHARACTERISTIC
/begin CHARACTERISTIC rbctc_fRgBrTrqReqMinLmt "" VALUE 0xfd03ea /* @ECU_Address@rbctc_fRgBrTrqReqMinLmt@ */ Scalar_SWORD 0 xjmain_CM_sfix16_En3 -4000.0 4000.0 /end CHARACTERISTIC
/begin CHARACTERISTIC aiptc_phy_APP_LowLmt_Raw "" VALUE 0xfd0062 /* @ECU_Address@aiptc_phy_APP_LowLmt_Raw@ */ Scalar_UWORD 0 xjmain_CM_ufix16_En13_V 0.0 5.0 /end CHARACTERISTIC
/begin CHARACTERISTIC aiptc_phy_APP_UpLmt_Raw "" VALUE 0xfd0066 /* @ECU_Address@aiptc_phy_APP_UpLmt_Raw@ */ Scalar_UWORD 0 xjmain_CM_ufix16_En13_V 0.0 7.0 /end CHARACTERISTIC
/begin CHARACTERISTIC aiptc_phy_DmotSpdRes_LowLmt_Raw "" VALUE 0xfd006a /* @ECU_Address@aiptc_phy_DmotSpdRes_LowLmt_Raw@ */ Scalar_UWORD 0 xjmain_CM_ufix16_En13_V 0.0 5.0 /end CHARACTERISTIC
/begin CHARACTERISTIC aiptc_phy_DmotSpdRes_UpLmt_Raw "" VALUE 0xfd006e /* @ECU_Address@aiptc_phy_DmotSpdRes_UpLmt_Raw@ */ Scalar_UWORD 0 xjmain_CM_ufix16_En13_V 0.0 7.0 /end CHARACTERISTIC
/begin CHARACTERISTIC aiptc_phy_HW_LowLmt_Raw "" VALUE 0xfd0072 /* @ECU_Address@aiptc_phy_HW_LowLmt_Raw@ */ Scalar_UWORD 0 xjmain_CM_ufix16_En13_V 0.0 5.0 /end CHARACTERISTIC
/begin CHARACTERISTIC aiptc_phy_HW_UpLmt_Raw "" VALUE 0xfd0076 /* @ECU_Address@aiptc_phy_HW_UpLmt_Raw@ */ Scalar_UWORD 0 xjmain_CM_ufix16_En13_V 0.0 7.0 /end CHARACTERISTIC
/begin CHARACTERISTIC aiptc_adc2phy_APP_Ratio "" VALUE 0xfd0024 /* @ECU_Address@aiptc_adc2phy_APP_Ratio@ */ Scalar_UWORD 0 xjmain_CM_ufix16_En14 0.0 1.0 /end CHARACTERISTIC
/begin CHARACTERISTIC aiptc_adc2phy_AirPumpPress_Ratio "" VALUE 0xfd0026 /* @ECU_Address@aiptc_adc2phy_AirPumpPress_Ratio@ */ Scalar_UWORD 0 xjmain_CM_ufix16_En14 0.0 1.0 /end CHARACTERISTIC
/begin CHARACTERISTIC aiptc_adc2phy_DmotSpdRes_Ratio "" VALUE 0xfd0028 /* @ECU_Address@aiptc_adc2phy_DmotSpdRes_Ratio@ */ Scalar_UWORD 0 xjmain_CM_ufix16_En14 0.0 1.0 /end CHARACTERISTIC
/begin CHARACTERISTIC aiptc_adc2phy_HW_Ratio "" VALUE 0xfd002a /* @ECU_Address@aiptc_adc2phy_HW_Ratio@ */ Scalar_UWORD 0 xjmain_CM_ufix16_En14 0.0 1.0 /end CHARACTERISTIC
/begin CHARACTERISTIC aiptc_adc2phy_SkylightPress_Ratio "" VALUE 0xfd002c /* @ECU_Address@aiptc_adc2phy_SkylightPress_Ratio@ */ Scalar_UWORD 0 xjmain_CM_ufix16_En14 0.0 1.0 /end CHARACTERISTIC
/begin CHARACTERISTIC aiptc_adc2phy_WindSpd_Ratio "" VALUE 0xfd002e /* @ECU_Address@aiptc_adc2phy_WindSpd_Ratio@ */ Scalar_UWORD 0 xjmain_CM_ufix16_En14 0.0 1.0 /end CHARACTERISTIC
/begin CHARACTERISTIC coptcalvlu_V2O_fChgCurrSet "" VALUE 0xfd02ca /* @ECU_Address@coptcalvlu_V2O_fChgCurrSet@ */ Scalar_UWORD 0 xjmain_CM_ufix16_En2_A 0.0 1000.0 /end CHARACTERISTIC
/begin CHARACTERISTIC amctc_Hys_fAirPumpRunPress_bar_off "" VALUE 0xfd0098 /* @ECU_Address@amctc_Hys_fAirPumpRunPress_bar_off@ */ Scalar_UWORD 0 xjmain_CM_ufix16_En4 0.0 100.0 /end CHARACTERISTIC
/begin CHARACTERISTIC amctc_Hys_fAirPumpRunPress_bar_on "" VALUE 0xfd009a /* @ECU_Address@amctc_Hys_fAirPumpRunPress_bar_on@ */ Scalar_UWORD 0 xjmain_CM_ufix16_En4 0.0 100.0 /end CHARACTERISTIC
/begin CHARACTERISTIC obcc_fBattHeatCurr "" VALUE 0xfd0370 /* @ECU_Address@obcc_fBattHeatCurr@ */ Scalar_UWORD 0 xjmain_CM_ufix16_En4 0.0 100.0 /end CHARACTERISTIC
/begin CHARACTERISTIC coptcalvlu_V2O_fChgVoltSet "" VALUE 0xfd02cc /* @ECU_Address@coptcalvlu_V2O_fChgVoltSet@ */ Scalar_UWORD 0 xjmain_CM_ufix16_En6_V 0.0 1000.0 /end CHARACTERISTIC
/begin CHARACTERISTIC glc_ANGLEBOX_RATIO "" VALUE 0xfd0330 /* @ECU_Address@glc_ANGLEBOX_RATIO@ */ Scalar_UWORD 0 xjmain_CM_ufix16_En6 0.0 15.937 /end CHARACTERISTIC
/begin CHARACTERISTIC glc_CHAIN_RATIO "" VALUE 0xfd0332 /* @ECU_Address@glc_CHAIN_RATIO@ */ Scalar_UWORD 0 xjmain_CM_ufix16_En6 0.0 15.937 /end CHARACTERISTIC
/begin CHARACTERISTIC glc_GEAR_D1_RATIO "" VALUE 0xfd0334 /* @ECU_Address@glc_GEAR_D1_RATIO@ */ Scalar_UWORD 0 xjmain_CM_ufix16_En6 0.0 31.875 /end CHARACTERISTIC
/begin CHARACTERISTIC glc_GEAR_D2_RATIO "" VALUE 0xfd0336 /* @ECU_Address@glc_GEAR_D2_RATIO@ */ Scalar_UWORD 0 xjmain_CM_ufix16_En6 0.0 31.875 /end CHARACTERISTIC
/begin CHARACTERISTIC glc_GEAR_D3_RATIO "" VALUE 0xfd0338 /* @ECU_Address@glc_GEAR_D3_RATIO@ */ Scalar_UWORD 0 xjmain_CM_ufix16_En6 0.0 31.875 /end CHARACTERISTIC
/begin CHARACTERISTIC glc_GEAR_D4_RATIO "" VALUE 0xfd033a /* @ECU_Address@glc_GEAR_D4_RATIO@ */ Scalar_UWORD 0 xjmain_CM_ufix16_En6 0.0 31.875 /end CHARACTERISTIC
/begin CHARACTERISTIC glc_GEAR_R_RATIO "" VALUE 0xfd033c /* @ECU_Address@glc_GEAR_R_RATIO@ */ Scalar_UWORD 0 xjmain_CM_ufix16_En6 0.0 31.875 /end CHARACTERISTIC
/begin CHARACTERISTIC glc_REGEN_RATIO "" VALUE 0xfd034a /* @ECU_Address@glc_REGEN_RATIO@ */ Scalar_UWORD 0 xjmain_CM_ufix16_En6 0.0 1.0 /end CHARACTERISTIC
/begin CHARACTERISTIC glc_ROLLER_DIAMETER_mm "" VALUE 0xfd034c /* @ECU_Address@glc_ROLLER_DIAMETER_mm@ */ Scalar_UWORD 0 xjmain_CM_ufix16_En6 0.0 1000.0 /end CHARACTERISTIC
/begin CHARACTERISTIC glc_ROTARYTABLE_EFF "" VALUE 0xfd034e /* @ECU_Address@glc_ROTARYTABLE_EFF@ */ Scalar_UWORD 0 xjmain_CM_ufix16_En6 0.0 31.875 /end CHARACTERISTIC
/begin CHARACTERISTIC glc_ROTARYTABLE_RATIO "" VALUE 0xfd0350 /* @ECU_Address@glc_ROTARYTABLE_RATIO@ */ Scalar_UWORD 0 xjmain_CM_ufix16_En6 0.0 31.875 /end CHARACTERISTIC
/begin CHARACTERISTIC glc_TRANSBOX_RATIO "" VALUE 0xfd0354 /* @ECU_Address@glc_TRANSBOX_RATIO@ */ Scalar_UWORD 0 xjmain_CM_ufix16_En6 0.0 31.875 /end CHARACTERISTIC
/begin CHARACTERISTIC apddc_fDmotBwdTrqDerat "" VALUE 0xfd026e /* @ECU_Address@apddc_fDmotBwdTrqDerat@ */ Scalar_UWORD 0 xjmain_CM_ufix16_En8_none 0.0 1.0 /end CHARACTERISTIC
/begin CHARACTERISTIC rbctc_Hys_fBattSOC_off "" VALUE 0xfd03be /* @ECU_Address@rbctc_Hys_fBattSOC_off@ */ Scalar_UWORD 0 xjmain_CM_ufix16_En8 0.0 100.0 /end CHARACTERISTIC
/begin CHARACTERISTIC rbctc_Hys_fBattSOC_on "" VALUE 0xfd03c0 /* @ECU_Address@rbctc_Hys_fBattSOC_on@ */ Scalar_UWORD 0 xjmain_CM_ufix16_En8 0.0 100.0 /end CHARACTERISTIC
/begin CHARACTERISTIC aiptc_adc_APP_FilterWeight "" VALUE 0xfd0030 /* @ECU_Address@aiptc_adc_APP_FilterWeight@ */ Scalar_UWORD 0 xjmain_CM_ufix16_En9 0.0 100.0 /end CHARACTERISTIC
/begin CHARACTERISTIC aiptc_adc_AirPumpPress_FilterWeight "" VALUE 0xfd0036 /* @ECU_Address@aiptc_adc_AirPumpPress_FilterWeight@ */ Scalar_UWORD 0 xjmain_CM_ufix16_En9 0.0 100.0 /end CHARACTERISTIC
/begin CHARACTERISTIC aiptc_adc_DmotSpdRes_FilterWeight "" VALUE 0xfd003c /* @ECU_Address@aiptc_adc_DmotSpdRes_FilterWeight@ */ Scalar_UWORD 0 xjmain_CM_ufix16_En9 0.0 100.0 /end CHARACTERISTIC
/begin CHARACTERISTIC aiptc_adc_HW_FilterWeight "" VALUE 0xfd0042 /* @ECU_Address@aiptc_adc_HW_FilterWeight@ */ Scalar_UWORD 0 xjmain_CM_ufix16_En9 0.0 100.0 /end CHARACTERISTIC
/begin CHARACTERISTIC aiptc_adc_SkylightPress_FilterWeight "" VALUE 0xfd004a /* @ECU_Address@aiptc_adc_SkylightPress_FilterWeight@ */ Scalar_UWORD 0 xjmain_CM_ufix16_En9 0.0 100.0 /end CHARACTERISTIC
/begin CHARACTERISTIC aiptc_adc_WindSpd_FilterWeight "" VALUE 0xfd0050 /* @ECU_Address@aiptc_adc_WindSpd_FilterWeight@ */ Scalar_UWORD 0 xjmain_CM_ufix16_En9 0.0 100.0 /end CHARACTERISTIC
/begin CHARACTERISTIC coptcalvlu_V2I_fHoistSpd "" VALUE 0xfd02bc /* @ECU_Address@coptcalvlu_V2I_fHoistSpd@ */ Scalar_UWORD 0 xjmain_CM_ufix16_Sp1 0.0 100.0 /end CHARACTERISTIC
/begin CHARACTERISTIC BMS_CANBREAK1_debounce_time "" VALUE 0xfd0004 /* @ECU_Address@BMS_CANBREAK1_debounce_time@ */ Scalar_UWORD 0 xjmain_CM_uint16 0.0 65535.0 /end CHARACTERISTIC
/begin CHARACTERISTIC BMS_CANBREAK_debounce_time "" VALUE 0xfd0006 /* @ECU_Address@BMS_CANBREAK_debounce_time@ */ Scalar_UWORD 0 xjmain_CM_uint16 0.0 65535.0 /end CHARACTERISTIC
/begin CHARACTERISTIC BMS_CANLOST_debounce_time "" VALUE 0xfd0008 /* @ECU_Address@BMS_CANLOST_debounce_time@ */ Scalar_UWORD 0 xjmain_CM_uint16 0.0 65535.0 /end CHARACTERISTIC
/begin CHARACTERISTIC MCU_CANBREAK1_debounce_time "" VALUE 0xfd0016 /* @ECU_Address@MCU_CANBREAK1_debounce_time@ */ Scalar_UWORD 0 xjmain_CM_uint16 0.0 65535.0 /end CHARACTERISTIC
/begin CHARACTERISTIC MCU_CANBREAK_debounce_time "" VALUE 0xfd0018 /* @ECU_Address@MCU_CANBREAK_debounce_time@ */ Scalar_UWORD 0 xjmain_CM_uint16 0.0 65535.0 /end CHARACTERISTIC
/begin CHARACTERISTIC MCU_CANLOST_debounce_time "" VALUE 0xfd001a /* @ECU_Address@MCU_CANLOST_debounce_time@ */ Scalar_UWORD 0 xjmain_CM_uint16 0.0 65535.0 /end CHARACTERISTIC
/begin CHARACTERISTIC aiptc_adc_APP_GndShort "" VALUE 0xfd0032 /* @ECU_Address@aiptc_adc_APP_GndShort@ */ Scalar_UWORD 0 xjmain_CM_uint16 0.0 65535.0 /end CHARACTERISTIC
/begin CHARACTERISTIC aiptc_adc_APP_VccShort "" VALUE 0xfd0034 /* @ECU_Address@aiptc_adc_APP_VccShort@ */ Scalar_UWORD 0 xjmain_CM_uint16 0.0 65535.0 /end CHARACTERISTIC
/begin CHARACTERISTIC aiptc_adc_AirPumpPress_GndShort "" VALUE 0xfd0038 /* @ECU_Address@aiptc_adc_AirPumpPress_GndShort@ */ Scalar_UWORD 0 xjmain_CM_uint16 0.0 65535.0 /end CHARACTERISTIC
/begin CHARACTERISTIC aiptc_adc_AirPumpPress_VccShort "" VALUE 0xfd003a /* @ECU_Address@aiptc_adc_AirPumpPress_VccShort@ */ Scalar_UWORD 0 xjmain_CM_uint16 0.0 65535.0 /end CHARACTERISTIC
/begin CHARACTERISTIC aiptc_adc_DmotSpdRes_GndShort "" VALUE 0xfd003e /* @ECU_Address@aiptc_adc_DmotSpdRes_GndShort@ */ Scalar_UWORD 0 xjmain_CM_uint16 0.0 65535.0 /end CHARACTERISTIC
/begin CHARACTERISTIC aiptc_adc_DmotSpdRes_VccShort "" VALUE 0xfd0040 /* @ECU_Address@aiptc_adc_DmotSpdRes_VccShort@ */ Scalar_UWORD 0 xjmain_CM_uint16 0.0 65535.0 /end CHARACTERISTIC
/begin CHARACTERISTIC aiptc_adc_HW_GndShort "" VALUE 0xfd0044 /* @ECU_Address@aiptc_adc_HW_GndShort@ */ Scalar_UWORD 0 xjmain_CM_uint16 0.0 65535.0 /end CHARACTERISTIC
/begin CHARACTERISTIC aiptc_adc_HW_VccShort "" VALUE 0xfd0046 /* @ECU_Address@aiptc_adc_HW_VccShort@ */ Scalar_UWORD 0 xjmain_CM_uint16 0.0 65535.0 /end CHARACTERISTIC
/begin CHARACTERISTIC aiptc_adc_Selection "" VALUE 0xfd0048 /* @ECU_Address@aiptc_adc_Selection@ */ Scalar_UWORD 0 xjmain_CM_uint16 0.0 4096.0 /end CHARACTERISTIC
/begin CHARACTERISTIC aiptc_adc_SkylightPress_GndShort "" VALUE 0xfd004c /* @ECU_Address@aiptc_adc_SkylightPress_GndShort@ */ Scalar_UWORD 0 xjmain_CM_uint16 0.0 65535.0 /end CHARACTERISTIC
/begin CHARACTERISTIC aiptc_adc_SkylightPress_VccShort "" VALUE 0xfd004e /* @ECU_Address@aiptc_adc_SkylightPress_VccShort@ */ Scalar_UWORD 0 xjmain_CM_uint16 0.0 65535.0 /end CHARACTERISTIC
/begin CHARACTERISTIC aiptc_adc_WindSpd_GndShort "" VALUE 0xfd0052 /* @ECU_Address@aiptc_adc_WindSpd_GndShort@ */ Scalar_UWORD 0 xjmain_CM_uint16 0.0 65535.0 /end CHARACTERISTIC
/begin CHARACTERISTIC aiptc_adc_WindSpd_VccShort "" VALUE 0xfd0054 /* @ECU_Address@aiptc_adc_WindSpd_VccShort@ */ Scalar_UWORD 0 xjmain_CM_uint16 0.0 65535.0 /end CHARACTERISTIC
/begin CHARACTERISTIC coptcalvlu_V2T_i16PmcuSpdReq "" VALUE 0xfd02e2 /* @ECU_Address@coptcalvlu_V2T_i16PmcuSpdReq@ */ Scalar_UWORD 0 xjmain_CM_uint16_rpm 0.0 6000.0 /end CHARACTERISTIC
/begin CHARACTERISTIC poocc_u16BattConnTimeOut_ms "" VALUE 0xfd0380 /* @ECU_Address@poocc_u16BattConnTimeOut_ms@ */ Scalar_UWORD 0 xjmain_CM_uint16 0.0 65535.0 /end CHARACTERISTIC
/begin CHARACTERISTIC poocc_u16BattDisConnTime_ms "" VALUE 0xfd0382 /* @ECU_Address@poocc_u16BattDisConnTime_ms@ */ Scalar_UWORD 0 xjmain_CM_uint16 0.0 65535.0 /end CHARACTERISTIC
/begin CHARACTERISTIC poocc_u16InitTimeOut_ms "" VALUE 0xfd0384 /* @ECU_Address@poocc_u16InitTimeOut_ms@ */ Scalar_UWORD 0 xjmain_CM_uint16 0.0 65535.0 /end CHARACTERISTIC
/begin CHARACTERISTIC poocc_u16LVDownTime_ms "" VALUE 0xfd0386 /* @ECU_Address@poocc_u16LVDownTime_ms@ */ Scalar_UWORD 0 xjmain_CM_uint16 0.0 65535.0 /end CHARACTERISTIC
/begin CHARACTERISTIC poocc_u16McuDisChgTime_ms "" VALUE 0xfd0388 /* @ECU_Address@poocc_u16McuDisChgTime_ms@ */ Scalar_UWORD 0 xjmain_CM_uint16 0.0 65535.0 /end CHARACTERISTIC
/begin CHARACTERISTIC poocc_u16McuPreConnTime_ms "" VALUE 0xfd038a /* @ECU_Address@poocc_u16McuPreConnTime_ms@ */ Scalar_UWORD 0 xjmain_CM_uint16 0.0 65535.0 /end CHARACTERISTIC
/begin CHARACTERISTIC poocc_u16MotEnTimeOut_ms "" VALUE 0xfd038c /* @ECU_Address@poocc_u16MotEnTimeOut_ms@ */ Scalar_UWORD 0 xjmain_CM_uint16 0.0 65535.0 /end CHARACTERISTIC
/begin CHARACTERISTIC poocc_u16MotSpdLowChg "" VALUE 0xfd038e /* @ECU_Address@poocc_u16MotSpdLowChg@ */ Scalar_UWORD 0 xjmain_CM_uint16 0.0 6000.0 /end CHARACTERISTIC
/begin CHARACTERISTIC poocc_u16MotSpdLowDown "" VALUE 0xfd0390 /* @ECU_Address@poocc_u16MotSpdLowDown@ */ Scalar_UWORD 0 xjmain_CM_uint16 0.0 6000.0 /end CHARACTERISTIC
/begin CHARACTERISTIC poocc_u16MotSpdLowUp "" VALUE 0xfd0392 /* @ECU_Address@poocc_u16MotSpdLowUp@ */ Scalar_UWORD 0 xjmain_CM_uint16 0.0 6000.0 /end CHARACTERISTIC
/begin CHARACTERISTIC poocc_u16PwrDownTime_ms "" VALUE 0xfd0394 /* @ECU_Address@poocc_u16PwrDownTime_ms@ */ Scalar_UWORD 0 xjmain_CM_uint16 0.0 65535.0 /end CHARACTERISTIC
/begin CHARACTERISTIC poocc_u16SpdCurrDlyTime_ms "" VALUE 0xfd0396 /* @ECU_Address@poocc_u16SpdCurrDlyTime_ms@ */ Scalar_UWORD 0 xjmain_CM_uint16 0.0 65535.0 /end CHARACTERISTIC
/begin CHARACTERISTIC tftac_u16DmcuTrqReq_FilterWeight "" VALUE 0xfd042c /* @ECU_Address@tftac_u16DmcuTrqReq_FilterWeight@ */ Scalar_UWORD 0 xjmain_CM_uint16_ms 0.0 100.0 /end CHARACTERISTIC
/begin CHARACTERISTIC wctrlc_u16PmcuSpdReqMax "" VALUE 0xfd0434 /* @ECU_Address@wctrlc_u16PmcuSpdReqMax@ */ Scalar_UWORD 0 xjmain_CM_uint16_rpm 0.0 6000.0 /end CHARACTERISTIC
/begin CHARACTERISTIC coptcalflg_V2B_isChgAllow "" VALUE 0xfd0291 /* @ECU_Address@coptcalflg_V2B_isChgAllow@ */ Scalar_BOOLEAN 0 xjmain_CM_boolean_none 0.0 1.0 /end CHARACTERISTIC
/begin CHARACTERISTIC coptcalflg_V2B_u8BattChgMode "" VALUE 0xfd0292 /* @ECU_Address@coptcalflg_V2B_u8BattChgMode@ */ Scalar_BOOLEAN 0 xjmain_CM_boolean_none 0.0 1.0 /end CHARACTERISTIC
/begin CHARACTERISTIC coptcalflg_V2B_u8BattConn "" VALUE 0xfd0293 /* @ECU_Address@coptcalflg_V2B_u8BattConn@ */ Scalar_BOOLEAN 0 xjmain_CM_boolean_none 0.0 1.0 /end CHARACTERISTIC
/begin CHARACTERISTIC coptcalflg_V2I_fHoistSpd "" VALUE 0xfd0294 /* @ECU_Address@coptcalflg_V2I_fHoistSpd@ */ Scalar_BOOLEAN 0 xjmain_CM_boolean_none 0.0 1.0 /end CHARACTERISTIC
/begin CHARACTERISTIC coptcalflg_V2I_isApFlt "" VALUE 0xfd0295 /* @ECU_Address@coptcalflg_V2I_isApFlt@ */ Scalar_BOOLEAN 0 xjmain_CM_boolean_none 0.0 1.0 /end CHARACTERISTIC
/begin CHARACTERISTIC coptcalflg_V2I_isBattCanFltRc "" VALUE 0xfd0296 /* @ECU_Address@coptcalflg_V2I_isBattCanFltRc@ */ Scalar_BOOLEAN 0 xjmain_CM_boolean_none 0.0 1.0 /end CHARACTERISTIC
/begin CHARACTERISTIC coptcalflg_V2I_isDmcuCanFltRc "" VALUE 0xfd0297 /* @ECU_Address@coptcalflg_V2I_isDmcuCanFltRc@ */ Scalar_BOOLEAN 0 xjmain_CM_boolean_none 0.0 1.0 /end CHARACTERISTIC
/begin CHARACTERISTIC coptcalflg_V2I_isHWFlt "" VALUE 0xfd0298 /* @ECU_Address@coptcalflg_V2I_isHWFlt@ */ Scalar_BOOLEAN 0 xjmain_CM_boolean_none 0.0 1.0 /end CHARACTERISTIC
/begin CHARACTERISTIC coptcalflg_V2I_isPmcuCanFltRc "" VALUE 0xfd0299 /* @ECU_Address@coptcalflg_V2I_isPmcuCanFltRc@ */ Scalar_BOOLEAN 0 xjmain_CM_boolean_none 0.0 1.0 /end CHARACTERISTIC
/begin CHARACTERISTIC coptcalflg_V2I_isVehFlt "" VALUE 0xfd029a /* @ECU_Address@coptcalflg_V2I_isVehFlt@ */ Scalar_BOOLEAN 0 xjmain_CM_boolean_none 0.0 1.0 /end CHARACTERISTIC
/begin CHARACTERISTIC coptcalflg_V2I_isWindSpdFlt "" VALUE 0xfd029b /* @ECU_Address@coptcalflg_V2I_isWindSpdFlt@ */ Scalar_BOOLEAN 0 xjmain_CM_boolean_none 0.0 1.0 /end CHARACTERISTIC
/begin CHARACTERISTIC coptcalflg_V2I_u8ReadySts "" VALUE 0xfd029c /* @ECU_Address@coptcalflg_V2I_u8ReadySts@ */ Scalar_BOOLEAN 0 xjmain_CM_boolean_none 0.0 1.0 /end CHARACTERISTIC
/begin CHARACTERISTIC coptcalflg_V2I_u8VehChgSts "" VALUE 0xfd029d /* @ECU_Address@coptcalflg_V2I_u8VehChgSts@ */ Scalar_BOOLEAN 0 xjmain_CM_boolean_none 0.0 1.0 /end CHARACTERISTIC
/begin CHARACTERISTIC coptcalflg_V2I_u8VehRunSts "" VALUE 0xfd029e /* @ECU_Address@coptcalflg_V2I_u8VehRunSts@ */ Scalar_BOOLEAN 0 xjmain_CM_boolean_none 0.0 1.0 /end CHARACTERISTIC
/begin CHARACTERISTIC coptcalflg_V2I_u8WindLvl "" VALUE 0xfd029f /* @ECU_Address@coptcalflg_V2I_u8WindLvl@ */ Scalar_BOOLEAN 0 xjmain_CM_boolean_none 0.0 1.0 /end CHARACTERISTIC
/begin CHARACTERISTIC coptcalflg_V2O_fChgCurrSet "" VALUE 0xfd02a0 /* @ECU_Address@coptcalflg_V2O_fChgCurrSet@ */ Scalar_BOOLEAN 0 xjmain_CM_boolean_none 0.0 1.0 /end CHARACTERISTIC
/begin CHARACTERISTIC coptcalflg_V2O_fChgVoltSet "" VALUE 0xfd02a1 /* @ECU_Address@coptcalflg_V2O_fChgVoltSet@ */ Scalar_BOOLEAN 0 xjmain_CM_boolean_none 0.0 1.0 /end CHARACTERISTIC
/begin CHARACTERISTIC coptcalflg_V2O_u8ChgStartStop "" VALUE 0xfd02a2 /* @ECU_Address@coptcalflg_V2O_u8ChgStartStop@ */ Scalar_BOOLEAN 0 xjmain_CM_boolean_none 0.0 1.0 /end CHARACTERISTIC
/begin CHARACTERISTIC coptcalflg_V2P_isDcacRun "" VALUE 0xfd02a4 /* @ECU_Address@coptcalflg_V2P_isDcacRun@ */ Scalar_BOOLEAN 0 xjmain_CM_boolean_none 0.0 1.0 /end CHARACTERISTIC
/begin CHARACTERISTIC coptcalflg_V2P_isDcdcDcacConn "" VALUE 0xfd02a5 /* @ECU_Address@coptcalflg_V2P_isDcdcDcacConn@ */ Scalar_BOOLEAN 0 xjmain_CM_boolean_none 0.0 1.0 /end CHARACTERISTIC
/begin CHARACTERISTIC coptcalflg_V2P_isDcdcRun "" VALUE 0xfd02a6 /* @ECU_Address@coptcalflg_V2P_isDcdcRun@ */ Scalar_BOOLEAN 0 xjmain_CM_boolean_none 0.0 1.0 /end CHARACTERISTIC
/begin CHARACTERISTIC coptcalflg_V2P_isDmcuConn "" VALUE 0xfd02a7 /* @ECU_Address@coptcalflg_V2P_isDmcuConn@ */ Scalar_BOOLEAN 0 xjmain_CM_boolean_none 0.0 1.0 /end CHARACTERISTIC
/begin CHARACTERISTIC coptcalflg_V2P_isDmcuPreConn "" VALUE 0xfd02a8 /* @ECU_Address@coptcalflg_V2P_isDmcuPreConn@ */ Scalar_BOOLEAN 0 xjmain_CM_boolean_none 0.0 1.0 /end CHARACTERISTIC
/begin CHARACTERISTIC coptcalflg_V2P_isObcConn "" VALUE 0xfd02a9 /* @ECU_Address@coptcalflg_V2P_isObcConn@ */ Scalar_BOOLEAN 0 xjmain_CM_boolean_none 0.0 1.0 /end CHARACTERISTIC
/begin CHARACTERISTIC coptcalflg_V2P_isPmcuConn "" VALUE 0xfd02aa /* @ECU_Address@coptcalflg_V2P_isPmcuConn@ */ Scalar_BOOLEAN 0 xjmain_CM_boolean_none 0.0 1.0 /end CHARACTERISTIC
/begin CHARACTERISTIC coptcalflg_V2P_isPmcuPreConn "" VALUE 0xfd02ab /* @ECU_Address@coptcalflg_V2P_isPmcuPreConn@ */ Scalar_BOOLEAN 0 xjmain_CM_boolean_none 0.0 1.0 /end CHARACTERISTIC
/begin CHARACTERISTIC coptcalflg_V2T_fDmcuTrqReq "" VALUE 0xfd02ad /* @ECU_Address@coptcalflg_V2T_fDmcuTrqReq@ */ Scalar_BOOLEAN 0 xjmain_CM_boolean_none 0.0 1.0 /end CHARACTERISTIC
/begin CHARACTERISTIC coptcalflg_V2T_fPmcuTrqReq "" VALUE 0xfd02ae /* @ECU_Address@coptcalflg_V2T_fPmcuTrqReq@ */ Scalar_BOOLEAN 0 xjmain_CM_boolean_none 0.0 1.0 /end CHARACTERISTIC
/begin CHARACTERISTIC coptcalflg_V2T_i16DmcuSpdReq "" VALUE 0xfd02b0 /* @ECU_Address@coptcalflg_V2T_i16DmcuSpdReq@ */ Scalar_BOOLEAN 0 xjmain_CM_boolean_none 0.0 1.0 /end CHARACTERISTIC
/begin CHARACTERISTIC coptcalflg_V2T_i16PmcuSpdReq "" VALUE 0xfd02b1 /* @ECU_Address@coptcalflg_V2T_i16PmcuSpdReq@ */ Scalar_BOOLEAN 0 xjmain_CM_boolean_none 0.0 1.0 /end CHARACTERISTIC
/begin CHARACTERISTIC coptcalflg_V2T_i8GearPos "" VALUE 0xfd02b2 /* @ECU_Address@coptcalflg_V2T_i8GearPos@ */ Scalar_BOOLEAN 0 xjmain_CM_boolean_none 0.0 1.0 /end CHARACTERISTIC
/begin CHARACTERISTIC coptcalflg_V2T_isDmcuDisChg "" VALUE 0xfd02b3 /* @ECU_Address@coptcalflg_V2T_isDmcuDisChg@ */ Scalar_BOOLEAN 0 xjmain_CM_boolean_none 0.0 1.0 /end CHARACTERISTIC
/begin CHARACTERISTIC coptcalflg_V2T_isDmcuEn "" VALUE 0xfd02b4 /* @ECU_Address@coptcalflg_V2T_isDmcuEn@ */ Scalar_BOOLEAN 0 xjmain_CM_boolean_none 0.0 1.0 /end CHARACTERISTIC
/begin CHARACTERISTIC coptcalflg_V2T_isPmcuDisChg "" VALUE 0xfd02b5 /* @ECU_Address@coptcalflg_V2T_isPmcuDisChg@ */ Scalar_BOOLEAN 0 xjmain_CM_boolean_none 0.0 1.0 /end CHARACTERISTIC
/begin CHARACTERISTIC coptcalflg_V2T_isPmcuEn "" VALUE 0xfd02b6 /* @ECU_Address@coptcalflg_V2T_isPmcuEn@ */ Scalar_BOOLEAN 0 xjmain_CM_boolean_none 0.0 1.0 /end CHARACTERISTIC
/begin CHARACTERISTIC coptcalflg_V2T_u8DmcuRunModeReq "" VALUE 0xfd02b7 /* @ECU_Address@coptcalflg_V2T_u8DmcuRunModeReq@ */ Scalar_BOOLEAN 0 xjmain_CM_boolean_none 0.0 1.0 /end CHARACTERISTIC
/begin CHARACTERISTIC coptcalflg_V2T_u8PmcuRunModeReq "" VALUE 0xfd02b8 /* @ECU_Address@coptcalflg_V2T_u8PmcuRunModeReq@ */ Scalar_BOOLEAN 0 xjmain_CM_boolean_none 0.0 1.0 /end CHARACTERISTIC
/begin CHARACTERISTIC coptcalvlu_V2B_isChgAllow "" VALUE 0xfd02b9 /* @ECU_Address@coptcalvlu_V2B_isChgAllow@ */ Scalar_BOOLEAN 0 xjmain_CM_boolean_none 0.0 1.0 /end CHARACTERISTIC
/begin CHARACTERISTIC coptcalvlu_V2I_isApFlt "" VALUE 0xfd02be /* @ECU_Address@coptcalvlu_V2I_isApFlt@ */ Scalar_BOOLEAN 0 xjmain_CM_boolean_none 0.0 1.0 /end CHARACTERISTIC
/begin CHARACTERISTIC coptcalvlu_V2I_isBattCanFltRc "" VALUE 0xfd02bf /* @ECU_Address@coptcalvlu_V2I_isBattCanFltRc@ */ Scalar_BOOLEAN 0 xjmain_CM_boolean_none 0.0 1.0 /end CHARACTERISTIC
/begin CHARACTERISTIC coptcalvlu_V2I_isDmcuCanFltRc "" VALUE 0xfd02c0 /* @ECU_Address@coptcalvlu_V2I_isDmcuCanFltRc@ */ Scalar_BOOLEAN 0 xjmain_CM_boolean_none 0.0 1.0 /end CHARACTERISTIC
/begin CHARACTERISTIC coptcalvlu_V2I_isHWFlt "" VALUE 0xfd02c1 /* @ECU_Address@coptcalvlu_V2I_isHWFlt@ */ Scalar_BOOLEAN 0 xjmain_CM_boolean_none 0.0 1.0 /end CHARACTERISTIC
/begin CHARACTERISTIC coptcalvlu_V2I_isPmcuCanFltRc "" VALUE 0xfd02c2 /* @ECU_Address@coptcalvlu_V2I_isPmcuCanFltRc@ */ Scalar_BOOLEAN 0 xjmain_CM_boolean_none 0.0 1.0 /end CHARACTERISTIC
/begin CHARACTERISTIC coptcalvlu_V2I_isVehFlt "" VALUE 0xfd02c3 /* @ECU_Address@coptcalvlu_V2I_isVehFlt@ */ Scalar_BOOLEAN 0 xjmain_CM_boolean 0.0 1.0 /end CHARACTERISTIC
/begin CHARACTERISTIC coptcalvlu_V2I_isWindSpdFlt "" VALUE 0xfd02c4 /* @ECU_Address@coptcalvlu_V2I_isWindSpdFlt@ */ Scalar_BOOLEAN 0 xjmain_CM_boolean_none 0.0 1.0 /end CHARACTERISTIC
/begin CHARACTERISTIC coptcalvlu_V2I_u8ReadySts "" VALUE 0xfd02c5 /* @ECU_Address@coptcalvlu_V2I_u8ReadySts@ */ Scalar_BOOLEAN 0 xjmain_CM_boolean_none 0.0 1.0 /end CHARACTERISTIC
/begin CHARACTERISTIC coptcalvlu_V2P_isDcacRun "" VALUE 0xfd02d0 /* @ECU_Address@coptcalvlu_V2P_isDcacRun@ */ Scalar_BOOLEAN 0 xjmain_CM_boolean_none 0.0 1.0 /end CHARACTERISTIC
/begin CHARACTERISTIC coptcalvlu_V2P_isDcdcDcacConn "" VALUE 0xfd02d1 /* @ECU_Address@coptcalvlu_V2P_isDcdcDcacConn@ */ Scalar_BOOLEAN 0 xjmain_CM_boolean_none 0.0 1.0 /end CHARACTERISTIC
/begin CHARACTERISTIC coptcalvlu_V2P_isDcdcRun "" VALUE 0xfd02d2 /* @ECU_Address@coptcalvlu_V2P_isDcdcRun@ */ Scalar_BOOLEAN 0 xjmain_CM_boolean_none 0.0 1.0 /end CHARACTERISTIC
/begin CHARACTERISTIC coptcalvlu_V2P_isDmcuConn "" VALUE 0xfd02d3 /* @ECU_Address@coptcalvlu_V2P_isDmcuConn@ */ Scalar_BOOLEAN 0 xjmain_CM_boolean_none 0.0 1.0 /end CHARACTERISTIC
/begin CHARACTERISTIC coptcalvlu_V2P_isDmcuPreConn "" VALUE 0xfd02d4 /* @ECU_Address@coptcalvlu_V2P_isDmcuPreConn@ */ Scalar_BOOLEAN 0 xjmain_CM_boolean_none 0.0 1.0 /end CHARACTERISTIC
/begin CHARACTERISTIC coptcalvlu_V2P_isObcConn "" VALUE 0xfd02d5 /* @ECU_Address@coptcalvlu_V2P_isObcConn@ */ Scalar_BOOLEAN 0 xjmain_CM_boolean_none 0.0 1.0 /end CHARACTERISTIC
/begin CHARACTERISTIC coptcalvlu_V2P_isPmcuConn "" VALUE 0xfd02d6 /* @ECU_Address@coptcalvlu_V2P_isPmcuConn@ */ Scalar_BOOLEAN 0 xjmain_CM_boolean_none 0.0 1.0 /end CHARACTERISTIC
/begin CHARACTERISTIC coptcalvlu_V2P_isPmcuPreConn "" VALUE 0xfd02d7 /* @ECU_Address@coptcalvlu_V2P_isPmcuPreConn@ */ Scalar_BOOLEAN 0 xjmain_CM_boolean_none 0.0 1.0 /end CHARACTERISTIC
/begin CHARACTERISTIC coptcalvlu_V2T_isDmcuDisChg "" VALUE 0xfd02e5 /* @ECU_Address@coptcalvlu_V2T_isDmcuDisChg@ */ Scalar_BOOLEAN 0 xjmain_CM_boolean_none 0.0 1.0 /end CHARACTERISTIC
/begin CHARACTERISTIC coptcalvlu_V2T_isDmcuEn "" VALUE 0xfd02e6 /* @ECU_Address@coptcalvlu_V2T_isDmcuEn@ */ Scalar_BOOLEAN 0 xjmain_CM_boolean_none 0.0 1.0 /end CHARACTERISTIC
/begin CHARACTERISTIC coptcalvlu_V2T_isPmcuDisChg "" VALUE 0xfd02e7 /* @ECU_Address@coptcalvlu_V2T_isPmcuDisChg@ */ Scalar_BOOLEAN 0 xjmain_CM_boolean_none 0.0 1.0 /end CHARACTERISTIC
/begin CHARACTERISTIC coptcalvlu_V2T_isPmcuEn "" VALUE 0xfd02e8 /* @ECU_Address@coptcalvlu_V2T_isPmcuEn@ */ Scalar_BOOLEAN 0 xjmain_CM_boolean_none 0.0 1.0 /end CHARACTERISTIC
/begin CHARACTERISTIC fdstc_isReqHVPwrOffGoOnOneCycTime "" VALUE 0xfd0319 /* @ECU_Address@fdstc_isReqHVPwrOffGoOnOneCycTime@ */ Scalar_BOOLEAN 0 xjmain_CM_boolean 0.0 1.0 /end CHARACTERISTIC
/begin CHARACTERISTIC GEAR_D "" VALUE 0xfd000f /* @ECU_Address@GEAR_D@ */ Scalar_BYTE 0 xjmain_CM_int8 0.0 4.0 /end CHARACTERISTIC
/begin CHARACTERISTIC GEAR_D1 "" VALUE 0xfd0010 /* @ECU_Address@GEAR_D1@ */ Scalar_BYTE 0 xjmain_CM_int8 0.0 4.0 /end CHARACTERISTIC
/begin CHARACTERISTIC GEAR_D2 "" VALUE 0xfd0011 /* @ECU_Address@GEAR_D2@ */ Scalar_BYTE 0 xjmain_CM_int8 0.0 4.0 /end CHARACTERISTIC
/begin CHARACTERISTIC GEAR_D3 "" VALUE 0xfd0012 /* @ECU_Address@GEAR_D3@ */ Scalar_BYTE 0 xjmain_CM_int8 0.0 4.0 /end CHARACTERISTIC
/begin CHARACTERISTIC GEAR_D4 "" VALUE 0xfd0013 /* @ECU_Address@GEAR_D4@ */ Scalar_BYTE 0 xjmain_CM_int8 0.0 4.0 /end CHARACTERISTIC
/begin CHARACTERISTIC GEAR_R "" VALUE 0xfd0015 /* @ECU_Address@GEAR_R@ */ Scalar_BYTE 0 xjmain_CM_int8 -1.0 4.0 /end CHARACTERISTIC
/begin CHARACTERISTIC coptcalvlu_V2T_i8GearPos "" VALUE 0xfd02e4 /* @ECU_Address@coptcalvlu_V2T_i8GearPos@ */ Scalar_BYTE 0 xjmain_CM_int8_enum -1.0 14.0 /end CHARACTERISTIC
/begin CHARACTERISTIC rbctc_i8AllowRgBattAvgTmpt "" VALUE 0xfd03ee /* @ECU_Address@rbctc_i8AllowRgBattAvgTmpt@ */ Scalar_BYTE 0 xjmain_CM_int8 -40.0 127.0 /end CHARACTERISTIC
/begin CHARACTERISTIC tftac_i8AllowZeroTrqReqMax "" VALUE 0xfd042a /* @ECU_Address@tftac_i8AllowZeroTrqReqMax@ */ Scalar_BYTE 0 xjmain_CM_int8_Nm 0.0 100.0 /end CHARACTERISTIC
/begin CHARACTERISTIC tftac_i8AllowZeroTrqReqMin "" VALUE 0xfd042b /* @ECU_Address@tftac_i8AllowZeroTrqReqMin@ */ Scalar_BYTE 0 xjmain_CM_int8_Nm -100.0 0.0 /end CHARACTERISTIC
/begin CHARACTERISTIC FLT_LVL_0 "" VALUE 0xfd000b /* @ECU_Address@FLT_LVL_0@ */ Scalar_UBYTE 0 xjmain_CM_uint8 0.0 3.0 /end CHARACTERISTIC
/begin CHARACTERISTIC FLT_LVL_1 "" VALUE 0xfd000c /* @ECU_Address@FLT_LVL_1@ */ Scalar_UBYTE 0 xjmain_CM_uint8 0.0 3.0 /end CHARACTERISTIC
/begin CHARACTERISTIC FLT_LVL_2 "" VALUE 0xfd000d /* @ECU_Address@FLT_LVL_2@ */ Scalar_UBYTE 0 xjmain_CM_uint8 0.0 3.0 /end CHARACTERISTIC
/begin CHARACTERISTIC FLT_LVL_3 "" VALUE 0xfd000e /* @ECU_Address@FLT_LVL_3@ */ Scalar_UBYTE 0 xjmain_CM_uint8 0.0 3.0 /end CHARACTERISTIC
/begin CHARACTERISTIC MCU_DIR_MODE_NEG "" VALUE 0xfd001c /* @ECU_Address@MCU_DIR_MODE_NEG@ */ Scalar_UBYTE 0 xjmain_CM_uint8 0.0 255.0 /end CHARACTERISTIC
/begin CHARACTERISTIC MCU_DIR_MODE_POS "" VALUE 0xfd001d /* @ECU_Address@MCU_DIR_MODE_POS@ */ Scalar_UBYTE 0 xjmain_CM_uint8 0.0 255.0 /end CHARACTERISTIC
/begin CHARACTERISTIC MCU_RUN_MODE_SPD "" VALUE 0xfd001e /* @ECU_Address@MCU_RUN_MODE_SPD@ */ Scalar_UBYTE 0 xjmain_CM_uint8 0.0 255.0 /end CHARACTERISTIC
/begin CHARACTERISTIC MCU_RUN_MODE_TRQ "" VALUE 0xfd001f /* @ECU_Address@MCU_RUN_MODE_TRQ@ */ Scalar_UBYTE 0 xjmain_CM_uint8 0.0 255.0 /end CHARACTERISTIC
/begin CHARACTERISTIC MCU_TRQ_MODE_ZERO "" VALUE 0xfd0020 /* @ECU_Address@MCU_TRQ_MODE_ZERO@ */ Scalar_UBYTE 0 xjmain_CM_uint8 0.0 255.0 /end CHARACTERISTIC
/begin CHARACTERISTIC aiptc_Deb_time_ms "" VALUE 0xfd0022 /* @ECU_Address@aiptc_Deb_time_ms@ */ Scalar_UBYTE 0 xjmain_CM_uint8 0.0 254.0 /end CHARACTERISTIC
/begin CHARACTERISTIC coptcalvlu_V2B_u8BattChgMode "" VALUE 0xfd02ba /* @ECU_Address@coptcalvlu_V2B_u8BattChgMode@ */ Scalar_UBYTE 0 xjmain_CM_uint8 0.0 5.0 /end CHARACTERISTIC
/begin CHARACTERISTIC coptcalvlu_V2B_u8BattConn "" VALUE 0xfd02bb /* @ECU_Address@coptcalvlu_V2B_u8BattConn@ */ Scalar_UBYTE 0 xjmain_CM_uint8_none 0.0 1.0 /end CHARACTERISTIC
/begin CHARACTERISTIC coptcalvlu_V2I_u8VehChgSts "" VALUE 0xfd02c6 /* @ECU_Address@coptcalvlu_V2I_u8VehChgSts@ */ Scalar_UBYTE 0 xjmain_CM_uint8 0.0 15.0 /end CHARACTERISTIC
/begin CHARACTERISTIC coptcalvlu_V2I_u8VehRunSts "" VALUE 0xfd02c7 /* @ECU_Address@coptcalvlu_V2I_u8VehRunSts@ */ Scalar_UBYTE 0 xjmain_CM_uint8_none 0.0 15.0 /end CHARACTERISTIC
/begin CHARACTERISTIC coptcalvlu_V2I_u8WindLvl "" VALUE 0xfd02c8 /* @ECU_Address@coptcalvlu_V2I_u8WindLvl@ */ Scalar_UBYTE 0 xjmain_CM_uint8 0.0 30.0 /end CHARACTERISTIC
/begin CHARACTERISTIC coptcalvlu_V2O_u8ChgStartStop "" VALUE 0xfd02ce /* @ECU_Address@coptcalvlu_V2O_u8ChgStartStop@ */ Scalar_UBYTE 0 xjmain_CM_uint8_none 0.0 3.0 /end CHARACTERISTIC
/begin CHARACTERISTIC coptcalvlu_V2T_u8DmcuRunModeReq "" VALUE 0xfd02e9 /* @ECU_Address@coptcalvlu_V2T_u8DmcuRunModeReq@ */ Scalar_UBYTE 0 xjmain_CM_uint8_enum 0.0 15.0 /end CHARACTERISTIC
/begin CHARACTERISTIC coptcalvlu_V2T_u8PmcuRunModeReq "" VALUE 0xfd02ea /* @ECU_Address@coptcalvlu_V2T_u8PmcuRunModeReq@ */ Scalar_UBYTE 0 xjmain_CM_uint8_enum 0.0 15.0 /end CHARACTERISTIC
/begin CHARACTERISTIC fdstc_u8ReqHVPwrOffDlyCycTime "" VALUE 0xfd031a /* @ECU_Address@fdstc_u8ReqHVPwrOffDlyCycTime@ */ Scalar_UBYTE 0 xjmain_CM_uint8 0.0 255.0 /end CHARACTERISTIC
/begin CHARACTERISTIC glc_KEY_DEB_TIME_MS "" VALUE 0xfd033e /* @ECU_Address@glc_KEY_DEB_TIME_MS@ */ Scalar_UBYTE 0 xjmain_CM_uint8 0.0 255.0 /end CHARACTERISTIC
/begin CHARACTERISTIC glc_STEEL_WIRE_SUM "" VALUE 0xfd0352 /* @ECU_Address@glc_STEEL_WIRE_SUM@ */ Scalar_UBYTE 0 xjmain_CM_uint8 0.0 100.0 /end CHARACTERISTIC
/begin CHARACTERISTIC obcc_u8DcdcPwr_kW "" VALUE 0xfd0372 /* @ECU_Address@obcc_u8DcdcPwr_kW@ */ Scalar_UBYTE 0 xjmain_CM_uint8 0.0 100.0 /end CHARACTERISTIC
/begin CHARACTERISTIC obcc_u8VehFltDebTime_ms "" VALUE 0xfd0373 /* @ECU_Address@obcc_u8VehFltDebTime_ms@ */ Scalar_UBYTE 0 xjmain_CM_uint8 0.0 250.0 /end CHARACTERISTIC
/begin CHARACTERISTIC rbctc_u8AllowRgHW_t "" VALUE 0xfd03ef /* @ECU_Address@rbctc_u8AllowRgHW_t@ */ Scalar_UBYTE 0 xjmain_CM_uint8 0.0 200.0 /end CHARACTERISTIC
/begin CHARACTERISTIC rbctc_u8VehFltDebTime_ms "" VALUE 0xfd03f0 /* @ECU_Address@rbctc_u8VehFltDebTime_ms@ */ Scalar_UBYTE 0 xjmain_CM_uint8 0.0 250.0 /end CHARACTERISTIC
/begin CHARACTERISTIC scpcc_u8AccessoryPwr_kW "" VALUE 0xfd0420 /* @ECU_Address@scpcc_u8AccessoryPwr_kW@ */ Scalar_UBYTE 0 xjmain_CM_uint8 0.0 100.0 /end CHARACTERISTIC
/begin AXIS_PTS apddc_Lk2D_DmotAppCoef_i16Spd_x "" 0xfd0256 /* @ECU_Address@apddc_Lk2D_DmotAppCoef_i16Spd_x@ */ NO_INPUT_QUANTITY Lookup2D_X_WORD 0 xjmain_CM_int16_rpm 12 0.0 4000.0 /end AXIS_PTS
/begin AXIS_PTS apddc_Lk2D_DmotAppCoef_fAppPos_pct_y "" 0xfd00b6 /* @ECU_Address@apddc_Lk2D_DmotAppCoef_fAppPos_pct_y@ */ aiptmsr_fAPPos_pct Lookup2D_X_UWORD 0 xjmain_CM_ufix16_En9_percent_ 16 0.0 100.0 /end AXIS_PTS
/begin AXIS_PTS rbctc_Lk1D_RgTrqCoef_i16Spd_x "" 0xfd03d6 /* @ECU_Address@rbctc_Lk1D_RgTrqCoef_i16Spd_x@ */ NO_INPUT_QUANTITY Lookup1D_X_WORD 0 xjmain_CM_int16 8 0.0 4000.0 /end AXIS_PTS
/begin MEASUREMENT incc_NewRunTime2 "" ULONG xjmain_CM_uint32 0 0 0 4294967295 ECU_ADDRESS 0x40008200 /* @ECU_Address@incc_NewRunTime2@ */ /end MEASUREMENT
/begin MEASUREMENT incc_NewRunTime3 "" ULONG xjmain_CM_uint32 0 0 0 4294967295 ECU_ADDRESS 0x40008204 /* @ECU_Address@incc_NewRunTime3@ */ /end MEASUREMENT
/begin MEASUREMENT appmsr_u32Version "" ULONG xjmain_CM_uint32 0 0 0 4294967295 ECU_ADDRESS 0x4000802c /* @ECU_Address@appmsr_u32Version@ */ /end MEASUREMENT
/begin MEASUREMENT appmsr_fCycTime "" FLOAT32_IEEE xjmain_CM_single 0 0 -3.4E+38 3.4E+38 ECU_ADDRESS 0x40008028 /* @ECU_Address@appmsr_fCycTime@ */ /end MEASUREMENT
/begin MEASUREMENT apddmsrv_fDmotSysMaxTrq "" SLONG xjmain_CM_sfix32_En4 0 0 -1.34217728E+8 1.342177279375E+8 ECU_ADDRESS 0x40008024 /* @ECU_Address@apddmsrv_fDmotSysMaxTrq@ */ /end MEASUREMENT
/begin MEASUREMENT hldmsr_AI_SkylightPress "" UWORD xjmain_CM_uint16 0 0 0 65535 ECU_ADDRESS 0x40008136 /* @ECU_Address@hldmsr_AI_SkylightPress@ */ /end MEASUREMENT
/begin MEASUREMENT hldmsr_AI_AirPumpPress "" UWORD xjmain_CM_uint16 0 0 0 65535 ECU_ADDRESS 0x4000812e /* @ECU_Address@hldmsr_AI_AirPumpPress@ */ /end MEASUREMENT
/begin MEASUREMENT hldmsr_AI_WindSpd "" UWORD xjmain_CM_uint16 0 0 0 65535 ECU_ADDRESS 0x40008138 /* @ECU_Address@hldmsr_AI_WindSpd@ */ /end MEASUREMENT
/begin MEASUREMENT hldmsr_AI_HoistWeight "" UWORD xjmain_CM_uint16 0 0 0 65535 ECU_ADDRESS 0x40008134 /* @ECU_Address@hldmsr_AI_HoistWeight@ */ /end MEASUREMENT
/begin MEASUREMENT mmctmsrv_u16DmcuSpdReq "" UWORD xjmain_CM_uint16 0 0 0 65535 ECU_ADDRESS 0x40008222 /* @ECU_Address@mmctmsrv_u16DmcuSpdReq@ */ /end MEASUREMENT
/begin MEASUREMENT incc_HoistSpd_mps "" UWORD xjmain_CM_ufix16_Sp1 0 0 0 6553.5 ECU_ADDRESS 0x400081fc /* @ECU_Address@incc_HoistSpd_mps@ */ /end MEASUREMENT
/begin MEASUREMENT incc_NewRunTime1 "" UWORD xjmain_CM_ufix16_Sp001 0 0 0 65.535 ECU_ADDRESS 0x400081fe /* @ECU_Address@incc_NewRunTime1@ */ /end MEASUREMENT
/begin MEASUREMENT apddmsrv_fDmotFwdAppCoef "" UWORD xjmain_CM_ufix16_En8 0 0 0 255.99609375 ECU_ADDRESS 0x40008020 /* @ECU_Address@apddmsrv_fDmotFwdAppCoef@ */ /end MEASUREMENT
/begin MEASUREMENT apddmsrv_fDmotBwdAppCoef "" UWORD xjmain_CM_ufix16_En8 0 0 0 255.99609375 ECU_ADDRESS 0x4000801c /* @ECU_Address@apddmsrv_fDmotBwdAppCoef@ */ /end MEASUREMENT
/begin MEASUREMENT scpcmsrv_fPmotInPwrReq_kW "" UWORD xjmain_CM_ufix16_En6 0 0 0 1023.984375 ECU_ADDRESS 0x4000824e /* @ECU_Address@scpcmsrv_fPmotInPwrReq_kW@ */ /end MEASUREMENT
/begin MEASUREMENT fdstmsrv_fSysFltBattChgPwrLmt_kW "" UWORD xjmain_CM_ufix16_En6 0 0 0 1023.984375 ECU_ADDRESS 0x40008110 /* @ECU_Address@fdstmsrv_fSysFltBattChgPwrLmt_kW@ */ /end MEASUREMENT
/begin MEASUREMENT fdstmsrv_fCanFltBattChgPwrLmt_kW "" UWORD xjmain_CM_ufix16_En6 0 0 0 1023.984375 ECU_ADDRESS 0x40008108 /* @ECU_Address@fdstmsrv_fCanFltBattChgPwrLmt_kW@ */ /end MEASUREMENT
/begin MEASUREMENT fdstmsrv_fSysFltBattDisChgPwrLmt_kW "" UWORD xjmain_CM_ufix16_En6 0 0 0 1023.984375 ECU_ADDRESS 0x40008112 /* @ECU_Address@fdstmsrv_fSysFltBattDisChgPwrLmt_kW@ */ /end MEASUREMENT
/begin MEASUREMENT fdstmsrv_fCanFltBattDisChgPwrLmt_kW "" UWORD xjmain_CM_ufix16_En6 0 0 0 1023.984375 ECU_ADDRESS 0x4000810a /* @ECU_Address@fdstmsrv_fCanFltBattDisChgPwrLmt_kW@ */ /end MEASUREMENT
/begin MEASUREMENT mmctmsrv_fDmcuTrqReq "" SWORD xjmain_CM_sfix16_En2 0 0 -8192.0 8191.75 ECU_ADDRESS 0x40008220 /* @ECU_Address@mmctmsrv_fDmcuTrqReq@ */ /end MEASUREMENT
/begin MEASUREMENT tftamsrv_fDmcuTrqReqBeforeLmt "" SWORD xjmain_CM_sfix16_En2 0 0 -8192.0 8191.75 ECU_ADDRESS 0x40008256 /* @ECU_Address@tftamsrv_fDmcuTrqReqBeforeLmt@ */ /end MEASUREMENT
/begin MEASUREMENT tftamsrv_fDmcuTrqReq "" SWORD xjmain_CM_sfix16_En2 0 0 -8192.0 8191.75 ECU_ADDRESS 0x40008254 /* @ECU_Address@tftamsrv_fDmcuTrqReq@ */ /end MEASUREMENT
/begin MEASUREMENT apddmsrv_fDmotFwdTrqReq "" SWORD xjmain_CM_sfix16_En2 0 0 -8192.0 8191.75 ECU_ADDRESS 0x40008022 /* @ECU_Address@apddmsrv_fDmotFwdTrqReq@ */ /end MEASUREMENT
/begin MEASUREMENT apddmsrv_fDmotBwdTrqReq "" SWORD xjmain_CM_sfix16_En2 0 0 -8192.0 8191.75 ECU_ADDRESS 0x4000801e /* @ECU_Address@apddmsrv_fDmotBwdTrqReq@ */ /end MEASUREMENT
/begin MEASUREMENT fdstmsrv_fSysFltDmcuDrTrqLmt "" SWORD xjmain_CM_sfix16_En2 0 0 -8192.0 8191.75 ECU_ADDRESS 0x40008116 /* @ECU_Address@fdstmsrv_fSysFltDmcuDrTrqLmt@ */ /end MEASUREMENT
/begin MEASUREMENT fdstmsrv_fSysFltDmcuBrTrqLmt "" SWORD xjmain_CM_sfix16_En2 0 0 -8192.0 8191.75 ECU_ADDRESS 0x40008114 /* @ECU_Address@fdstmsrv_fSysFltDmcuBrTrqLmt@ */ /end MEASUREMENT
/begin MEASUREMENT fdstmsrv_fCanFltDmcuBrTrqLmt "" SWORD xjmain_CM_sfix16_En2 0 0 -8192.0 8191.75 ECU_ADDRESS 0x4000810c /* @ECU_Address@fdstmsrv_fCanFltDmcuBrTrqLmt@ */ /end MEASUREMENT
/begin MEASUREMENT fdstmsrv_fCanFltDmcuDrTrqLmt "" SWORD xjmain_CM_sfix16_En2 0 0 -8192.0 8191.75 ECU_ADDRESS 0x4000810e /* @ECU_Address@fdstmsrv_fCanFltDmcuDrTrqLmt@ */ /end MEASUREMENT
/begin MEASUREMENT hldmsr_P2V_u8PmcuPreRlySts "" UBYTE xjmain_CM_uint8 0 0 0 255 ECU_ADDRESS 0x400081a2 /* @ECU_Address@hldmsr_P2V_u8PmcuPreRlySts@ */ /end MEASUREMENT
/begin MEASUREMENT hldmsr_P2V_u8PmcuRlySts "" UBYTE xjmain_CM_uint8 0 0 0 255 ECU_ADDRESS 0x400081a3 /* @ECU_Address@hldmsr_P2V_u8PmcuRlySts@ */ /end MEASUREMENT
/begin MEASUREMENT hldmsr_P2V_u8DmcuPreRlySts "" UBYTE xjmain_CM_uint8 0 0 0 255 ECU_ADDRESS 0x4000819f /* @ECU_Address@hldmsr_P2V_u8DmcuPreRlySts@ */ /end MEASUREMENT
/begin MEASUREMENT hldmsr_P2V_u8DmcuRlySts "" UBYTE xjmain_CM_uint8 0 0 0 255 ECU_ADDRESS 0x400081a0 /* @ECU_Address@hldmsr_P2V_u8DmcuRlySts@ */ /end MEASUREMENT
/begin MEASUREMENT hldmsr_P2V_u8ObcRlySts "" UBYTE xjmain_CM_uint8 0 0 0 255 ECU_ADDRESS 0x400081a1 /* @ECU_Address@hldmsr_P2V_u8ObcRlySts@ */ /end MEASUREMENT
/begin MEASUREMENT hldmsr_P2V_u8DcacRlySts "" UBYTE xjmain_CM_uint8 0 0 0 255 ECU_ADDRESS 0x4000819b /* @ECU_Address@hldmsr_P2V_u8DcacRlySts@ */ /end MEASUREMENT
/begin MEASUREMENT hldmsr_P2V_u8DcdcRlySts "" UBYTE xjmain_CM_uint8 0 0 0 255 ECU_ADDRESS 0x4000819e /* @ECU_Address@hldmsr_P2V_u8DcdcRlySts@ */ /end MEASUREMENT
/begin MEASUREMENT hldmsr_P2V_u8DcacFltLvl "" UBYTE xjmain_CM_uint8 0 0 0 255 ECU_ADDRESS 0x4000819a /* @ECU_Address@hldmsr_P2V_u8DcacFltLvl@ */ /end MEASUREMENT
/begin MEASUREMENT hldmsr_P2V_u8DcdcFltLvl "" UBYTE xjmain_CM_uint8 0 0 0 255 ECU_ADDRESS 0x4000819d /* @ECU_Address@hldmsr_P2V_u8DcdcFltLvl@ */ /end MEASUREMENT
/begin MEASUREMENT incc_WindLevel "" UBYTE xjmain_CM_uint8 0 0 0 255 ECU_ADDRESS 0x40008211 /* @ECU_Address@incc_WindLevel@ */ /end MEASUREMENT
/begin MEASUREMENT incc_VehMsg_VehRunsts "" UBYTE xjmain_CM_uint8 0 0 0 255 ECU_ADDRESS 0x4000820f /* @ECU_Address@incc_VehMsg_VehRunsts@ */ /end MEASUREMENT
/begin MEASUREMENT incc_VehMsg_VehMd "" UBYTE xjmain_CM_uint8 0 0 0 255 ECU_ADDRESS 0x4000820e /* @ECU_Address@incc_VehMsg_VehMd@ */ /end MEASUREMENT
/begin MEASUREMENT incc_Ready_flg "" UBYTE xjmain_CM_uint8 0 0 0 255 ECU_ADDRESS 0x40008209 /* @ECU_Address@incc_Ready_flg@ */ /end MEASUREMENT
/begin MEASUREMENT fdstmsrv_u8BattSysFltLvl "" UBYTE xjmain_CM_uint8 0 0 0 255 ECU_ADDRESS 0x4000811f /* @ECU_Address@fdstmsrv_u8BattSysFltLvl@ */ /end MEASUREMENT
/begin MEASUREMENT fdstmsrv_u8PduSysFltLvl "" UBYTE xjmain_CM_uint8 0 0 0 255 ECU_ADDRESS 0x40008125 /* @ECU_Address@fdstmsrv_u8PduSysFltLvl@ */ /end MEASUREMENT
/begin MEASUREMENT fdstmsrv_u8DmcuSysFltLvl "" UBYTE xjmain_CM_uint8 0 0 0 255 ECU_ADDRESS 0x40008121 /* @ECU_Address@fdstmsrv_u8DmcuSysFltLvl@ */ /end MEASUREMENT
/begin MEASUREMENT fdstmsrv_u8GearSysFltLvl "" UBYTE xjmain_CM_uint8 0 0 0 255 ECU_ADDRESS 0x40008123 /* @ECU_Address@fdstmsrv_u8GearSysFltLvl@ */ /end MEASUREMENT
/begin MEASUREMENT fdstmsrv_u8PmcuSysFltLvl "" UBYTE xjmain_CM_uint8 0 0 0 255 ECU_ADDRESS 0x40008127 /* @ECU_Address@fdstmsrv_u8PmcuSysFltLvl@ */ /end MEASUREMENT
/begin MEASUREMENT fdstmsrv_u8BattCanFltLvl "" UBYTE xjmain_CM_uint8 0 0 0 255 ECU_ADDRESS 0x4000811e /* @ECU_Address@fdstmsrv_u8BattCanFltLvl@ */ /end MEASUREMENT
/begin MEASUREMENT fdstmsrv_u8DmcuCanFltLvl "" UBYTE xjmain_CM_uint8 0 0 0 255 ECU_ADDRESS 0x40008120 /* @ECU_Address@fdstmsrv_u8DmcuCanFltLvl@ */ /end MEASUREMENT
/begin MEASUREMENT fdstmsrv_u8PmcuCanFltLvl "" UBYTE xjmain_CM_uint8 0 0 0 255 ECU_ADDRESS 0x40008126 /* @ECU_Address@fdstmsrv_u8PmcuCanFltLvl@ */ /end MEASUREMENT
/begin MEASUREMENT fdstmsrv_u8PduCanFltLvl "" UBYTE xjmain_CM_uint8 0 0 0 255 ECU_ADDRESS 0x40008124 /* @ECU_Address@fdstmsrv_u8PduCanFltLvl@ */ /end MEASUREMENT
/begin MEASUREMENT fdstmsrv_u8GearCanFltLvl "" UBYTE xjmain_CM_uint8 0 0 0 255 ECU_ADDRESS 0x40008122 /* @ECU_Address@fdstmsrv_u8GearCanFltLvl@ */ /end MEASUREMENT
/begin MEASUREMENT hldmsr_DI_Kl15 "" UBYTE xjmain_CM_boolean 0 0 0 1 ECU_ADDRESS 0x40008180 /* @ECU_Address@hldmsr_DI_Kl15@ */ /end MEASUREMENT
/begin MEASUREMENT PwrM_flgKeyOnDelay "" UBYTE xjmain_CM_boolean 0 0 0 1 ECU_ADDRESS 0x40008000 /* @ECU_Address@PwrM_flgKeyOnDelay@ */ /end MEASUREMENT
/begin MEASUREMENT PwrM_flgKeyOnRaw "" UBYTE xjmain_CM_boolean 0 0 0 1 ECU_ADDRESS 0x40008001 /* @ECU_Address@PwrM_flgKeyOnRaw@ */ /end MEASUREMENT
/begin MEASUREMENT incc_AppValid_flg "" UBYTE xjmain_CM_boolean 0 0 0 1 ECU_ADDRESS 0x400081e3 /* @ECU_Address@incc_AppValid_flg@ */ /end MEASUREMENT
/begin MEASUREMENT incc_WeightSigValid_flg "" UBYTE xjmain_CM_boolean 0 0 0 1 ECU_ADDRESS 0x40008210 /* @ECU_Address@incc_WeightSigValid_flg@ */ /end MEASUREMENT
/begin MEASUREMENT incc_WindSigValid_flg "" UBYTE xjmain_CM_boolean 0 0 0 1 ECU_ADDRESS 0x40008212 /* @ECU_Address@incc_WindSigValid_flg@ */ /end MEASUREMENT
/begin MEASUREMENT incc_VCUFault_flg "" UBYTE xjmain_CM_boolean 0 0 0 1 ECU_ADDRESS 0x4000820d /* @ECU_Address@incc_VCUFault_flg@ */ /end MEASUREMENT
/begin MEASUREMENT incc_DMCUCANFlt_flg "" UBYTE xjmain_CM_boolean 0 0 0 1 ECU_ADDRESS 0x400081e5 /* @ECU_Address@incc_DMCUCANFlt_flg@ */ /end MEASUREMENT
/begin MEASUREMENT incc_PMCUCANFlt_flg "" UBYTE xjmain_CM_boolean 0 0 0 1 ECU_ADDRESS 0x40008208 /* @ECU_Address@incc_PMCUCANFlt_flg@ */ /end MEASUREMENT
/begin MEASUREMENT incc_BMSCANFlt_flg "" UBYTE xjmain_CM_boolean 0 0 0 1 ECU_ADDRESS 0x400081e4 /* @ECU_Address@incc_BMSCANFlt_flg@ */ /end MEASUREMENT
/begin MEASUREMENT fdstmsrv_isSysFltBattHVEn "" UBYTE xjmain_CM_boolean 0 0 0 1 ECU_ADDRESS 0x4000811b /* @ECU_Address@fdstmsrv_isSysFltBattHVEn@ */ /end MEASUREMENT
/begin MEASUREMENT fdstmsrv_isSysFltDmcuEn "" UBYTE xjmain_CM_boolean 0 0 0 1 ECU_ADDRESS 0x4000811c /* @ECU_Address@fdstmsrv_isSysFltDmcuEn@ */ /end MEASUREMENT
/begin MEASUREMENT fdstmsrv_isCanFltBattHVEn "" UBYTE xjmain_CM_boolean 0 0 0 1 ECU_ADDRESS 0x40008118 /* @ECU_Address@fdstmsrv_isCanFltBattHVEn@ */ /end MEASUREMENT
/begin MEASUREMENT fdstmsrv_isCanFltDmcuEn "" UBYTE xjmain_CM_boolean 0 0 0 1 ECU_ADDRESS 0x40008119 /* @ECU_Address@fdstmsrv_isCanFltDmcuEn@ */ /end MEASUREMENT
/begin MEASUREMENT fdstmsrv_isCanFltPmcuEn "" UBYTE xjmain_CM_boolean 0 0 0 1 ECU_ADDRESS 0x4000811a /* @ECU_Address@fdstmsrv_isCanFltPmcuEn@ */ /end MEASUREMENT
/begin MEASUREMENT fdstmsrv_isSysFltPmcuEn "" UBYTE xjmain_CM_boolean 0 0 0 1 ECU_ADDRESS 0x4000811d /* @ECU_Address@fdstmsrv_isSysFltPmcuEn@ */ /end MEASUREMENT
/begin MEASUREMENT incc_Engine_TotalHours "" ULONG xjmain_CM_uint32 0 0 0 3.0 ECU_ADDRESS 0x400081f8 /* @ECU_Address@incc_Engine_TotalHours@ */ /end MEASUREMENT
/begin MEASUREMENT incc_Engine_TotalFuel_Used "" ULONG xjmain_CM_ufix32_En1 0 0 0 3.0 ECU_ADDRESS 0x400081f4 /* @ECU_Address@incc_Engine_TotalFuel_Used@ */ /end MEASUREMENT
/begin MEASUREMENT coptmsr_V2T_i16DmcuSpdReq "" UWORD xjmain_CM_uint16 0 0 0 65535 ECU_ADDRESS 0x400080d8 /* @ECU_Address@coptmsr_V2T_i16DmcuSpdReq@ */ /end MEASUREMENT
/begin MEASUREMENT coptmsr_V2T_i16PmcuSpdReq "" UWORD xjmain_CM_uint16 0 0 0 65535 ECU_ADDRESS 0x400080da /* @ECU_Address@coptmsr_V2T_i16PmcuSpdReq@ */ /end MEASUREMENT
/begin MEASUREMENT incc_Engine_Oil_Pressure "" UWORD xjmain_CM_uint16 0 0 0 3.0 ECU_ADDRESS 0x400081ec /* @ECU_Address@incc_Engine_Oil_Pressure@ */ /end MEASUREMENT
/begin MEASUREMENT incc_Engine_Speed "" UWORD xjmain_CM_uint16 0 0 0 3.0 ECU_ADDRESS 0x400081f0 /* @ECU_Address@incc_Engine_Speed@ */ /end MEASUREMENT
/begin MEASUREMENT coptmsr_V2I_fHoistSpd "" UWORD xjmain_CM_ufix16_Sp1 0 0 0 6553.5 ECU_ADDRESS 0x400080b4 /* @ECU_Address@coptmsr_V2I_fHoistSpd@ */ /end MEASUREMENT
/begin MEASUREMENT coptmsr_V2O_fChgVoltSet "" UWORD xjmain_CM_ufix16_En4 0 0 0 4095.9375 ECU_ADDRESS 0x400080c4 /* @ECU_Address@coptmsr_V2O_fChgVoltSet@ */ /end MEASUREMENT
/begin MEASUREMENT coptmsr_V2O_fChgCurrSet "" UWORD xjmain_CM_ufix16_En2 0 0 0 16383.75 ECU_ADDRESS 0x400080c2 /* @ECU_Address@coptmsr_V2O_fChgCurrSet@ */ /end MEASUREMENT
/begin MEASUREMENT coptmsr_V2T_fDmcuTrqReq "" SWORD xjmain_CM_sfix16_En2 0 0 -8192.0 8191.75 ECU_ADDRESS 0x400080d2 /* @ECU_Address@coptmsr_V2T_fDmcuTrqReq@ */ /end MEASUREMENT
/begin MEASUREMENT coptmsr_V2T_fPmcuTrqReq "" SWORD xjmain_CM_sfix16_En2 0 0 -8192.0 8191.75 ECU_ADDRESS 0x400080d4 /* @ECU_Address@coptmsr_V2T_fPmcuTrqReq@ */ /end MEASUREMENT
/begin MEASUREMENT incc_Engine_Coolant_Temp "" SWORD xjmain_CM_int16 0 0 -32768 32767 ECU_ADDRESS 0x400081e6 /* @ECU_Address@incc_Engine_Coolant_Temp@ */ /end MEASUREMENT
/begin MEASUREMENT incc_Engine_Oil_Temp "" SWORD xjmain_CM_int16 0 0 -32768 3.0 ECU_ADDRESS 0x400081ee /* @ECU_Address@incc_Engine_Oil_Temp@ */ /end MEASUREMENT
/begin MEASUREMENT coptmsr_V2T_u8DmcuLifeSig "" UBYTE xjmain_CM_uint8 0 0 0 255 ECU_ADDRESS 0x400080e1 /* @ECU_Address@coptmsr_V2T_u8DmcuLifeSig@ */ /end MEASUREMENT
/begin MEASUREMENT coptmsr_V2T_u8DmcuRunModeReq "" UBYTE xjmain_CM_uint8 0 0 0 255 ECU_ADDRESS 0x400080e2 /* @ECU_Address@coptmsr_V2T_u8DmcuRunModeReq@ */ /end MEASUREMENT
/begin MEASUREMENT coptmsr_V2T_u8PmcuLifeSig "" UBYTE xjmain_CM_uint8 0 0 0 255 ECU_ADDRESS 0x400080e3 /* @ECU_Address@coptmsr_V2T_u8PmcuLifeSig@ */ /end MEASUREMENT
/begin MEASUREMENT coptmsr_V2B_u8BattConn "" UBYTE xjmain_CM_uint8 0 0 0 255 ECU_ADDRESS 0x400080b1 /* @ECU_Address@coptmsr_V2B_u8BattConn@ */ /end MEASUREMENT
/begin MEASUREMENT coptmsr_V2B_u8BattLifeSig "" UBYTE xjmain_CM_uint8 0 0 0 255 ECU_ADDRESS 0x400080b2 /* @ECU_Address@coptmsr_V2B_u8BattLifeSig@ */ /end MEASUREMENT
/begin MEASUREMENT coptmsr_V2I_u8InccLifeSig "" UBYTE xjmain_CM_uint8 0 0 0 255 ECU_ADDRESS 0x400080bd /* @ECU_Address@coptmsr_V2I_u8InccLifeSig@ */ /end MEASUREMENT
/begin MEASUREMENT coptmsr_V2T_u8PmcuRunModeReq "" UBYTE xjmain_CM_uint8 0 0 0 255 ECU_ADDRESS 0x400080e4 /* @ECU_Address@coptmsr_V2T_u8PmcuRunModeReq@ */ /end MEASUREMENT
/begin MEASUREMENT coptmsr_V2O_u8ChgStartStop "" UBYTE xjmain_CM_uint8 0 0 0 255 ECU_ADDRESS 0x400080c6 /* @ECU_Address@coptmsr_V2O_u8ChgStartStop@ */ /end MEASUREMENT
/begin MEASUREMENT coptmsr_V2B_u8BattChgMode "" UBYTE xjmain_CM_uint8 0 0 0 255 ECU_ADDRESS 0x400080b0 /* @ECU_Address@coptmsr_V2B_u8BattChgMode@ */ /end MEASUREMENT
/begin MEASUREMENT coptmsr_V2I_u8ReadySts "" UBYTE xjmain_CM_uint8 0 0 0 255 ECU_ADDRESS 0x400080be /* @ECU_Address@coptmsr_V2I_u8ReadySts@ */ /end MEASUREMENT
/begin MEASUREMENT coptmsr_V2I_u8WindLvl "" UBYTE xjmain_CM_uint8 0 0 0 255 ECU_ADDRESS 0x400080c1 /* @ECU_Address@coptmsr_V2I_u8WindLvl@ */ /end MEASUREMENT
/begin MEASUREMENT coptmsr_V2I_u8VehRunSts "" UBYTE xjmain_CM_uint8 0 0 0 255 ECU_ADDRESS 0x400080c0 /* @ECU_Address@coptmsr_V2I_u8VehRunSts@ */ /end MEASUREMENT
/begin MEASUREMENT coptmsr_V2I_u8VehChgSts "" UBYTE xjmain_CM_uint8 0 0 0 255 ECU_ADDRESS 0x400080bf /* @ECU_Address@coptmsr_V2I_u8VehChgSts@ */ /end MEASUREMENT
/begin MEASUREMENT incc_Engine_Load_Percent "" UBYTE xjmain_CM_uint8 0 0 0 3.0 ECU_ADDRESS 0x400081ea /* @ECU_Address@incc_Engine_Load_Percent@ */ /end MEASUREMENT
/begin MEASUREMENT incc_SPN_LeastBits "" UBYTE xjmain_CM_uint8 0 0 0 3.0 ECU_ADDRESS 0x4000820a /* @ECU_Address@incc_SPN_LeastBits@ */ /end MEASUREMENT
/begin MEASUREMENT incc_SPN_SecondBits "" UBYTE xjmain_CM_uint8 0 0 0 3.0 ECU_ADDRESS 0x4000820c /* @ECU_Address@incc_SPN_SecondBits@ */ /end MEASUREMENT
/begin MEASUREMENT incc_Engine_FMI "" UBYTE xjmain_CM_uint8 0 0 0 3.0 ECU_ADDRESS 0x400081e8 /* @ECU_Address@incc_Engine_FMI@ */ /end MEASUREMENT
/begin MEASUREMENT incc_SPN_MostBits "" UBYTE xjmain_CM_uint8 0 0 0 3.0 ECU_ADDRESS 0x4000820b /* @ECU_Address@incc_SPN_MostBits@ */ /end MEASUREMENT
/begin MEASUREMENT coptmsr_V2T_i8GearPos "" SBYTE xjmain_CM_int8 0 0 -128 127 ECU_ADDRESS 0x400080dc /* @ECU_Address@coptmsr_V2T_i8GearPos@ */ /end MEASUREMENT
/begin MEASUREMENT incc_Engine_Gear "" SBYTE xjmain_CM_int8 0 0 -128 3.0 ECU_ADDRESS 0x400081e9 /* @ECU_Address@incc_Engine_Gear@ */ /end MEASUREMENT
/begin MEASUREMENT coptmsr_V2T_isDmcuEn "" UBYTE xjmain_CM_boolean 0 0 0 1 ECU_ADDRESS 0x400080de /* @ECU_Address@coptmsr_V2T_isDmcuEn@ */ /end MEASUREMENT
/begin MEASUREMENT coptmsr_V2T_isDmcuDisChg "" UBYTE xjmain_CM_boolean 0 0 0 1 ECU_ADDRESS 0x400080dd /* @ECU_Address@coptmsr_V2T_isDmcuDisChg@ */ /end MEASUREMENT
/begin MEASUREMENT coptmsr_V2T_isPmcuEn "" UBYTE xjmain_CM_boolean 0 0 0 1 ECU_ADDRESS 0x400080e0 /* @ECU_Address@coptmsr_V2T_isPmcuEn@ */ /end MEASUREMENT
/begin MEASUREMENT coptmsr_V2T_isPmcuDisChg "" UBYTE xjmain_CM_boolean 0 0 0 1 ECU_ADDRESS 0x400080df /* @ECU_Address@coptmsr_V2T_isPmcuDisChg@ */ /end MEASUREMENT
/begin MEASUREMENT coptmsr_V2P_isDmcuConn "" UBYTE xjmain_CM_boolean 0 0 0 1 ECU_ADDRESS 0x400080cb /* @ECU_Address@coptmsr_V2P_isDmcuConn@ */ /end MEASUREMENT
/begin MEASUREMENT coptmsr_V2P_isDcdcDcacConn "" UBYTE xjmain_CM_boolean 0 0 0 1 ECU_ADDRESS 0x400080c9 /* @ECU_Address@coptmsr_V2P_isDcdcDcacConn@ */ /end MEASUREMENT
/begin MEASUREMENT coptmsr_V2P_isObcConn "" UBYTE xjmain_CM_boolean 0 0 0 1 ECU_ADDRESS 0x400080cd /* @ECU_Address@coptmsr_V2P_isObcConn@ */ /end MEASUREMENT
/begin MEASUREMENT coptmsr_V2P_isDmcuPreConn "" UBYTE xjmain_CM_boolean 0 0 0 1 ECU_ADDRESS 0x400080cc /* @ECU_Address@coptmsr_V2P_isDmcuPreConn@ */ /end MEASUREMENT
/begin MEASUREMENT coptmsr_V2P_isPmcuPreConn "" UBYTE xjmain_CM_boolean 0 0 0 1 ECU_ADDRESS 0x400080cf /* @ECU_Address@coptmsr_V2P_isPmcuPreConn@ */ /end MEASUREMENT
/begin MEASUREMENT coptmsr_V2P_isPmcuConn "" UBYTE xjmain_CM_boolean 0 0 0 1 ECU_ADDRESS 0x400080ce /* @ECU_Address@coptmsr_V2P_isPmcuConn@ */ /end MEASUREMENT
/begin MEASUREMENT coptmsr_V2P_isDcdcRun "" UBYTE xjmain_CM_boolean 0 0 0 1 ECU_ADDRESS 0x400080ca /* @ECU_Address@coptmsr_V2P_isDcdcRun@ */ /end MEASUREMENT
/begin MEASUREMENT coptmsr_V2P_isDcacRun "" UBYTE xjmain_CM_boolean 0 0 0 1 ECU_ADDRESS 0x400080c8 /* @ECU_Address@coptmsr_V2P_isDcacRun@ */ /end MEASUREMENT
/begin MEASUREMENT coptmsr_V2B_isChgAllow "" UBYTE xjmain_CM_boolean 0 0 0 1 ECU_ADDRESS 0x400080af /* @ECU_Address@coptmsr_V2B_isChgAllow@ */ /end MEASUREMENT
/begin MEASUREMENT coptmsr_V2I_isApFlt "" UBYTE xjmain_CM_boolean 0 0 0 1 ECU_ADDRESS 0x400080b6 /* @ECU_Address@coptmsr_V2I_isApFlt@ */ /end MEASUREMENT
/begin MEASUREMENT coptmsr_V2I_isWindSpdFlt "" UBYTE xjmain_CM_boolean 0 0 0 1 ECU_ADDRESS 0x400080bc /* @ECU_Address@coptmsr_V2I_isWindSpdFlt@ */ /end MEASUREMENT
/begin MEASUREMENT coptmsr_V2I_isHWFlt "" UBYTE xjmain_CM_boolean 0 0 0 1 ECU_ADDRESS 0x400080b9 /* @ECU_Address@coptmsr_V2I_isHWFlt@ */ /end MEASUREMENT
/begin MEASUREMENT coptmsr_V2I_isDmcuCanFltRc "" UBYTE xjmain_CM_boolean 0 0 0 1 ECU_ADDRESS 0x400080b8 /* @ECU_Address@coptmsr_V2I_isDmcuCanFltRc@ */ /end MEASUREMENT
/begin MEASUREMENT coptmsr_V2I_isBattCanFltRc "" UBYTE xjmain_CM_boolean 0 0 0 1 ECU_ADDRESS 0x400080b7 /* @ECU_Address@coptmsr_V2I_isBattCanFltRc@ */ /end MEASUREMENT
/begin MEASUREMENT coptmsr_V2I_isPmcuCanFltRc "" UBYTE xjmain_CM_boolean 0 0 0 1 ECU_ADDRESS 0x400080ba /* @ECU_Address@coptmsr_V2I_isPmcuCanFltRc@ */ /end MEASUREMENT
/begin MEASUREMENT coptmsr_V2I_isVehFlt "" UBYTE xjmain_CM_boolean 0 0 0 1 ECU_ADDRESS 0x400080bb /* @ECU_Address@coptmsr_V2I_isVehFlt@ */ /end MEASUREMENT
/begin MEASUREMENT obcmsrv_fMotPwrAct_kW "" SLONG xjmain_CM_sfix32_En2 0 0 -5.36870912E+8 5.3687091175E+8 ECU_ADDRESS 0x4000822c /* @ECU_Address@obcmsrv_fMotPwrAct_kW@ */ /end MEASUREMENT
/begin MEASUREMENT obcmsrv_isNoFlt "" UBYTE xjmain_CM_boolean 0 0 0 1 ECU_ADDRESS 0x40008230 /* @ECU_Address@obcmsrv_isNoFlt@ */ /end MEASUREMENT
/begin MEASUREMENT ciptmsr_T2V_u8DmcuCanFltLvl "" UBYTE xjmain_CM_uint8 0 0 0 255 ECU_ADDRESS 0x400080a6 /* @ECU_Address@ciptmsr_T2V_u8DmcuCanFltLvl@ */ /end MEASUREMENT
/begin MEASUREMENT ciptmsr_T2V_u8PmcuCanFltLvl "" UBYTE xjmain_CM_uint8 0 0 0 255 ECU_ADDRESS 0x400080ab /* @ECU_Address@ciptmsr_T2V_u8PmcuCanFltLvl@ */ /end MEASUREMENT
/begin MEASUREMENT ciptmsr_B2V_u8BattCanFltLvl "" UBYTE xjmain_CM_uint8 0 0 0 255 ECU_ADDRESS 0x40008050 /* @ECU_Address@ciptmsr_B2V_u8BattCanFltLvl@ */ /end MEASUREMENT
/begin COMPU_METHOD xjmain_CM_ufix16_En8_none "Q = V*256.000000" RAT_FUNC "%11.8" "none" COEFFS 0 256.000000 0.000000 0 0 1.000000 /end COMPU_METHOD
/begin COMPU_METHOD xjmain_CM_ufix16_En9_percent_ "Q = V*512.000000" RAT_FUNC "%12.9" "%" COEFFS 0 512.000000 0.000000 0 0 1.000000 /end COMPU_METHOD
/begin COMPU_METHOD xjmain_CM_int16_rpm "Q = V" RAT_FUNC "%5.0" "rpm" COEFFS 0 1 0 0 0 1 /end COMPU_METHOD
/begin COMPU_METHOD xjmain_CM_ufix16_En9 "Q = V*512.000000" RAT_FUNC "%12.9" "" COEFFS 0 512.000000 0.000000 0 0 1.000000 /end COMPU_METHOD
/begin COMPU_METHOD xjmain_CM_int16 "Q = V" RAT_FUNC "%5.0" "" COEFFS 0 1 0 0 0 1 /end COMPU_METHOD
/begin COMPU_METHOD xjmain_CM_uint32 "Q = V" RAT_FUNC "%10.0" "" COEFFS 0 1 0 0 0 1 /end COMPU_METHOD
/begin COMPU_METHOD xjmain_CM_sfix16_En13_V "Q = V*8192.000000" RAT_FUNC "%14.13" "V" COEFFS 0 8192.000000 0.000000 0 0 1.000000 /end COMPU_METHOD
/begin COMPU_METHOD xjmain_CM_sfix16_En2_Nm "Q = V*4.000000" RAT_FUNC "%7.2" "Nm" COEFFS 0 4.000000 0.000000 0 0 1.000000 /end COMPU_METHOD
/begin COMPU_METHOD xjmain_CM_sfix16_En2 "Q = V*4.000000" RAT_FUNC "%7.2" "" COEFFS 0 4.000000 0.000000 0 0 1.000000 /end COMPU_METHOD
/begin COMPU_METHOD xjmain_CM_sfix16_En3 "Q = V*8.000000" RAT_FUNC "%7.3" "" COEFFS 0 8.000000 0.000000 0 0 1.000000 /end COMPU_METHOD
/begin COMPU_METHOD xjmain_CM_ufix16_En13_V "Q = V*8192.000000" RAT_FUNC "%14.13" "V" COEFFS 0 8192.000000 0.000000 0 0 1.000000 /end COMPU_METHOD
/begin COMPU_METHOD xjmain_CM_ufix16_En14 "Q = V*16384.000000" RAT_FUNC "%15.14" "" COEFFS 0 16384.000000 0.000000 0 0 1.000000 /end COMPU_METHOD
/begin COMPU_METHOD xjmain_CM_ufix16_En2_A "Q = V*4.000000" RAT_FUNC "%7.2" "A" COEFFS 0 4.000000 0.000000 0 0 1.000000 /end COMPU_METHOD
/begin COMPU_METHOD xjmain_CM_ufix16_En2 "Q = V*4.000000" RAT_FUNC "%7.2" "" COEFFS 0 4.000000 0.000000 0 0 1.000000 /end COMPU_METHOD
/begin COMPU_METHOD xjmain_CM_ufix16_En4 "Q = V*16.000000" RAT_FUNC "%8.4" "" COEFFS 0 16.000000 0.000000 0 0 1.000000 /end COMPU_METHOD
/begin COMPU_METHOD xjmain_CM_ufix16_En6_V "Q = V*64.000000" RAT_FUNC "%10.6" "V" COEFFS 0 64.000000 0.000000 0 0 1.000000 /end COMPU_METHOD
/begin COMPU_METHOD xjmain_CM_ufix16_En6 "Q = V*64.000000" RAT_FUNC "%10.6" "" COEFFS 0 64.000000 0.000000 0 0 1.000000 /end COMPU_METHOD
/begin COMPU_METHOD xjmain_CM_ufix16_En8 "Q = V*256.000000" RAT_FUNC "%11.8" "" COEFFS 0 256.000000 0.000000 0 0 1.000000 /end COMPU_METHOD
/begin COMPU_METHOD xjmain_CM_ufix16_Sp1 "Q = V*10.000000" RAT_FUNC "%5.1" "" COEFFS 0 10.000000 0.000000 0 0 1.000000 /end COMPU_METHOD
/begin COMPU_METHOD xjmain_CM_uint16 "Q = V" RAT_FUNC "%5.0" "" COEFFS 0 1 0 0 0 1 /end COMPU_METHOD
/begin COMPU_METHOD xjmain_CM_uint16_rpm "Q = V" RAT_FUNC "%5.0" "rpm" COEFFS 0 1 0 0 0 1 /end COMPU_METHOD
/begin COMPU_METHOD xjmain_CM_uint16_ms "Q = V" RAT_FUNC "%5.0" "ms" COEFFS 0 1 0 0 0 1 /end COMPU_METHOD
/begin COMPU_METHOD xjmain_CM_boolean_none "Q = V" RAT_FUNC "%1.0" "none" COEFFS 0 1 0 0 0 1 /end COMPU_METHOD
/begin COMPU_METHOD xjmain_CM_boolean "Q = V" RAT_FUNC "%1.0" "" COEFFS 0 1 0 0 0 1 /end COMPU_METHOD
/begin COMPU_METHOD xjmain_CM_int8 "Q = V" RAT_FUNC "%3.0" "" COEFFS 0 1 0 0 0 1 /end COMPU_METHOD
/begin COMPU_METHOD xjmain_CM_int8_enum "Q = V" RAT_FUNC "%3.0" "enum" COEFFS 0 1 0 0 0 1 /end COMPU_METHOD
/begin COMPU_METHOD xjmain_CM_int8_Nm "Q = V" RAT_FUNC "%3.0" "Nm" COEFFS 0 1 0 0 0 1 /end COMPU_METHOD
/begin COMPU_METHOD xjmain_CM_uint8 "Q = V" RAT_FUNC "%3.0" "" COEFFS 0 1 0 0 0 1 /end COMPU_METHOD
/begin COMPU_METHOD xjmain_CM_uint8_none "Q = V" RAT_FUNC "%3.0" "none" COEFFS 0 1 0 0 0 1 /end COMPU_METHOD
/begin COMPU_METHOD xjmain_CM_uint8_enum "Q = V" RAT_FUNC "%3.0" "enum" COEFFS 0 1 0 0 0 1 /end COMPU_METHOD
/begin COMPU_METHOD xjmain_CM_single "Q = V" RAT_FUNC "%8.6" "" COEFFS 0 1 0 0 0 1 /end COMPU_METHOD
/begin COMPU_METHOD xjmain_CM_sfix32_En4 "Q = V*16.000000" RAT_FUNC "%13.4" "" COEFFS 0 16.000000 0.000000 0 0 1.000000 /end COMPU_METHOD
/begin COMPU_METHOD xjmain_CM_ufix16_Sp001 "Q = V*1000.000000" RAT_FUNC "%5.3" "" COEFFS 0 1000.000000 0.000000 0 0 1.000000 /end COMPU_METHOD
/begin COMPU_METHOD xjmain_CM_ufix32_En1 "Q = V*2.000000" RAT_FUNC "%11.1" "" COEFFS 0 2.000000 0.000000 0 0 1.000000 /end COMPU_METHOD
/begin COMPU_METHOD xjmain_CM_sfix32_En2 "Q = V*4.000000" RAT_FUNC "%12.2" "" COEFFS 0 4.000000 0.000000 0 0 1.000000 /end COMPU_METHOD
/begin GROUP S22_AirPSig2Diagnosis_fault "xjmain/GOTO/aipt_calibration/AirPSig2Diagnosis_fault" /begin SUB_GROUP S40_diagnosis_fault /end SUB_GROUP /end GROUP
/begin GROUP S22_AirPSig2_pct_conversion "xjmain/GOTO/aipt_calibration/AirPSig2_pct_conversion" /begin REF_CHARACTERISTIC aiptc_adc2phy_SkylightPress_Ratio /end REF_CHARACTERISTIC /end GROUP
/begin GROUP S22_AirPSigDiagnosis_fault "xjmain/GOTO/aipt_calibration/AirPSigDiagnosis_fault" /begin SUB_GROUP S42_diagnosis_fault /end SUB_GROUP /end GROUP
/begin GROUP S22_AirPSig_pct_conversion "xjmain/GOTO/aipt_calibration/AirPSig_pct_conversion" /begin REF_CHARACTERISTIC aiptc_adc2phy_AirPumpPress_Ratio /end REF_CHARACTERISTIC /end GROUP
/begin GROUP S22_AnemoSigDiagnosis_fault "xjmain/GOTO/aipt_calibration/AnemoSigDiagnosis_fault" /begin SUB_GROUP S44_diagnosis_fault /end SUB_GROUP /end GROUP
/begin GROUP S22_AppDiagnosis_fault "xjmain/GOTO/aipt_calibration/AppDiagnosis_fault" /begin SUB_GROUP S45_diagnosis_fault /end SUB_GROUP /end GROUP
/begin GROUP S22_DmotSpdResDiagnosis_fault "xjmain/GOTO/aipt_calibration/DmotSpdResDiagnosis_fault" /begin SUB_GROUP S46_diagnosis_fault /end SUB_GROUP /end GROUP
/begin GROUP S22_DmotSpdRes_pct_conversion "xjmain/GOTO/aipt_calibration/DmotSpdRes_pct_conversion" /begin SUB_GROUP S47_convert_dsrVoltage_to__percent /end SUB_GROUP /begin REF_CHARACTERISTIC aiptc_adc2phy_DmotSpdRes_Ratio /end REF_CHARACTERISTIC /end GROUP
/begin GROUP S22_Filter_AP "xjmain/GOTO/aipt_calibration/Filter_AP" /begin REF_CHARACTERISTIC aiptc_adc_APP_FilterWeight /end REF_CHARACTERISTIC /end GROUP
/begin GROUP S22_Filter_AirPSig "xjmain/GOTO/aipt_calibration/Filter_AirPSig" /begin REF_CHARACTERISTIC aiptc_adc_AirPumpPress_FilterWeight /end REF_CHARACTERISTIC /end GROUP
/begin GROUP S22_Filter_AirPSig2 "xjmain/GOTO/aipt_calibration/Filter_AirPSig2" /begin REF_CHARACTERISTIC aiptc_adc_SkylightPress_FilterWeight /end REF_CHARACTERISTIC /end GROUP
/begin GROUP S22_Filter_DmotSpdRes "xjmain/GOTO/aipt_calibration/Filter_DmotSpdRes" /begin REF_CHARACTERISTIC aiptc_adc_DmotSpdRes_FilterWeight /end REF_CHARACTERISTIC /end GROUP
/begin GROUP S22_Filter_HP "xjmain/GOTO/aipt_calibration/Filter_HP" /begin REF_CHARACTERISTIC aiptc_adc_HW_FilterWeight /end REF_CHARACTERISTIC /end GROUP
/begin GROUP S22_Filter_WindSig "xjmain/GOTO/aipt_calibration/Filter_WindSig" /begin REF_CHARACTERISTIC aiptc_adc_WindSpd_FilterWeight /end REF_CHARACTERISTIC /end GROUP
/begin GROUP S22_HP_pct_conversion "xjmain/GOTO/aipt_calibration/HP_pct_conversion" /begin SUB_GROUP S54_convert_ppsVoltage_to__percent /end SUB_GROUP /begin REF_CHARACTERISTIC aiptc_adc2phy_HW_Ratio /end REF_CHARACTERISTIC /end GROUP
/begin GROUP S22_Selection_AP "xjmain/GOTO/aipt_calibration/Selection_AP" /begin REF_CHARACTERISTIC aiptc_adc_Selection /end REF_CHARACTERISTIC /end GROUP
/begin GROUP S22_Selection_AirPSig "xjmain/GOTO/aipt_calibration/Selection_AirPSig" /begin REF_CHARACTERISTIC aiptc_adc_Selection /end REF_CHARACTERISTIC /end GROUP
/begin GROUP S22_Selection_AirPSig2 "xjmain/GOTO/aipt_calibration/Selection_AirPSig2" /begin REF_CHARACTERISTIC aiptc_adc_Selection /end REF_CHARACTERISTIC /end GROUP
/begin GROUP S22_Selection_DmotSpdRes "xjmain/GOTO/aipt_calibration/Selection_DmotSpdRes" /begin REF_CHARACTERISTIC aiptc_adc_Selection /end REF_CHARACTERISTIC /end GROUP
/begin GROUP S22_Selection_HP "xjmain/GOTO/aipt_calibration/Selection_HP" /begin REF_CHARACTERISTIC aiptc_adc_Selection /end REF_CHARACTERISTIC /end GROUP
/begin GROUP S22_Selection_WindSig "xjmain/GOTO/aipt_calibration/Selection_WindSig" /begin REF_CHARACTERISTIC aiptc_adc_Selection /end REF_CHARACTERISTIC /end GROUP
/begin GROUP S22_WindSig_pct_conversion "xjmain/GOTO/aipt_calibration/WindSig_pct_conversion" /begin REF_CHARACTERISTIC aiptc_adc2phy_WindSpd_Ratio /end REF_CHARACTERISTIC /end GROUP
/begin GROUP S22_app_pct_conversion "xjmain/GOTO/aipt_calibration/app_pct_conversion" /begin SUB_GROUP S65_convert_ppsVoltage_to__percent /end SUB_GROUP /begin REF_CHARACTERISTIC aiptc_adc2phy_APP_Ratio /end REF_CHARACTERISTIC /end GROUP
/begin GROUP S22_hoist_weight_sgn_fault "xjmain/GOTO/aipt_calibration/hoist_weight_sgn_fault" /begin SUB_GROUP S66_debounce1 S66_debounce2 /end SUB_GROUP /begin REF_CHARACTERISTIC aiptc_adc_HW_GndShort aiptc_adc_HW_VccShort /end REF_CHARACTERISTIC /end GROUP
/begin GROUP S23_DCACCtrl "xjmain/GOTO/amct/DCACCtrl"
 /begin REF_CHARACTERISTIC FLT_LVL_1 amctc_Hys_fAirPumpRunPress_bar_off amctc_Hys_fAirPumpRunPress_bar_on /end REF_CHARACTERISTIC
/end GROUP
/begin GROUP S23_DCDCCtrl "xjmain/GOTO/amct/DCDCCtrl" /begin REF_CHARACTERISTIC FLT_LVL_1 /end REF_CHARACTERISTIC /end GROUP
/begin GROUP S24_PumpMotor_interp "xjmain/GOTO/apdd_calibration/PumpMotor_interp" /begin REF_CHARACTERISTIC apddc_i16PmotHighSpd apddc_i16PmotLowSpd /end REF_CHARACTERISTIC /end GROUP
/begin GROUP S24_apdd_main "xjmain/GOTO/apdd_calibration/apdd_main"
 /begin SUB_GROUP S110_backward_percent_calculation S110_pedal_interp_percent_calculation /end SUB_GROUP
 /begin REF_CHARACTERISTIC GEAR_D GEAR_R apddc_Lk1D_DmotMaxTrq_i16Spd_x /end REF_CHARACTERISTIC
 /begin REF_MEASUREMENT apddmsrv_fDmotSysMaxTrq /end REF_MEASUREMENT
/end GROUP
/begin GROUP S25_Roll_counter "xjmain/GOTO/cipt_calibration/Roll_counter"
 /begin REF_CHARACTERISTIC MCU_CANBREAK1_debounce_time MCU_CANBREAK_debounce_time MCU_CANLOST_debounce_time /end REF_CHARACTERISTIC
 /begin REF_MEASUREMENT ciptmsr_T2V_u8DmcuCanFltLvl /end REF_MEASUREMENT
/end GROUP
/begin GROUP S25_Roll_counter1 "xjmain/GOTO/cipt_calibration/Roll_counter1"
 /begin REF_CHARACTERISTIC MCU_CANBREAK1_debounce_time MCU_CANBREAK_debounce_time MCU_CANLOST_debounce_time /end REF_CHARACTERISTIC
 /begin REF_MEASUREMENT ciptmsr_T2V_u8PmcuCanFltLvl /end REF_MEASUREMENT
/end GROUP
/begin GROUP S25_bmscounter "xjmain/GOTO/cipt_calibration/bmscounter"
 /begin REF_CHARACTERISTIC BMS_CANBREAK1_debounce_time BMS_CANBREAK_debounce_time BMS_CANLOST_debounce_time FLT_LVL_0 /end REF_CHARACTERISTIC
 /begin REF_MEASUREMENT ciptmsr_B2V_u8BattCanFltLvl /end REF_MEASUREMENT
/end GROUP
/begin GROUP S26_0X1824D9D0 "xjmain/GOTO/copt_calibration/0X1824D9D0"
 /begin REF_CHARACTERISTIC coptcalflg_V2P_isDcdcDcacConn coptcalflg_V2P_isDmcuConn coptcalflg_V2P_isDmcuPreConn coptcalflg_V2P_isObcConn coptcalflg_V2P_isPmcuConn coptcalflg_V2P_isPmcuPreConn coptcalvlu_V2P_isDcdcDcacConn coptcalvlu_V2P_isDmcuConn coptcalvlu_V2P_isDmcuPreConn coptcalvlu_V2P_isObcConn coptcalvlu_V2P_isPmcuConn coptcalvlu_V2P_isPmcuPreConn /end REF_CHARACTERISTIC
 /begin REF_MEASUREMENT coptmsr_V2P_isDcdcDcacConn coptmsr_V2P_isDmcuConn coptmsr_V2P_isDmcuPreConn coptmsr_V2P_isObcConn coptmsr_V2P_isPmcuConn coptmsr_V2P_isPmcuPreConn /end REF_MEASUREMENT
/end GROUP
/begin GROUP S26_0X1827D9D0 "xjmain/GOTO/copt_calibration/0X1827D9D0"
 /begin REF_CHARACTERISTIC coptcalflg_V2P_isDcacRun coptcalflg_V2P_isDcdcRun coptcalvlu_V2P_isDcacRun coptcalvlu_V2P_isDcdcRun /end REF_CHARACTERISTIC
 /begin REF_MEASUREMENT coptmsr_V2P_isDcacRun coptmsr_V2P_isDcdcRun /end REF_MEASUREMENT
/end GROUP
/begin GROUP S26_0x180256EF "xjmain/GOTO/copt_calibration/0x180256EF" /begin REF_CHARACTERISTIC coptcalflg_V2T_i8GearPos coptcalvlu_V2T_i8GearPos /end REF_CHARACTERISTIC /begin REF_MEASUREMENT coptmsr_V2T_i8GearPos /end REF_MEASUREMENT /end GROUP
/begin GROUP S26_Engine_Information "xjmain/GOTO/copt_calibration/Engine_Information"
 /begin REF_MEASUREMENT incc_Engine_Coolant_Temp incc_Engine_FMI incc_Engine_Gear incc_Engine_Load_Percent incc_Engine_Oil_Pressure incc_Engine_Oil_Temp incc_Engine_Speed incc_Engine_TotalFuel_Used incc_Engine_TotalHours incc_SPN_LeastBits incc_SPN_MostBits incc_SPN_SecondBits /end REF_MEASUREMENT
/end GROUP
/begin GROUP S26_INCC_0x18F101D0 "xjmain/GOTO/copt_calibration/INCC_0x18F101D0"
 /begin REF_CHARACTERISTIC coptcalflg_V2I_fHoistSpd coptcalflg_V2I_isApFlt coptcalflg_V2I_isBattCanFltRc coptcalflg_V2I_isDmcuCanFltRc coptcalflg_V2I_isHWFlt coptcalflg_V2I_isPmcuCanFltRc coptcalflg_V2I_isVehFlt coptcalflg_V2I_isWindSpdFlt coptcalflg_V2I_u8ReadySts coptcalflg_V2I_u8VehChgSts coptcalflg_V2I_u8VehRunSts coptcalflg_V2I_u8WindLvl coptcalvlu_V2I_fHoistSpd coptcalvlu_V2I_isApFlt coptcalvlu_V2I_isBattCanFltRc coptcalvlu_V2I_isDmcuCanFltRc coptcalvlu_V2I_isHWFlt coptcalvlu_V2I_isPmcuCanFltRc coptcalvlu_V2I_isVehFlt coptcalvlu_V2I_isWindSpdFlt coptcalvlu_V2I_u8ReadySts coptcalvlu_V2I_u8VehChgSts coptcalvlu_V2I_u8VehRunSts coptcalvlu_V2I_u8WindLvl /end REF_CHARACTERISTIC
 /begin REF_MEASUREMENT coptmsr_V2I_fHoistSpd coptmsr_V2I_isApFlt coptmsr_V2I_isBattCanFltRc coptmsr_V2I_isDmcuCanFltRc coptmsr_V2I_isHWFlt coptmsr_V2I_isPmcuCanFltRc coptmsr_V2I_isVehFlt coptmsr_V2I_isWindSpdFlt coptmsr_V2I_u8InccLifeSig coptmsr_V2I_u8ReadySts coptmsr_V2I_u8VehChgSts coptmsr_V2I_u8VehRunSts coptmsr_V2I_u8WindLvl /end REF_MEASUREMENT
/end GROUP
/begin GROUP S26_V2BMS "xjmain/GOTO/copt_calibration/V2BMS"
 /begin REF_CHARACTERISTIC coptcalflg_V2B_isChgAllow coptcalflg_V2B_u8BattChgMode coptcalflg_V2B_u8BattConn coptcalvlu_V2B_isChgAllow coptcalvlu_V2B_u8BattChgMode coptcalvlu_V2B_u8BattConn /end REF_CHARACTERISTIC
 /begin REF_MEASUREMENT coptmsr_V2B_isChgAllow coptmsr_V2B_u8BattChgMode coptmsr_V2B_u8BattConn coptmsr_V2B_u8BattLifeSig /end REF_MEASUREMENT
/end GROUP
/begin GROUP S26_V2DMCU "xjmain/GOTO/copt_calibration/V2DMCU"
 /begin REF_CHARACTERISTIC coptcalflg_V2T_fDmcuTrqReq coptcalflg_V2T_i16DmcuSpdReq coptcalflg_V2T_isDmcuDisChg coptcalflg_V2T_isDmcuEn coptcalflg_V2T_u8DmcuRunModeReq coptcalvlu_V2T_fDmcuTrqReq coptcalvlu_V2T_i16DmcuSpdReq coptcalvlu_V2T_isDmcuDisChg coptcalvlu_V2T_isDmcuEn coptcalvlu_V2T_u8DmcuRunModeReq /end REF_CHARACTERISTIC
 /begin REF_MEASUREMENT coptmsr_V2T_fDmcuTrqReq coptmsr_V2T_i16DmcuSpdReq coptmsr_V2T_isDmcuDisChg coptmsr_V2T_isDmcuEn coptmsr_V2T_u8DmcuLifeSig coptmsr_V2T_u8DmcuRunModeReq /end REF_MEASUREMENT
/end GROUP
/begin GROUP S26_V2OBC "xjmain/GOTO/copt_calibration/V2OBC"
 /begin REF_CHARACTERISTIC coptcalflg_V2O_fChgCurrSet coptcalflg_V2O_fChgVoltSet coptcalflg_V2O_u8ChgStartStop coptcalvlu_V2O_fChgCurrSet coptcalvlu_V2O_fChgVoltSet coptcalvlu_V2O_u8ChgStartStop /end REF_CHARACTERISTIC
 /begin REF_MEASUREMENT coptmsr_V2O_fChgCurrSet coptmsr_V2O_fChgVoltSet coptmsr_V2O_u8ChgStartStop /end REF_MEASUREMENT
/end GROUP
/begin GROUP S26_V2PMCU "xjmain/GOTO/copt_calibration/V2PMCU"
 /begin REF_CHARACTERISTIC coptcalflg_V2T_fPmcuTrqReq coptcalflg_V2T_i16PmcuSpdReq coptcalflg_V2T_isPmcuDisChg coptcalflg_V2T_isPmcuEn coptcalflg_V2T_u8PmcuRunModeReq coptcalvlu_V2T_fPmcuTrqReq coptcalvlu_V2T_i16PmcuSpdReq coptcalvlu_V2T_isPmcuDisChg coptcalvlu_V2T_isPmcuEn coptcalvlu_V2T_u8PmcuRunModeReq /end REF_CHARACTERISTIC
 /begin REF_MEASUREMENT coptmsr_V2T_fPmcuTrqReq coptmsr_V2T_i16PmcuSpdReq coptmsr_V2T_isPmcuDisChg coptmsr_V2T_isPmcuEn coptmsr_V2T_u8PmcuLifeSig coptmsr_V2T_u8PmcuRunModeReq /end REF_MEASUREMENT
/end GROUP
/begin GROUP S27_GetAppInfo "xjmain/GOTO/dipt/GetAppInfo" /begin REF_CHARACTERISTIC appc_u32Version /end REF_CHARACTERISTIC /begin REF_MEASUREMENT appmsr_fCycTime appmsr_u32Version /end REF_MEASUREMENT /end GROUP
/begin GROUP S27_debounce1 "xjmain/GOTO/dipt/debounce1" /begin REF_CHARACTERISTIC glc_KEY_DEB_TIME_MS /end REF_CHARACTERISTIC /end GROUP
/begin GROUP S27_debounce10 "xjmain/GOTO/dipt/debounce10" /begin REF_CHARACTERISTIC glc_KEY_DEB_TIME_MS /end REF_CHARACTERISTIC /end GROUP
/begin GROUP S27_debounce11 "xjmain/GOTO/dipt/debounce11" /begin REF_CHARACTERISTIC glc_KEY_DEB_TIME_MS /end REF_CHARACTERISTIC /end GROUP
/begin GROUP S27_debounce12 "xjmain/GOTO/dipt/debounce12" /begin REF_CHARACTERISTIC glc_KEY_DEB_TIME_MS /end REF_CHARACTERISTIC /end GROUP
/begin GROUP S27_debounce13 "xjmain/GOTO/dipt/debounce13" /begin REF_CHARACTERISTIC glc_KEY_DEB_TIME_MS /end REF_CHARACTERISTIC /end GROUP
/begin GROUP S27_debounce14 "xjmain/GOTO/dipt/debounce14" /begin REF_CHARACTERISTIC glc_KEY_DEB_TIME_MS /end REF_CHARACTERISTIC /end GROUP
/begin GROUP S27_debounce15 "xjmain/GOTO/dipt/debounce15" /begin REF_CHARACTERISTIC glc_KEY_DEB_TIME_MS /end REF_CHARACTERISTIC /end GROUP
/begin GROUP S27_debounce2 "xjmain/GOTO/dipt/debounce2" /begin REF_CHARACTERISTIC glc_KEY_DEB_TIME_MS /end REF_CHARACTERISTIC /end GROUP
/begin GROUP S27_debounce3 "xjmain/GOTO/dipt/debounce3" /begin REF_CHARACTERISTIC glc_KEY_DEB_TIME_MS /end REF_CHARACTERISTIC /end GROUP
/begin GROUP S27_debounce4 "xjmain/GOTO/dipt/debounce4" /begin REF_CHARACTERISTIC glc_KEY_DEB_TIME_MS /end REF_CHARACTERISTIC /end GROUP
/begin GROUP S27_debounce5 "xjmain/GOTO/dipt/debounce5" /begin REF_CHARACTERISTIC glc_KEY_DEB_TIME_MS /end REF_CHARACTERISTIC /end GROUP
/begin GROUP S27_debounce6 "xjmain/GOTO/dipt/debounce6" /begin REF_CHARACTERISTIC glc_KEY_DEB_TIME_MS /end REF_CHARACTERISTIC /end GROUP
/begin GROUP S27_debounce7 "xjmain/GOTO/dipt/debounce7" /begin REF_CHARACTERISTIC glc_KEY_DEB_TIME_MS /end REF_CHARACTERISTIC /end GROUP
/begin GROUP S27_debounce8 "xjmain/GOTO/dipt/debounce8" /begin REF_CHARACTERISTIC glc_KEY_DEB_TIME_MS /end REF_CHARACTERISTIC /end GROUP
/begin GROUP S27_debounce9 "xjmain/GOTO/dipt/debounce9" /begin REF_CHARACTERISTIC glc_KEY_DEB_TIME_MS /end REF_CHARACTERISTIC /end GROUP
/begin GROUP S28_dopt_main "xjmain/GOTO/dopt/dopt_main" /begin REF_CHARACTERISTIC FLT_LVL_1 /end REF_CHARACTERISTIC /end GROUP
/begin GROUP S29_ComponentFault "xjmain/GOTO/fdst_calibration/ComponentFault"
 /begin SUB_GROUP S185_PDU_fault_handling S185_TCU_Fault S185_battery_fault_handling S185_dmotor_fault_handling S185_pmotor_fault_handling /end SUB_GROUP
/end GROUP
/begin GROUP S29_InputSignals "xjmain/GOTO/fdst_calibration/InputSignals"
 /begin SUB_GROUP S186_BMS_CANFault S186_MCU_CANFault S186_PDU_CANFault S186_PMCU_CANFault S186_TCU_CANFault /end SUB_GROUP
/end GROUP
/begin GROUP S31_AppValid "xjmain/GOTO/incc_calibration/AppValid"
 /begin REF_MEASUREMENT incc_AppValid_flg incc_WeightSigValid_flg incc_WindSigValid_flg /end REF_MEASUREMENT
/end GROUP
/begin GROUP S31_DMCU_FaultLevel "xjmain/GOTO/incc_calibration/DMCU_FaultLevel" /begin REF_CHARACTERISTIC FLT_LVL_1 /end REF_CHARACTERISTIC /end GROUP
/begin GROUP S31_PMCU_FaultLevel "xjmain/GOTO/incc_calibration/PMCU_FaultLevel" /begin REF_CHARACTERISTIC FLT_LVL_1 /end REF_CHARACTERISTIC /end GROUP
/begin GROUP S31_RunTime1 "xjmain/GOTO/incc_calibration/RunTime1" /begin REF_MEASUREMENT incc_NewRunTime1 incc_NewRunTime2 incc_NewRunTime3 /end REF_MEASUREMENT /end GROUP
/begin GROUP S31_Windlevel "xjmain/GOTO/incc_calibration/Windlevel" /begin REF_MEASUREMENT incc_WindLevel /end REF_MEASUREMENT /end GROUP
/begin GROUP S31_can_bus_fault "xjmain/GOTO/incc_calibration/can_bus_fault" /begin REF_CHARACTERISTIC FLT_LVL_1 /end REF_CHARACTERISTIC /begin REF_MEASUREMENT incc_BMSCANFlt_flg incc_DMCUCANFlt_flg incc_PMCUCANFlt_flg /end REF_MEASUREMENT /end GROUP
/begin GROUP S31_hoistspd "xjmain/GOTO/incc_calibration/hoistspd"
 /begin REF_CHARACTERISTIC GEAR_D1 GEAR_D2 GEAR_D3 GEAR_D4 GEAR_R glc_ANGLEBOX_RATIO glc_CHAIN_RATIO glc_GEAR_D1_RATIO glc_GEAR_D2_RATIO glc_GEAR_D3_RATIO glc_GEAR_D4_RATIO glc_GEAR_R_RATIO glc_ROLLER_DIAMETER_mm glc_ROTARYTABLE_EFF glc_ROTARYTABLE_RATIO glc_STEEL_WIRE_SUM glc_TRANSBOX_RATIO /end REF_CHARACTERISTIC
 /begin REF_MEASUREMENT incc_HoistSpd_mps /end REF_MEASUREMENT
/end GROUP
/begin GROUP S31_system_ready "xjmain/GOTO/incc_calibration/system_ready" /begin REF_MEASUREMENT incc_Ready_flg /end REF_MEASUREMENT /end GROUP
/begin GROUP S31_vcu_fault "xjmain/GOTO/incc_calibration/vcu_fault" /begin REF_CHARACTERISTIC FLT_LVL_1 /end REF_CHARACTERISTIC /begin REF_MEASUREMENT incc_VCUFault_flg /end REF_MEASUREMENT /end GROUP
/begin GROUP S31_veh_message "xjmain/GOTO/incc_calibration/veh_message" /begin REF_MEASUREMENT incc_VehMsg_VehMd incc_VehMsg_VehRunsts /end REF_MEASUREMENT /end GROUP
/begin GROUP S32_mmct_Pmot "xjmain/GOTO/mmct_calibration/mmct_Pmot" /begin REF_CHARACTERISTIC MCU_DIR_MODE_POS MCU_RUN_MODE_SPD MCU_RUN_MODE_TRQ /end REF_CHARACTERISTIC /end GROUP
/begin GROUP S32_mmct_main "xjmain/GOTO/mmct_calibration/mmct_main"
 /begin REF_CHARACTERISTIC GEAR_D4 GEAR_R MCU_DIR_MODE_NEG MCU_DIR_MODE_POS MCU_RUN_MODE_SPD MCU_RUN_MODE_TRQ MCU_TRQ_MODE_ZERO glc_i16DMCU_MAX_SPD_LMT mmctc_i16DmcuSpdLmtOfD4 /end REF_CHARACTERISTIC
 /begin REF_MEASUREMENT mmctmsrv_fDmcuTrqReq mmctmsrv_u16DmcuSpdReq /end REF_MEASUREMENT
/end GROUP
/begin GROUP S33_obc_main "xjmain/GOTO/obc_calibration/obc_main" /begin SUB_GROUP S262_debounce1 S262_obc_fault /end SUB_GROUP /begin REF_CHARACTERISTIC FLT_LVL_1 obcc_fBattHeatCurr obcc_u8DcdcPwr_kW /end REF_CHARACTERISTIC /begin REF_MEASUREMENT obcmsrv_fMotPwrAct_kW /end REF_MEASUREMENT /end GROUP
/begin GROUP S34_pooc_calibration "xjmain/GOTO/pooc/pooc_calibration"
 /begin REF_CHARACTERISTIC poocc_fBattCurrLow poocc_u16BattConnTimeOut_ms poocc_u16BattDisConnTime_ms poocc_u16InitTimeOut_ms poocc_u16LVDownTime_ms poocc_u16McuDisChgTime_ms poocc_u16McuPreConnTime_ms poocc_u16MotEnTimeOut_ms poocc_u16MotSpdLowChg poocc_u16MotSpdLowDown poocc_u16MotSpdLowUp poocc_u16PwrDownTime_ms poocc_u16SpdCurrDlyTime_ms /end REF_CHARACTERISTIC
/end GROUP
/begin GROUP S35_rbct_main "xjmain/GOTO/rbct_calibration/rbct_main" /begin SUB_GROUP S268_brk_regen S268_regen_condition_dicision /end SUB_GROUP /begin REF_CHARACTERISTIC rbctc_fRgBrTrqReqMaxLmt rbctc_fRgBrTrqReqMinLmt /end REF_CHARACTERISTIC /end GROUP
/begin GROUP S36_debounce4 "xjmain/GOTO/rtos_calibration/debounce4" /begin REF_CHARACTERISTIC glc_KEY_DEB_TIME_MS /end REF_CHARACTERISTIC /end GROUP
/begin GROUP S37_brake "xjmain/GOTO/scpc_calibration/brake" /begin REF_CHARACTERISTIC scpcc_Lk2D_DmotBrEff_i16Spd_y /end REF_CHARACTERISTIC /end GROUP
/begin GROUP S37_drive "xjmain/GOTO/scpc_calibration/drive"
 /begin REF_CHARACTERISTIC glc_i16DMCU_MAX_SPD_LMT scpcc_Lk2D_DmotDrEff_i16Spd_y scpcc_u8AccessoryPwr_kW /end REF_CHARACTERISTIC
 /begin REF_MEASUREMENT scpcmsrv_fPmotInPwrReq_kW /end REF_MEASUREMENT
/end GROUP
/begin GROUP S38_final_limit "xjmain/GOTO/tfta_calibration/final_limit" /begin REF_CHARACTERISTIC GEAR_D GEAR_R /end REF_CHARACTERISTIC /end GROUP
/begin GROUP S38_torque_damping "xjmain/GOTO/tfta_calibration/torque_damping" /begin SUB_GROUP S281_ts /end SUB_GROUP /end GROUP
/begin GROUP S38_tq_syn_and_limitation "xjmain/GOTO/tfta_calibration/tq_syn_and_limitation"
 /begin SUB_GROUP S283_forward_mde_demand S283_regen_mde_demand S283_reverse_mde_demamd /end SUB_GROUP
 /begin REF_CHARACTERISTIC GEAR_D GEAR_R tftac_i8AllowZeroTrqReqMax tftac_i8AllowZeroTrqReqMin /end REF_CHARACTERISTIC
 /begin REF_MEASUREMENT tftamsrv_fDmcuTrqReq /end REF_MEASUREMENT
/end GROUP
/begin GROUP S39_final_limit "xjmain/GOTO/wctrl/final_limit" /begin REF_CHARACTERISTIC wctrlc_u16PmcuSpdReqMax /end REF_CHARACTERISTIC /end GROUP
/begin GROUP S295_Get_flgKeyOn "xjmain/Power Management Example/Power Off Management/Get flgKeyOn" /begin REF_MEASUREMENT PwrM_flgKeyOnRaw /end REF_MEASUREMENT /end GROUP
/begin GROUP S295_TOfD_xxxx1 "xjmain/Power Management Example/Power Off Management/TOfD_xxxx1" /begin REF_MEASUREMENT PwrM_flgKeyOnDelay /end REF_MEASUREMENT /end GROUP
/begin GROUP S327_Subsystem_Reference "xjmain/VarIn/ActIn/Subsystem Reference" /begin REF_MEASUREMENT hldmsr_P2V_u8PmcuPreRlySts /end REF_MEASUREMENT /end GROUP
/begin GROUP S327_Subsystem_Reference1 "xjmain/VarIn/ActIn/Subsystem Reference1" /begin REF_MEASUREMENT hldmsr_P2V_u8PmcuRlySts /end REF_MEASUREMENT /end GROUP
/begin GROUP S327_Subsystem_Reference2 "xjmain/VarIn/ActIn/Subsystem Reference2" /begin REF_MEASUREMENT hldmsr_P2V_u8DmcuPreRlySts /end REF_MEASUREMENT /end GROUP
/begin GROUP S327_Subsystem_Reference3 "xjmain/VarIn/ActIn/Subsystem Reference3" /begin REF_MEASUREMENT hldmsr_P2V_u8DmcuRlySts /end REF_MEASUREMENT /end GROUP
/begin GROUP S327_Subsystem_Reference4 "xjmain/VarIn/ActIn/Subsystem Reference4" /begin REF_MEASUREMENT hldmsr_P2V_u8ObcRlySts /end REF_MEASUREMENT /end GROUP
/begin GROUP S327_Subsystem_Reference5 "xjmain/VarIn/ActIn/Subsystem Reference5" /begin REF_MEASUREMENT hldmsr_P2V_u8DcacRlySts /end REF_MEASUREMENT /end GROUP
/begin GROUP S327_Subsystem_Reference6 "xjmain/VarIn/ActIn/Subsystem Reference6" /begin REF_MEASUREMENT hldmsr_P2V_u8DcdcRlySts /end REF_MEASUREMENT /end GROUP
/begin GROUP S327_Subsystem_Reference7 "xjmain/VarIn/ActIn/Subsystem Reference7" /begin REF_MEASUREMENT hldmsr_P2V_u8DcacFltLvl /end REF_MEASUREMENT /end GROUP
/begin GROUP S327_Subsystem_Reference8 "xjmain/VarIn/ActIn/Subsystem Reference8" /begin REF_MEASUREMENT hldmsr_P2V_u8DcdcFltLvl /end REF_MEASUREMENT /end GROUP
/begin GROUP S327_hld_aipt2 "xjmain/VarIn/ActIn/hld_aipt2"
 /begin REF_MEASUREMENT hldmsr_AI_AirPumpPress hldmsr_AI_HoistWeight hldmsr_AI_SkylightPress hldmsr_AI_WindSpd /end REF_MEASUREMENT
/end GROUP
/begin GROUP S327_hld_dipt "xjmain/VarIn/ActIn/hld_dipt" /begin REF_MEASUREMENT hldmsr_DI_Kl15 /end REF_MEASUREMENT /end GROUP
/begin GROUP S40_diagnosis_fault "xjmain/GOTO/aipt_calibration/AirPSig2Diagnosis_fault/diagnosis_fault" /begin SUB_GROUP S67_debounce1 S67_debounce4 /end SUB_GROUP
 /begin REF_CHARACTERISTIC aiptc_adc_SkylightPress_GndShort aiptc_adc_SkylightPress_VccShort /end REF_CHARACTERISTIC
/end GROUP
/begin GROUP S42_diagnosis_fault "xjmain/GOTO/aipt_calibration/AirPSigDiagnosis_fault/diagnosis_fault" /begin SUB_GROUP S72_debounce1 S72_debounce4 /end SUB_GROUP
 /begin REF_CHARACTERISTIC aiptc_adc_AirPumpPress_GndShort aiptc_adc_AirPumpPress_VccShort /end REF_CHARACTERISTIC
/end GROUP
/begin GROUP S44_diagnosis_fault "xjmain/GOTO/aipt_calibration/AnemoSigDiagnosis_fault/diagnosis_fault" /begin SUB_GROUP S77_debounce1 S77_debounce4 /end SUB_GROUP /begin REF_CHARACTERISTIC aiptc_adc_WindSpd_GndShort aiptc_adc_WindSpd_VccShort /end REF_CHARACTERISTIC /end GROUP
/begin GROUP S45_diagnosis_fault "xjmain/GOTO/aipt_calibration/AppDiagnosis_fault/diagnosis_fault" /begin SUB_GROUP S82_debounce1 S82_debounce4 /end SUB_GROUP /begin REF_CHARACTERISTIC aiptc_adc_APP_GndShort aiptc_adc_APP_VccShort /end REF_CHARACTERISTIC /end GROUP
/begin GROUP S46_diagnosis_fault "xjmain/GOTO/aipt_calibration/DmotSpdResDiagnosis_fault/diagnosis_fault" /begin SUB_GROUP S87_debounce1 S87_debounce4 /end SUB_GROUP
 /begin REF_CHARACTERISTIC aiptc_adc_DmotSpdRes_GndShort aiptc_adc_DmotSpdRes_VccShort /end REF_CHARACTERISTIC
/end GROUP
/begin GROUP S47_convert_dsrVoltage_to__percent "xjmain/GOTO/aipt_calibration/DmotSpdRes_pct_conversion/convert_dsrVoltage_to_ percent"
 /begin REF_CHARACTERISTIC aiptc_phy_DmotSpdRes_LowLmt_Err aiptc_phy_DmotSpdRes_LowLmt_Raw aiptc_phy_DmotSpdRes_UpLmt_Err aiptc_phy_DmotSpdRes_UpLmt_Raw /end REF_CHARACTERISTIC
/end GROUP
/begin GROUP S54_convert_ppsVoltage_to__percent "xjmain/GOTO/aipt_calibration/HP_pct_conversion/convert_ppsVoltage_to_ percent"
 /begin REF_CHARACTERISTIC aiptc_phy_HW_LowLmt_Err aiptc_phy_HW_LowLmt_Raw aiptc_phy_HW_UpLmt_Err aiptc_phy_HW_UpLmt_Raw /end REF_CHARACTERISTIC
/end GROUP
/begin GROUP S65_convert_ppsVoltage_to__percent "xjmain/GOTO/aipt_calibration/app_pct_conversion/convert_ppsVoltage_to_ percent"
 /begin REF_CHARACTERISTIC aiptc_phy_APP_LowLmt_Err aiptc_phy_APP_LowLmt_Raw aiptc_phy_APP_UpLmt_Err aiptc_phy_APP_UpLmt_Raw /end REF_CHARACTERISTIC
/end GROUP
/begin GROUP S66_debounce1 "xjmain/GOTO/aipt_calibration/hoist_weight_sgn_fault/debounce1" /begin REF_CHARACTERISTIC aiptc_Deb_time_ms /end REF_CHARACTERISTIC /end GROUP
/begin GROUP S66_debounce2 "xjmain/GOTO/aipt_calibration/hoist_weight_sgn_fault/debounce2" /begin REF_CHARACTERISTIC aiptc_Deb_time_ms /end REF_CHARACTERISTIC /end GROUP
/begin GROUP S110_backward_percent_calculation "xjmain/GOTO/apdd_calibration/apdd_main/backward_percent_calculation" /begin REF_CHARACTERISTIC apddc_fDmotBwdTrqDerat /end REF_CHARACTERISTIC /begin REF_MEASUREMENT apddmsrv_fDmotBwdAppCoef apddmsrv_fDmotBwdTrqReq /end REF_MEASUREMENT /end GROUP
/begin GROUP S110_pedal_interp_percent_calculation "xjmain/GOTO/apdd_calibration/apdd_main/pedal_interp_percent_calculation" /begin REF_MEASUREMENT apddmsrv_fDmotFwdAppCoef apddmsrv_fDmotFwdTrqReq /end REF_MEASUREMENT /end GROUP
/begin GROUP S185_PDU_fault_handling "xjmain/GOTO/fdst_calibration/ComponentFault/PDU_fault_handling" /begin REF_CHARACTERISTIC FLT_LVL_0 FLT_LVL_1 FLT_LVL_2 FLT_LVL_3 /end REF_CHARACTERISTIC /begin REF_MEASUREMENT fdstmsrv_u8PduSysFltLvl /end REF_MEASUREMENT /end GROUP
/begin GROUP S185_TCU_Fault "xjmain/GOTO/fdst_calibration/ComponentFault/TCU_Fault" /begin REF_MEASUREMENT fdstmsrv_u8GearSysFltLvl /end REF_MEASUREMENT /end GROUP
/begin GROUP S185_battery_fault_handling "xjmain/GOTO/fdst_calibration/ComponentFault/battery_fault_handling"
 /begin SUB_GROUP S190_BatteryChargePowerLimit S190_BatteryDischargePowerLimit S190_Battery_FaultLevel S190_HighVoltageConnect /end SUB_GROUP
/end GROUP
/begin GROUP S185_dmotor_fault_handling "xjmain/GOTO/fdst_calibration/ComponentFault/dmotor_fault_handling"
 /begin SUB_GROUP S191_Subsystem S191_TMBrTrqLmt S191_TMDrTrqLmt S191_fdstv_SysFlt /end SUB_GROUP
/end GROUP
/begin GROUP S185_pmotor_fault_handling "xjmain/GOTO/fdst_calibration/ComponentFault/pmotor_fault_handling" /begin REF_CHARACTERISTIC FLT_LVL_3 /end REF_CHARACTERISTIC /begin REF_MEASUREMENT fdstmsrv_isSysFltPmcuEn fdstmsrv_u8PmcuSysFltLvl /end REF_MEASUREMENT /end GROUP
/begin GROUP S186_BMS_CANFault "xjmain/GOTO/fdst_calibration/InputSignals/BMS_CANFault"
 /begin SUB_GROUP S202_BMS_FaultLevel S202_BMS_HVConnection S202_BatteryChargePower S202_BatteryDischargePower /end SUB_GROUP
/end GROUP
/begin GROUP S186_MCU_CANFault "xjmain/GOTO/fdst_calibration/InputSignals/MCU_CANFault"
 /begin SUB_GROUP S203_MCU_TMEnable S203_MCU_TMMaxTorque S203_MCU_TMMinTorque /end SUB_GROUP
 /begin REF_CHARACTERISTIC FLT_LVL_3 /end REF_CHARACTERISTIC
 /begin REF_MEASUREMENT fdstmsrv_u8DmcuCanFltLvl /end REF_MEASUREMENT
/end GROUP
/begin GROUP S186_PDU_CANFault "xjmain/GOTO/fdst_calibration/InputSignals/PDU_CANFault" /begin REF_MEASUREMENT fdstmsrv_u8PduCanFltLvl /end REF_MEASUREMENT /end GROUP
/begin GROUP S186_PMCU_CANFault "xjmain/GOTO/fdst_calibration/InputSignals/PMCU_CANFault" /begin SUB_GROUP S205_MCU_TMEnable /end SUB_GROUP /begin REF_MEASUREMENT fdstmsrv_u8PmcuCanFltLvl /end REF_MEASUREMENT /end GROUP
/begin GROUP S186_TCU_CANFault "xjmain/GOTO/fdst_calibration/InputSignals/TCU_CANFault" /begin REF_MEASUREMENT fdstmsrv_u8GearCanFltLvl /end REF_MEASUREMENT /end GROUP
/begin GROUP S262_debounce1 "xjmain/GOTO/obc_calibration/obc_main/debounce1" /begin REF_CHARACTERISTIC obcc_u8VehFltDebTime_ms /end REF_CHARACTERISTIC /end GROUP
/begin GROUP S262_obc_fault "xjmain/GOTO/obc_calibration/obc_main/obc_fault" /begin REF_MEASUREMENT obcmsrv_isNoFlt /end REF_MEASUREMENT /end GROUP
/begin GROUP S268_brk_regen "xjmain/GOTO/rbct_calibration/rbct_main/brk_regen"
 /begin REF_CHARACTERISTIC GEAR_D1 GEAR_D2 GEAR_D3 GEAR_D4 GEAR_R glc_ANGLEBOX_RATIO glc_CHAIN_RATIO glc_GEAR_D1_RATIO glc_GEAR_D2_RATIO glc_GEAR_D3_RATIO glc_GEAR_D4_RATIO glc_GEAR_R_RATIO glc_REGEN_RATIO glc_ROLLER_DIAMETER_mm glc_STEEL_WIRE_SUM rbctc_fMaxRgTrq rbctc_i16MaxRgPwr_kW /end REF_CHARACTERISTIC
/end GROUP
/begin GROUP S268_regen_condition_dicision "xjmain/GOTO/rbct_calibration/rbct_main/regen_condition_dicision" /begin SUB_GROUP S271_debounce1 /end SUB_GROUP
 /begin REF_CHARACTERISTIC FLT_LVL_0 GEAR_D1 rbctc_Hys_fBattSOC_off rbctc_Hys_fBattSOC_on rbctc_Hys_fDmcuMaxRgTrq_off rbctc_Hys_fDmcuMaxRgTrq_on rbctc_i8AllowRgBattAvgTmpt rbctc_u8AllowRgHW_t /end REF_CHARACTERISTIC
/end GROUP
/begin GROUP S281_ts "xjmain/GOTO/tfta_calibration/torque_damping/ts" /begin SUB_GROUP S284_ts /end SUB_GROUP /begin REF_CHARACTERISTIC tftac_u16DmcuTrqReq_FilterWeight /end REF_CHARACTERISTIC /end GROUP
/begin GROUP S283_forward_mde_demand "xjmain/GOTO/tfta_calibration/tq_syn_and_limitation/forward_mde_demand" /begin REF_CHARACTERISTIC GEAR_D /end REF_CHARACTERISTIC /end GROUP
/begin GROUP S283_regen_mde_demand "xjmain/GOTO/tfta_calibration/tq_syn_and_limitation/regen_mde_demand" /begin REF_CHARACTERISTIC GEAR_D /end REF_CHARACTERISTIC /end GROUP
/begin GROUP S283_reverse_mde_demamd "xjmain/GOTO/tfta_calibration/tq_syn_and_limitation/reverse_mde_demamd" /begin REF_CHARACTERISTIC GEAR_R /end REF_CHARACTERISTIC /end GROUP
/begin GROUP S67_debounce1 "xjmain/GOTO/aipt_calibration/AirPSig2Diagnosis_fault/diagnosis_fault/debounce1" /begin REF_CHARACTERISTIC aiptc_Deb_time_ms /end REF_CHARACTERISTIC /end GROUP
/begin GROUP S67_debounce4 "xjmain/GOTO/aipt_calibration/AirPSig2Diagnosis_fault/diagnosis_fault/debounce4" /begin REF_CHARACTERISTIC aiptc_Deb_time_ms /end REF_CHARACTERISTIC /end GROUP
/begin GROUP S72_debounce1 "xjmain/GOTO/aipt_calibration/AirPSigDiagnosis_fault/diagnosis_fault/debounce1" /begin REF_CHARACTERISTIC aiptc_Deb_time_ms /end REF_CHARACTERISTIC /end GROUP
/begin GROUP S72_debounce4 "xjmain/GOTO/aipt_calibration/AirPSigDiagnosis_fault/diagnosis_fault/debounce4" /begin REF_CHARACTERISTIC aiptc_Deb_time_ms /end REF_CHARACTERISTIC /end GROUP
/begin GROUP S77_debounce1 "xjmain/GOTO/aipt_calibration/AnemoSigDiagnosis_fault/diagnosis_fault/debounce1" /begin REF_CHARACTERISTIC aiptc_Deb_time_ms /end REF_CHARACTERISTIC /end GROUP
/begin GROUP S77_debounce4 "xjmain/GOTO/aipt_calibration/AnemoSigDiagnosis_fault/diagnosis_fault/debounce4" /begin REF_CHARACTERISTIC aiptc_Deb_time_ms /end REF_CHARACTERISTIC /end GROUP
/begin GROUP S82_debounce1 "xjmain/GOTO/aipt_calibration/AppDiagnosis_fault/diagnosis_fault/debounce1" /begin REF_CHARACTERISTIC aiptc_Deb_time_ms /end REF_CHARACTERISTIC /end GROUP
/begin GROUP S82_debounce4 "xjmain/GOTO/aipt_calibration/AppDiagnosis_fault/diagnosis_fault/debounce4" /begin REF_CHARACTERISTIC aiptc_Deb_time_ms /end REF_CHARACTERISTIC /end GROUP
/begin GROUP S87_debounce1 "xjmain/GOTO/aipt_calibration/DmotSpdResDiagnosis_fault/diagnosis_fault/debounce1" /begin REF_CHARACTERISTIC aiptc_Deb_time_ms /end REF_CHARACTERISTIC /end GROUP
/begin GROUP S87_debounce4 "xjmain/GOTO/aipt_calibration/DmotSpdResDiagnosis_fault/diagnosis_fault/debounce4" /begin REF_CHARACTERISTIC aiptc_Deb_time_ms /end REF_CHARACTERISTIC /end GROUP
/begin GROUP S190_BatteryChargePowerLimit "xjmain/GOTO/fdst_calibration/ComponentFault/battery_fault_handling/BatteryChargePowerLimit" /begin REF_MEASUREMENT fdstmsrv_fSysFltBattChgPwrLmt_kW /end REF_MEASUREMENT /end GROUP
/begin GROUP S190_BatteryDischargePowerLimit "xjmain/GOTO/fdst_calibration/ComponentFault/battery_fault_handling/BatteryDischargePowerLimit" /begin REF_MEASUREMENT fdstmsrv_fSysFltBattDisChgPwrLmt_kW /end REF_MEASUREMENT /end GROUP
/begin GROUP S190_Battery_FaultLevel "xjmain/GOTO/fdst_calibration/ComponentFault/battery_fault_handling/Battery_FaultLevel" /begin REF_CHARACTERISTIC FLT_LVL_0 FLT_LVL_1 FLT_LVL_2 FLT_LVL_3 /end REF_CHARACTERISTIC /begin REF_MEASUREMENT fdstmsrv_u8BattSysFltLvl /end REF_MEASUREMENT /end GROUP
/begin GROUP S190_HighVoltageConnect "xjmain/GOTO/fdst_calibration/ComponentFault/battery_fault_handling/HighVoltageConnect" /begin SUB_GROUP S196_Subsystem /end SUB_GROUP /begin REF_CHARACTERISTIC fdstc_isReqHVPwrOffGoOnOneCycTime /end REF_CHARACTERISTIC /begin REF_MEASUREMENT fdstmsrv_isSysFltBattHVEn /end REF_MEASUREMENT /end GROUP
/begin GROUP S191_Subsystem "xjmain/GOTO/fdst_calibration/ComponentFault/dmotor_fault_handling/Subsystem" /begin REF_CHARACTERISTIC FLT_LVL_3 /end REF_CHARACTERISTIC /begin REF_MEASUREMENT fdstmsrv_isSysFltDmcuEn /end REF_MEASUREMENT /end GROUP
/begin GROUP S191_TMBrTrqLmt "xjmain/GOTO/fdst_calibration/ComponentFault/dmotor_fault_handling/TMBrTrqLmt" /begin REF_CHARACTERISTIC FLT_LVL_2 /end REF_CHARACTERISTIC /begin REF_MEASUREMENT fdstmsrv_fSysFltDmcuBrTrqLmt /end REF_MEASUREMENT /end GROUP
/begin GROUP S191_TMDrTrqLmt "xjmain/GOTO/fdst_calibration/ComponentFault/dmotor_fault_handling/TMDrTrqLmt" /begin REF_CHARACTERISTIC FLT_LVL_2 /end REF_CHARACTERISTIC /begin REF_MEASUREMENT fdstmsrv_fSysFltDmcuDrTrqLmt /end REF_MEASUREMENT /end GROUP
/begin GROUP S191_fdstv_SysFlt "xjmain/GOTO/fdst_calibration/ComponentFault/dmotor_fault_handling/fdstv_SysFlt" /begin REF_CHARACTERISTIC FLT_LVL_0 FLT_LVL_1 FLT_LVL_2 FLT_LVL_3 /end REF_CHARACTERISTIC /begin REF_MEASUREMENT fdstmsrv_u8DmcuSysFltLvl /end REF_MEASUREMENT /end GROUP
/begin GROUP S202_BMS_FaultLevel "xjmain/GOTO/fdst_calibration/InputSignals/BMS_CANFault/BMS_FaultLevel" /begin REF_CHARACTERISTIC FLT_LVL_0 FLT_LVL_1 FLT_LVL_2 FLT_LVL_3 /end REF_CHARACTERISTIC /begin REF_MEASUREMENT fdstmsrv_u8BattCanFltLvl /end REF_MEASUREMENT /end GROUP
/begin GROUP S202_BMS_HVConnection "xjmain/GOTO/fdst_calibration/InputSignals/BMS_CANFault/BMS_HVConnection" /begin REF_CHARACTERISTIC FLT_LVL_1 FLT_LVL_2 FLT_LVL_3 /end REF_CHARACTERISTIC /begin REF_MEASUREMENT fdstmsrv_isCanFltBattHVEn /end REF_MEASUREMENT /end GROUP
/begin GROUP S202_BatteryChargePower "xjmain/GOTO/fdst_calibration/InputSignals/BMS_CANFault/BatteryChargePower" /begin REF_CHARACTERISTIC FLT_LVL_2 FLT_LVL_3 /end REF_CHARACTERISTIC /begin REF_MEASUREMENT fdstmsrv_fCanFltBattChgPwrLmt_kW /end REF_MEASUREMENT /end GROUP
/begin GROUP S202_BatteryDischargePower "xjmain/GOTO/fdst_calibration/InputSignals/BMS_CANFault/BatteryDischargePower" /begin REF_CHARACTERISTIC FLT_LVL_2 FLT_LVL_3 /end REF_CHARACTERISTIC /begin REF_MEASUREMENT fdstmsrv_fCanFltBattDisChgPwrLmt_kW /end REF_MEASUREMENT /end GROUP
/begin GROUP S203_MCU_TMEnable "xjmain/GOTO/fdst_calibration/InputSignals/MCU_CANFault/MCU_TMEnable" /begin REF_CHARACTERISTIC FLT_LVL_2 FLT_LVL_3 /end REF_CHARACTERISTIC /begin REF_MEASUREMENT fdstmsrv_isCanFltDmcuEn /end REF_MEASUREMENT /end GROUP
/begin GROUP S203_MCU_TMMaxTorque "xjmain/GOTO/fdst_calibration/InputSignals/MCU_CANFault/MCU_TMMaxTorque" /begin REF_CHARACTERISTIC FLT_LVL_2 FLT_LVL_3 /end REF_CHARACTERISTIC /begin REF_MEASUREMENT fdstmsrv_fCanFltDmcuDrTrqLmt /end REF_MEASUREMENT /end GROUP
/begin GROUP S203_MCU_TMMinTorque "xjmain/GOTO/fdst_calibration/InputSignals/MCU_CANFault/MCU_TMMinTorque" /begin REF_CHARACTERISTIC FLT_LVL_2 FLT_LVL_3 /end REF_CHARACTERISTIC /begin REF_MEASUREMENT fdstmsrv_fCanFltDmcuBrTrqLmt /end REF_MEASUREMENT /end GROUP
/begin GROUP S205_MCU_TMEnable "xjmain/GOTO/fdst_calibration/InputSignals/PMCU_CANFault/MCU_TMEnable" /begin REF_CHARACTERISTIC FLT_LVL_2 FLT_LVL_3 /end REF_CHARACTERISTIC /begin REF_MEASUREMENT fdstmsrv_isCanFltPmcuEn /end REF_MEASUREMENT /end GROUP
/begin GROUP S271_debounce1 "xjmain/GOTO/rbct_calibration/rbct_main/regen_condition_dicision/debounce1" /begin REF_CHARACTERISTIC rbctc_u8VehFltDebTime_ms /end REF_CHARACTERISTIC /end GROUP
/begin GROUP S284_ts "xjmain/GOTO/tfta_calibration/torque_damping/ts/ts" /begin REF_MEASUREMENT tftamsrv_fDmcuTrqReqBeforeLmt /end REF_MEASUREMENT /end GROUP
/begin GROUP S196_Subsystem "xjmain/GOTO/fdst_calibration/ComponentFault/battery_fault_handling/HighVoltageConnect/Subsystem" /begin REF_CHARACTERISTIC fdstc_u8ReqHVPwrOffDlyCycTime /end REF_CHARACTERISTIC /end GROUP
/end MODULE
/end PROJECT
