/******************************************************************************
* ASAP2 file: SC_KZQ_EV2274A_4_1.a2l
* Code generation for model "SC_KZQ_EV2274A_4_1".
* Model version : 8.215
* Simulink Coder version : 24.1 (R2024a) 19-Nov-2023
* C source code generated on : Fri Nov 15 09:22:03 2024
* Target selection: MPC5644A.tlc
* Embedded hardware selection: Freescale->MPC55xx
* Code generation objectives: Unspecified
* Validation result: Not run
* (add additional file header information here)
******************************************************************************/
/* Version 1.31 */
ASAP2_VERSION 1 31
/begin PROJECT ProjectName "Project Comment Goes Here"
/begin HEADER "Header Comments go here" /end HEADER
/begin MODULE ModuleName "Module Comment Goes Here"
/* EcoCoder v2.9.15 R2M3 Target:EV2274A verCalTool:0.0*/
/* XCP-En:0 XCPCalTool:CANape CANape XCP-CAN:CAN_CTRL_C XCP-CAN-Baud:250000bps*/
/* CCP-En:1 CCP-TYPE:Configurable CCPCalTool:CANape CCP-CAN:CAN_CTRL_B CCP-CAN-Baud:250000bps*/
/*PGCANAEn:NoUse PGCANAStation:NoUse PGCANABaud:500kbps PGCANACRO:NoUse PGCANADTO:NoUse*/
/*PGCANBEn:NoUse PGCANBStation:NoUse PGCANBBaud:250kbps PGCANBCRO:NoUse PGCANBDTO:NoUse*/
/*PGCANCEn:NoUse PGCANCStation:NoUse PGCANCBaud:250kbps PGCANCCRO:NoUse PGCANCDTO:NoUse*/
/*PGCANDEn:NoUse PGCANDStation:NoUse PGCANDBaud:NoUsekbps PGCANDCRO:NoUse PGCANDDTO:NoUse*/
/*ECO_XCP_Note_Start
/begin IF_DATA XCP
/begin PROTOCOL_LAYER
0x0100
0x07D0
0x2710
0x3E8
0x2710
0x3E8
0x19
0x19
0x08
0x08
BYTE_ORDER_MSB_FIRST
ADDRESS_GRANULARITY_BYTE
OPTIONAL_CMD ALLOC_ODT_ENTRY
OPTIONAL_CMD ALLOC_ODT
OPTIONAL_CMD ALLOC_DAQ
OPTIONAL_CMD FREE_DAQ
OPTIONAL_CMD GET_DAQ_EVENT_INFO
OPTIONAL_CMD GET_DAQ_RESOLUTION_INFO
OPTIONAL_CMD GET_DAQ_PROCESSOR_INFO
OPTIONAL_CMD START_STOP_SYNCH
OPTIONAL_CMD START_STOP_DAQ_LIST
OPTIONAL_CMD GET_DAQ_LIST_MODE
OPTIONAL_CMD SET_DAQ_LIST_MODE
OPTIONAL_CMD WRITE_DAQ
OPTIONAL_CMD SET_DAQ_PTR
OPTIONAL_CMD CLEAR_DAQ_LIST
OPTIONAL_CMD DOWNLOAD
OPTIONAL_CMD SHORT_UPLOAD
OPTIONAL_CMD UPLOAD
OPTIONAL_CMD SET_MTA
OPTIONAL_CMD UNLOCK
OPTIONAL_CMD GET_SEED
OPTIONAL_CMD GET_ID
OPTIONAL_CMD GET_COMM_MODE_INFO
OPTIONAL_CMD BUILD_CHECKSUM
SEED_AND_KEY_EXTERNAL_FUNCTION ""
/end PROTOCOL_LAYER
/begin DAQ
DYNAMIC
0x00
0x05
0x00
OPTIMISATION_TYPE_DEFAULT
ADDRESS_EXTENSION_FREE
IDENTIFICATION_FIELD_TYPE_ABSOLUTE
GRANULARITY_ODT_ENTRY_SIZE_DAQ_BYTE
0x07
OVERLOAD_INDICATION_PID
/begin STIM
GRANULARITY_ODT_ENTRY_SIZE_STIM_BYTE
0x07
/end STIM
/begin EVENT
"5ms"
"5ms"
0x00
DAQ
0x01
0x05
0x06
0x00
/end EVENT
/begin EVENT
"20ms"
"20ms"
0x01
DAQ
0x01
0x02
0x07
0x00
/end EVENT
/begin EVENT
"50ms"
"50ms"
0x02
DAQ
0x01
0x05
0x07
0x00
/end EVENT
/begin EVENT
"100ms"
"100ms"
0x03
DAQ
0x01
0x01
0x08
0x00
/end EVENT
/begin EVENT
"200ms"
"200m"
0x04
DAQ
0x01
0x02
0x08
0x00
/end EVENT
/end DAQ
/begin PAG
0x00
/end PAG
/begin PGM
PGM_MODE_ABSOLUTE
0x00
0x00
/end PGM
/begin XCP_ON_CAN
0x0100
CAN_ID_MASTER 0x100
CAN_ID_SLAVE 0x101
BAUDRATE 250000
SAMPLE_POINT 0x4B
SAMPLE_RATE SINGLE
BTL_CYCLES 0x08
SJW 0x02
SYNC_EDGE SINGLE
/end XCP_ON_CAN
/end IF_DATA
/begin IF_DATA CANAPE_ADDRESS_UPDATE
/end IF_DATA
/begin MOD_PAR "_default_ModParComment"
/begin MEMORY_SEGMENT _ROMCAL
"calibration_rom"
DATA
FLASH
INTERN
0x00FD0000
0x8000
-1 -1 -1 -1 -1
/begin IF_DATA XCP
/begin SEGMENT
0x00
0x01
0x00
0x00
0x00
/begin CHECKSUM
XCP_CRC_16_CITT
MAX_BLOCK_SIZE 0xFFFF
EXTERNAL_FUNCTION "String.Empty"
/end CHECKSUM
/begin PAGE
0x00
ECU_ACCESS_DONT_CARE
XCP_READ_ACCESS_DONT_CARE
XCP_WRITE_ACCESS_DONT_CARE
INIT_SEGMENT 0x00
/end PAGE
/begin ADDRESS_MAPPING
0x00FD0000
0x40000000
0x8000
/end ADDRESS_MAPPING
/end SEGMENT
/end IF_DATA
/end MEMORY_SEGMENT
/begin MEMORY_SEGMENT _CODE
"ecu_code"
CODE
FLASH
INTERN
0x01000200
0x1FFA00
-1 -1 -1 -1 -1
/end MEMORY_SEGMENT
/end MOD_PAR
ECO_XCP_Note_End*/
/*ECO_CCP_Note_Start*/
/begin MOD_PAR "_default_ModParComment" ADDR_EPK 0x01000100 EPK "EV2274A EcoCoder v2.9.15 R2M3 2024-11-15 09:22:10" /*EcoCoderINCAStart
/begin MEMORY_SEGMENT _RAMCAL
"calibration_ram"
DATA
RAM
INTERN
0x40000000
0x8000
-1 -1 -1 -1 -1
/end MEMORY_SEGMENT
EcoCoderINCAEnd*/
 /begin MEMORY_SEGMENT _ROMCAL "calibration_rom" DATA FLASH INTERN 0x00FD0000 0x8000 -1 -1 -1 -1 -1
  /begin IF_DATA ASAP1B_CCP /*EcoCoderINCAStart
ADDRESS_MAPPING 0x00FD0000 0x40000000 0x8000
EcoCoderINCAEnd*/ ADDR_MAPPING 0x00FD0000 0x40000000 0x8000 /end IF_DATA
 /end MEMORY_SEGMENT
 /begin MEMORY_SEGMENT _epk_data "epk_data" DATA FLASH INTERN 0x01000100 0xFF -1 -1 -1 -1 -1
  /begin IF_DATA ASAP1B_CCP /*EcoCoderINCAStart
ADDRESS_MAPPING 0x01000100 0x01000100 0xFF
EcoCoderINCAEnd*/ ADDR_MAPPING 0x01000100 0x01000100 0xFF /end IF_DATA
 /end MEMORY_SEGMENT
 /begin MEMORY_SEGMENT _CODE "ecu_code" CODE FLASH INTERN 0x01000200 0x1FFA00 -1 -1 -1 -1 -1 /end MEMORY_SEGMENT
/end MOD_PAR
/begin IF_DATA ASAP1B_CCP
 /begin SOURCE "20ms" 3 20 DISPLAY_IDENTIFIER DAQ2
  /begin QP_BLOB 1 LENGTH 0x20 CAN_ID_FIXED 0x101 RASTER 1 REDUCTION_ALLOWED FIRST_PID 0x3C /end QP_BLOB
 /end SOURCE
 /begin SOURCE "100ms" 3 100 DISPLAY_IDENTIFIER DAQ3
  /begin QP_BLOB 2 LENGTH 0x30 CAN_ID_FIXED 0x101 RASTER 2 REDUCTION_ALLOWED FIRST_PID 0x78 /end QP_BLOB
 /end SOURCE
 /begin SOURCE "1000ms" 3 1000 DISPLAY_IDENTIFIER DAQ3
  /begin QP_BLOB 3 LENGTH 0x40 CAN_ID_FIXED 0x101 RASTER 3 REDUCTION_ALLOWED FIRST_PID 0xA9 /end QP_BLOB
 /end SOURCE
 /begin RASTER "20ms" "20ms" 1 3 20 /end RASTER
 /begin RASTER "100ms" "100ms" 2 3 100 /end RASTER
 /begin RASTER "1000ms" "1000ms" 3 3 1000 /end RASTER
 /begin SEED_KEY "" "" "" /end SEED_KEY
 /begin CHECKSUM "CRC16.dll" /end CHECKSUM
 /begin TP_BLOB 0x0201 0x0204 0x100 0x101 0x112 1 BAUDRATE 250000 SAMPLE_POINT 70 SAMPLE_RATE 1 BTL_CYCLES 10 SJW 1 SYNC_EDGE SINGLE DAQ_MODE 0 CONSISTENCY 1 ADDRESS_EXTENSION 0 RESUME_SUPPORTED STORE_SUPPORTED
  /begin CHECKSUM_PARAM /*EcoCoderINCAStart
0x9001
EcoCoderINCAEnd*/ 0x0C 0xffffffff CHECKSUM_CALCULATION ACTIVE_PAGE /end CHECKSUM_PARAM
  /begin DEFINED_PAGES 0x00 "RAM_PAGE" 0x00 0x40000000 0x8000 RAM RAM_INIT_BY_ECU /end DEFINED_PAGES
  OPTIONAL_CMD 0X5 OPTIONAL_CMD 0X8 OPTIONAL_CMD 0X9 OPTIONAL_CMD 0XC OPTIONAL_CMD 0XD OPTIONAL_CMD 0XE OPTIONAL_CMD 0XF OPTIONAL_CMD 0X10 OPTIONAL_CMD 0X11 OPTIONAL_CMD 0X12 OPTIONAL_CMD 0X13 OPTIONAL_CMD 0X18 OPTIONAL_CMD 0X19 OPTIONAL_CMD 0X20 OPTIONAL_CMD 0X21 OPTIONAL_CMD 0X22 OPTIONAL_CMD 0X23 /end TP_BLOB
/end IF_DATA
/*ECO_CCP_Note_End*/
/begin MOD_COMMON "" /* Comment */ ALIGNMENT_BYTE 1 ALIGNMENT_WORD 1 ALIGNMENT_LONG 1 ALIGNMENT_FLOAT32_IEEE 1 ALIGNMENT_FLOAT64_IEEE 1 BYTE_ORDER MSB_FIRST DEPOSIT ABSOLUTE /end MOD_COMMON
/begin RECORD_LAYOUT Scalar_BOOLEAN FNC_VALUES 1 UBYTE COLUMN_DIR DIRECT /end RECORD_LAYOUT
/begin RECORD_LAYOUT Scalar_UBYTE FNC_VALUES 1 UBYTE COLUMN_DIR DIRECT /end RECORD_LAYOUT
/begin RECORD_LAYOUT Scalar_BYTE FNC_VALUES 1 SBYTE COLUMN_DIR DIRECT /end RECORD_LAYOUT
/begin RECORD_LAYOUT Scalar_UWORD FNC_VALUES 1 UWORD COLUMN_DIR DIRECT /end RECORD_LAYOUT
/begin RECORD_LAYOUT Scalar_SWORD FNC_VALUES 1 SWORD COLUMN_DIR DIRECT /end RECORD_LAYOUT
/begin RECORD_LAYOUT Scalar_ULONG FNC_VALUES 1 ULONG COLUMN_DIR DIRECT /end RECORD_LAYOUT
/begin RECORD_LAYOUT Scalar_LONG FNC_VALUES 1 SLONG COLUMN_DIR DIRECT /end RECORD_LAYOUT
/begin RECORD_LAYOUT Scalar_FLOAT32_IEEE FNC_VALUES 1 FLOAT32_IEEE COLUMN_DIR DIRECT /end RECORD_LAYOUT
/begin RECORD_LAYOUT Scalar_FLOAT64_IEEE FNC_VALUES 1 FLOAT64_IEEE COLUMN_DIR DIRECT /end RECORD_LAYOUT
/begin RECORD_LAYOUT Lookup1D_BOOLEAN FNC_VALUES 1 UBYTE COLUMN_DIR DIRECT /end RECORD_LAYOUT
/begin RECORD_LAYOUT Lookup1D_FLOAT32_IEEE FNC_VALUES 1 FLOAT32_IEEE COLUMN_DIR DIRECT /end RECORD_LAYOUT
/begin RECORD_LAYOUT Lookup1D_X_FLOAT32_IEEE AXIS_PTS_X 1 FLOAT32_IEEE INDEX_INCR DIRECT /end RECORD_LAYOUT
/begin RECORD_LAYOUT Lookup2D_FLOAT32_IEEE FNC_VALUES 1 FLOAT32_IEEE COLUMN_DIR DIRECT /end RECORD_LAYOUT
/begin RECORD_LAYOUT Lookup2D_X_FLOAT32_IEEE AXIS_PTS_X 1 FLOAT32_IEEE INDEX_INCR DIRECT /end RECORD_LAYOUT
/begin CHARACTERISTIC gcp_M1External_TopGear145KW_arPeakSpeed "特百佳145KW电机，峰值外特性的转矩" CURVE 0xfd1584 /* @ECU_Address@gcp_M1External_TopGear145KW_arPeakSpeed@ */ Lookup1D_FLOAT32_IEEE 0 SC_KZQ_EV2274A_4_1_CM_single_rpm -3.4E+38 3.4E+38
 /begin AXIS_DESCR COM_AXIS NO_INPUT_QUANTITY SC_KZQ_EV2274A_4_1_CM_single_N_m 9 -3.4E+38 3.4E+38 AXIS_PTS_REF gcp_M1External_TopGear145KW_arPeakTroque /end AXIS_DESCR
/end CHARACTERISTIC
/begin CHARACTERISTIC gcp_M1External_TopGear220KW_arPeakSpeed "特百佳220KW电机，峰值外特性的转矩" CURVE 0xfd15cc /* @ECU_Address@gcp_M1External_TopGear220KW_arPeakSpeed@ */ Lookup1D_FLOAT32_IEEE 0 SC_KZQ_EV2274A_4_1_CM_single_rpm -3.4E+38 3.4E+38
 /begin AXIS_DESCR COM_AXIS NO_INPUT_QUANTITY SC_KZQ_EV2274A_4_1_CM_single_N_m 12 -3.4E+38 3.4E+38 AXIS_PTS_REF gcp_M1External_TopGear220KW_arPeakTroque /end AXIS_DESCR
/end CHARACTERISTIC
/begin CHARACTERISTIC gcp_M1External_TopGear286KW_arPeakSpeed "特百佳286KW电机，峰值外特性的转矩" CURVE 0xfd162c /* @ECU_Address@gcp_M1External_TopGear286KW_arPeakSpeed@ */ Lookup1D_FLOAT32_IEEE 0 SC_KZQ_EV2274A_4_1_CM_single_rpm -3.4E+38 3.4E+38
 /begin AXIS_DESCR COM_AXIS NO_INPUT_QUANTITY SC_KZQ_EV2274A_4_1_CM_single_N_m 10 -3.4E+38 3.4E+38 AXIS_PTS_REF gcp_M1External_TopGear286KW_arPeakTroque /end AXIS_DESCR
/end CHARACTERISTIC
/begin CHARACTERISTIC gcp_M1Eff_TopGear145KW_aarEff "效率，为数据，m(转矩)*n（转速）的矩阵" MAP 0xfd0030 /* @ECU_Address@gcp_M1Eff_TopGear145KW_aarEff@ */ Lookup2D_FLOAT32_IEEE 0 SC_KZQ_EV2274A_4_1_CM_single____ -3.4E+38 3.4E+38
 /begin AXIS_DESCR COM_AXIS NO_INPUT_QUANTITY SC_KZQ_EV2274A_4_1_CM_single_rpm 12 -3.4E+38 3.4E+38 AXIS_PTS_REF gcp_M1Eff_TopGear145KW_arSpeed /end AXIS_DESCR
 /begin AXIS_DESCR COM_AXIS NO_INPUT_QUANTITY SC_KZQ_EV2274A_4_1_CM_single_N_m 42 -3.4E+38 3.4E+38 AXIS_PTS_REF gcp_M1Eff_TopGear145KW_arTorque /end AXIS_DESCR
/end CHARACTERISTIC
/begin CHARACTERISTIC gcp_M1Eff_TopGear220KW_aarEff "效率，为数据，m(转矩)*n（转速）的矩阵" MAP 0xfd08e8 /* @ECU_Address@gcp_M1Eff_TopGear220KW_aarEff@ */ Lookup2D_FLOAT32_IEEE 0 SC_KZQ_EV2274A_4_1_CM_single____ -3.4E+38 3.4E+38
 /begin AXIS_DESCR COM_AXIS NO_INPUT_QUANTITY SC_KZQ_EV2274A_4_1_CM_single_rpm 11 -3.4E+38 3.4E+38 AXIS_PTS_REF gcp_M1Eff_TopGear220KW_arSpeed /end AXIS_DESCR
 /begin AXIS_DESCR COM_AXIS NO_INPUT_QUANTITY SC_KZQ_EV2274A_4_1_CM_single_N_m 28 -3.4E+38 3.4E+38 AXIS_PTS_REF gcp_M1Eff_TopGear220KW_arTorque /end AXIS_DESCR
/end CHARACTERISTIC
/begin CHARACTERISTIC gcp_M1Eff_TopGear286KW_aarEff "效率，为数据，m(转矩)*n（转速）的矩阵" MAP 0xfd0e54 /* @ECU_Address@gcp_M1Eff_TopGear286KW_aarEff@ */ Lookup2D_FLOAT32_IEEE 0 SC_KZQ_EV2274A_4_1_CM_single____ -3.4E+38 3.4E+38
 /begin AXIS_DESCR COM_AXIS NO_INPUT_QUANTITY SC_KZQ_EV2274A_4_1_CM_single_rpm 10 -3.4E+38 3.4E+38 AXIS_PTS_REF gcp_M1Eff_TopGear286KW_arSpeed /end AXIS_DESCR
 /begin AXIS_DESCR COM_AXIS NO_INPUT_QUANTITY SC_KZQ_EV2274A_4_1_CM_single_N_m 20 -3.4E+38 3.4E+38 AXIS_PTS_REF gcp_M1Eff_TopGear286KW_arTorque /end AXIS_DESCR
/end CHARACTERISTIC
/begin CHARACTERISTIC test_cal_double "初始的机型版本" VALUE 0xfd1828 /* @ECU_Address@test_cal_double@ */ Scalar_FLOAT64_IEEE 0 SC_KZQ_EV2274A_4_1_CM_double -1.7E+308 1.7E+308 /end CHARACTERISTIC
/begin CHARACTERISTIC System_gcp_eMachineModel "初始的机型版本" VALUE 0xfd0000 /* @ECU_Address@System_gcp_eMachineModel@ */ Scalar_ULONG 0 SC_KZQ_EV2274A_4_1_CM_XJMachineModelEnum 58982657 104857857 /end CHARACTERISTIC
/begin CHARACTERISTIC test_cal_enum "初始的机型版本" VALUE 0xfd1830 /* @ECU_Address@test_cal_enum@ */ Scalar_ULONG 0 SC_KZQ_EV2274A_4_1_CM_XJMachineModelEnum 58982657 104857857 /end CHARACTERISTIC
/begin CHARACTERISTIC test_cal_s32 "初始的机型版本" VALUE 0xfd183c /* @ECU_Address@test_cal_s32@ */ Scalar_LONG 0 SC_KZQ_EV2274A_4_1_CM_int32 -2147483648 2147483647 /end CHARACTERISTIC
/begin CHARACTERISTIC gcp_M1test_1_5 "特百佳315KW电机，峰值外特性的转矩" VAL_BLK 0xfd16cc /* @ECU_Address@gcp_M1test_1_5@ */ Scalar_FLOAT32_IEEE 0 SC_KZQ_EV2274A_4_1_CM_single_test -3.4E+38 3.4E+38 NUMBER 5 /end CHARACTERISTIC
/begin CHARACTERISTIC gcp_M1test_2_5 "特百佳315KW电机，峰值外特性的转矩" VAL_BLK 0xfd16e0 /* @ECU_Address@gcp_M1test_2_5@ */ Scalar_FLOAT32_IEEE 0 SC_KZQ_EV2274A_4_1_CM_single_test -3.4E+38 3.4E+38 NUMBER 10 /end CHARACTERISTIC
/begin CHARACTERISTIC gcp_M1test_6_1 "特百佳315KW电机，峰值外特性的转矩" VAL_BLK 0xfd1708 /* @ECU_Address@gcp_M1test_6_1@ */ Scalar_FLOAT32_IEEE 0 SC_KZQ_EV2274A_4_1_CM_single_test -3.4E+38 3.4E+38 NUMBER 6 /end CHARACTERISTIC
/begin CHARACTERISTIC gcp_M1test_6_2 "特百佳315KW电机，峰值外特性的转矩" VAL_BLK 0xfd1720 /* @ECU_Address@gcp_M1test_6_2@ */ Scalar_FLOAT32_IEEE 0 SC_KZQ_EV2274A_4_1_CM_single_test -3.4E+38 3.4E+38 NUMBER 12 /end CHARACTERISTIC
/begin CHARACTERISTIC in_A1_rM2HighSpeed_gp "" VALUE 0xfd1754 /* @ECU_Address@in_A1_rM2HighSpeed_gp@ */ Scalar_FLOAT32_IEEE 0 SC_KZQ_EV2274A_4_1_CM_single -3.4E+38 3.4E+38 /end CHARACTERISTIC
/begin CHARACTERISTIC in_A1_rM2LowSpeed_gp "" VALUE 0xfd1758 /* @ECU_Address@in_A1_rM2LowSpeed_gp@ */ Scalar_FLOAT32_IEEE 0 SC_KZQ_EV2274A_4_1_CM_single -3.4E+38 3.4E+38 /end CHARACTERISTIC
/begin CHARACTERISTIC in_A1_rMaxAllowedChargePower_gp "" VALUE 0xfd175c /* @ECU_Address@in_A1_rMaxAllowedChargePower_gp@ */ Scalar_FLOAT32_IEEE 0 SC_KZQ_EV2274A_4_1_CM_single -3.4E+38 3.4E+38 /end CHARACTERISTIC
/begin CHARACTERISTIC in_BMS_rChargeCurrentCmd_gp "" VALUE 0xfd1764 /* @ECU_Address@in_BMS_rChargeCurrentCmd_gp@ */ Scalar_FLOAT32_IEEE 0 SC_KZQ_EV2274A_4_1_CM_single -3.4E+38 3.4E+38 /end CHARACTERISTIC
/begin CHARACTERISTIC in_BMS_rChargeLimitErr_gp "" VALUE 0xfd1768 /* @ECU_Address@in_BMS_rChargeLimitErr_gp@ */ Scalar_FLOAT32_IEEE 0 SC_KZQ_EV2274A_4_1_CM_single -3.4E+38 3.4E+38 /end CHARACTERISTIC
/begin CHARACTERISTIC in_BMS_rCoolingPower_gp "" VALUE 0xfd176c /* @ECU_Address@in_BMS_rCoolingPower_gp@ */ Scalar_FLOAT32_IEEE 0 SC_KZQ_EV2274A_4_1_CM_single -3.4E+38 3.4E+38 /end CHARACTERISTIC
/begin CHARACTERISTIC in_BMS_rCurrent_gp "" VALUE 0xfd1770 /* @ECU_Address@in_BMS_rCurrent_gp@ */ Scalar_FLOAT32_IEEE 0 SC_KZQ_EV2274A_4_1_CM_single -3.4E+38 3.4E+38 /end CHARACTERISTIC
/begin CHARACTERISTIC in_BMS_rDischargeLimitErrTemp_gp "" VALUE 0xfd1774 /* @ECU_Address@in_BMS_rDischargeLimitErrTemp_gp@ */ Scalar_FLOAT32_IEEE 0 SC_KZQ_EV2274A_4_1_CM_single -3.4E+38 3.4E+38 /end CHARACTERISTIC
/begin CHARACTERISTIC in_BMS_rMaxAviableChargeCurrent_gp "" VALUE 0xfd1778 /* @ECU_Address@in_BMS_rMaxAviableChargeCurrent_gp@ */ Scalar_FLOAT32_IEEE 0 SC_KZQ_EV2274A_4_1_CM_single -3.4E+38 3.4E+38 /end CHARACTERISTIC
/begin CHARACTERISTIC in_BMS_rMaxAviableDischargeCurrent_gp "" VALUE 0xfd177c /* @ECU_Address@in_BMS_rMaxAviableDischargeCurrent_gp@ */ Scalar_FLOAT32_IEEE 0 SC_KZQ_EV2274A_4_1_CM_single -3.4E+38 3.4E+38 /end CHARACTERISTIC
/begin CHARACTERISTIC in_BMS_rMaxAviableTemperature_gp "" VALUE 0xfd1780 /* @ECU_Address@in_BMS_rMaxAviableTemperature_gp@ */ Scalar_FLOAT32_IEEE 0 SC_KZQ_EV2274A_4_1_CM_single -3.4E+38 3.4E+38 /end CHARACTERISTIC
/begin CHARACTERISTIC in_BMS_rMaxAviableVoltage_gp "" VALUE 0xfd1784 /* @ECU_Address@in_BMS_rMaxAviableVoltage_gp@ */ Scalar_FLOAT32_IEEE 0 SC_KZQ_EV2274A_4_1_CM_single -3.4E+38 3.4E+38 /end CHARACTERISTIC
/begin CHARACTERISTIC in_BMS_rSOC_gp "" VALUE 0xfd1788 /* @ECU_Address@in_BMS_rSOC_gp@ */ Scalar_FLOAT32_IEEE 0 SC_KZQ_EV2274A_4_1_CM_single -3.4E+38 3.4E+38 /end CHARACTERISTIC
/begin CHARACTERISTIC in_BMS_rTemperature_gp "" VALUE 0xfd178c /* @ECU_Address@in_BMS_rTemperature_gp@ */ Scalar_FLOAT32_IEEE 0 SC_KZQ_EV2274A_4_1_CM_single -3.4E+38 3.4E+38 /end CHARACTERISTIC
/begin CHARACTERISTIC in_BMS_rVoltage_gp "" VALUE 0xfd1790 /* @ECU_Address@in_BMS_rVoltage_gp@ */ Scalar_FLOAT32_IEEE 0 SC_KZQ_EV2274A_4_1_CM_single -3.4E+38 3.4E+38 /end CHARACTERISTIC
/begin CHARACTERISTIC in_M1_rACCurrent_gp "" VALUE 0xfd179c /* @ECU_Address@in_M1_rACCurrent_gp@ */ Scalar_FLOAT32_IEEE 0 SC_KZQ_EV2274A_4_1_CM_single -3.4E+38 3.4E+38 /end CHARACTERISTIC
/begin CHARACTERISTIC in_M1_rACVoltage_gp "" VALUE 0xfd17a0 /* @ECU_Address@in_M1_rACVoltage_gp@ */ Scalar_FLOAT32_IEEE 0 SC_KZQ_EV2274A_4_1_CM_single -3.4E+38 3.4E+38 /end CHARACTERISTIC
/begin CHARACTERISTIC in_M1_rBusCurrent_gp "" VALUE 0xfd17a4 /* @ECU_Address@in_M1_rBusCurrent_gp@ */ Scalar_FLOAT32_IEEE 0 SC_KZQ_EV2274A_4_1_CM_single -3.4E+38 3.4E+38 /end CHARACTERISTIC
/begin CHARACTERISTIC in_M1_rBusVoltage_gp "" VALUE 0xfd17a8 /* @ECU_Address@in_M1_rBusVoltage_gp@ */ Scalar_FLOAT32_IEEE 0 SC_KZQ_EV2274A_4_1_CM_single -3.4E+38 3.4E+38 /end CHARACTERISTIC
/begin CHARACTERISTIC in_M1_rControllerTemp_gp "" VALUE 0xfd17ac /* @ECU_Address@in_M1_rControllerTemp_gp@ */ Scalar_FLOAT32_IEEE 0 SC_KZQ_EV2274A_4_1_CM_single -3.4E+38 3.4E+38 /end CHARACTERISTIC
/begin CHARACTERISTIC in_M1_rLimitErr_gp "" VALUE 0xfd17b0 /* @ECU_Address@in_M1_rLimitErr_gp@ */ Scalar_FLOAT32_IEEE 0 SC_KZQ_EV2274A_4_1_CM_single -3.4E+38 3.4E+38 /end CHARACTERISTIC
/begin CHARACTERISTIC in_M1_rMotorTemp_gp "" VALUE 0xfd17b4 /* @ECU_Address@in_M1_rMotorTemp_gp@ */ Scalar_FLOAT32_IEEE 0 SC_KZQ_EV2274A_4_1_CM_single -3.4E+38 3.4E+38 /end CHARACTERISTIC
/begin CHARACTERISTIC in_M1_rSpeed_gp "" VALUE 0xfd17b8 /* @ECU_Address@in_M1_rSpeed_gp@ */ Scalar_FLOAT32_IEEE 0 SC_KZQ_EV2274A_4_1_CM_single -3.4E+38 3.4E+38 /end CHARACTERISTIC
/begin CHARACTERISTIC in_M1_rTorqueNegtiveLimit_gp "" VALUE 0xfd17bc /* @ECU_Address@in_M1_rTorqueNegtiveLimit_gp@ */ Scalar_FLOAT32_IEEE 0 SC_KZQ_EV2274A_4_1_CM_single -3.4E+38 3.4E+38 /end CHARACTERISTIC
/begin CHARACTERISTIC in_M1_rTorquePositiveLimit_gp "" VALUE 0xfd17c0 /* @ECU_Address@in_M1_rTorquePositiveLimit_gp@ */ Scalar_FLOAT32_IEEE 0 SC_KZQ_EV2274A_4_1_CM_single -3.4E+38 3.4E+38 /end CHARACTERISTIC
/begin CHARACTERISTIC in_M1_rTorque_gp "" VALUE 0xfd17c4 /* @ECU_Address@in_M1_rTorque_gp@ */ Scalar_FLOAT32_IEEE 0 SC_KZQ_EV2274A_4_1_CM_single -3.4E+38 3.4E+38 /end CHARACTERISTIC
/begin CHARACTERISTIC in_M2_rACCurrent_gp "" VALUE 0xfd17cc /* @ECU_Address@in_M2_rACCurrent_gp@ */ Scalar_FLOAT32_IEEE 0 SC_KZQ_EV2274A_4_1_CM_single -3.4E+38 3.4E+38 /end CHARACTERISTIC
/begin CHARACTERISTIC in_M2_rACVoltage_gp "" VALUE 0xfd17d0 /* @ECU_Address@in_M2_rACVoltage_gp@ */ Scalar_FLOAT32_IEEE 0 SC_KZQ_EV2274A_4_1_CM_single -3.4E+38 3.4E+38 /end CHARACTERISTIC
/begin CHARACTERISTIC in_M2_rBusCurrent_gp "" VALUE 0xfd17d4 /* @ECU_Address@in_M2_rBusCurrent_gp@ */ Scalar_FLOAT32_IEEE 0 SC_KZQ_EV2274A_4_1_CM_single -3.4E+38 3.4E+38 /end CHARACTERISTIC
/begin CHARACTERISTIC in_M2_rBusVoltage_gp "" VALUE 0xfd17d8 /* @ECU_Address@in_M2_rBusVoltage_gp@ */ Scalar_FLOAT32_IEEE 0 SC_KZQ_EV2274A_4_1_CM_single -3.4E+38 3.4E+38 /end CHARACTERISTIC
/begin CHARACTERISTIC in_M2_rControllerTemp_gp "" VALUE 0xfd17dc /* @ECU_Address@in_M2_rControllerTemp_gp@ */ Scalar_FLOAT32_IEEE 0 SC_KZQ_EV2274A_4_1_CM_single -3.4E+38 3.4E+38 /end CHARACTERISTIC
/begin CHARACTERISTIC in_M2_rLimitErr_gp "" VALUE 0xfd17e0 /* @ECU_Address@in_M2_rLimitErr_gp@ */ Scalar_FLOAT32_IEEE 0 SC_KZQ_EV2274A_4_1_CM_single -3.4E+38 3.4E+38 /end CHARACTERISTIC
/begin CHARACTERISTIC in_M2_rMotorTemp_gp "" VALUE 0xfd17e4 /* @ECU_Address@in_M2_rMotorTemp_gp@ */ Scalar_FLOAT32_IEEE 0 SC_KZQ_EV2274A_4_1_CM_single -3.4E+38 3.4E+38 /end CHARACTERISTIC
/begin CHARACTERISTIC in_M2_rSpeed_gp "" VALUE 0xfd17e8 /* @ECU_Address@in_M2_rSpeed_gp@ */ Scalar_FLOAT32_IEEE 0 SC_KZQ_EV2274A_4_1_CM_single -3.4E+38 3.4E+38 /end CHARACTERISTIC
/begin CHARACTERISTIC in_M2_rTorque_gp "" VALUE 0xfd17ec /* @ECU_Address@in_M2_rTorque_gp@ */ Scalar_FLOAT32_IEEE 0 SC_KZQ_EV2274A_4_1_CM_single -3.4E+38 3.4E+38 /end CHARACTERISTIC
/begin CHARACTERISTIC in_OBC_rCurrent_gp "" VALUE 0xfd17f8 /* @ECU_Address@in_OBC_rCurrent_gp@ */ Scalar_FLOAT32_IEEE 0 SC_KZQ_EV2274A_4_1_CM_single -3.4E+38 3.4E+38 /end CHARACTERISTIC
/begin CHARACTERISTIC in_OBC_rVoltage_gp "" VALUE 0xfd17fc /* @ECU_Address@in_OBC_rVoltage_gp@ */ Scalar_FLOAT32_IEEE 0 SC_KZQ_EV2274A_4_1_CM_single -3.4E+38 3.4E+38 /end CHARACTERISTIC
/begin CHARACTERISTIC test_cal_float "初始的机型版本" VALUE 0xfd1834 /* @ECU_Address@test_cal_float@ */ Scalar_FLOAT32_IEEE 0 SC_KZQ_EV2274A_4_1_CM_single -3.4E+38 3.4E+38 /end CHARACTERISTIC
/begin CHARACTERISTIC core_gp_u32SystemCountingFre "" VALUE 0xfd0010 /* @ECU_Address@core_gp_u32SystemCountingFre@ */ Scalar_ULONG 0 SC_KZQ_EV2274A_4_1_CM_uint32 0 4294967295 /end CHARACTERISTIC
/begin CHARACTERISTIC test_cal_u32 "初始的机型版本" VALUE 0xfd1844 /* @ECU_Address@test_cal_u32@ */ Scalar_ULONG 0 SC_KZQ_EV2274A_4_1_CM_uint32 0 4294967295 /end CHARACTERISTIC
/begin CHARACTERISTIC test_cal_s16 "初始的机型版本" VALUE 0xfd1838 /* @ECU_Address@test_cal_s16@ */ Scalar_SWORD 0 SC_KZQ_EV2274A_4_1_CM_int16 -32768 32767 /end CHARACTERISTIC
/begin CHARACTERISTIC in_u16BQ1_gp "" VALUE 0xfd1804 /* @ECU_Address@in_u16BQ1_gp@ */ Scalar_UWORD 0 SC_KZQ_EV2274A_4_1_CM_uint16 0 65535 /end CHARACTERISTIC
/begin CHARACTERISTIC in_u16BQ2_gp "" VALUE 0xfd1806 /* @ECU_Address@in_u16BQ2_gp@ */ Scalar_UWORD 0 SC_KZQ_EV2274A_4_1_CM_uint16 0 65535 /end CHARACTERISTIC
/begin CHARACTERISTIC in_u16BQ3_gp "" VALUE 0xfd1808 /* @ECU_Address@in_u16BQ3_gp@ */ Scalar_UWORD 0 SC_KZQ_EV2274A_4_1_CM_uint16 0 65535 /end CHARACTERISTIC
/begin CHARACTERISTIC in_u16BQ4_gp "" VALUE 0xfd180a /* @ECU_Address@in_u16BQ4_gp@ */ Scalar_UWORD 0 SC_KZQ_EV2274A_4_1_CM_uint16 0 65535 /end CHARACTERISTIC
/begin CHARACTERISTIC in_u16RM1A_gp "" VALUE 0xfd180c /* @ECU_Address@in_u16RM1A_gp@ */ Scalar_UWORD 0 SC_KZQ_EV2274A_4_1_CM_uint16 0 65535 /end CHARACTERISTIC
/begin CHARACTERISTIC in_u16RM1_gp "" VALUE 0xfd180e /* @ECU_Address@in_u16RM1_gp@ */ Scalar_UWORD 0 SC_KZQ_EV2274A_4_1_CM_uint16 0 65535 /end CHARACTERISTIC
/begin CHARACTERISTIC test_cal_u16 "初始的机型版本" VALUE 0xfd1842 /* @ECU_Address@test_cal_u16@ */ Scalar_UWORD 0 SC_KZQ_EV2274A_4_1_CM_uint16 0 65535 /end CHARACTERISTIC
/begin CHARACTERISTIC fbM1GearControl_eCurrentGearFeedback_gp "" VALUE 0xfd0021 /* @ECU_Address@fbM1GearControl_eCurrentGearFeedback_gp@ */ Scalar_BYTE 0 SC_KZQ_EV2274A_4_1_CM_XJGearLevelEnum -1 4 /end CHARACTERISTIC
/begin CHARACTERISTIC fbM1GearControl_eTargetGearFeedback_gp "" VALUE 0xfd0022 /* @ECU_Address@fbM1GearControl_eTargetGearFeedback_gp@ */ Scalar_BYTE 0 SC_KZQ_EV2274A_4_1_CM_XJGearLevelEnum -1 4 /end CHARACTERISTIC
/begin CHARACTERISTIC gs_M1_eMotorModel_gp "" VALUE 0xfd1750 /* @ECU_Address@gs_M1_eMotorModel_gp@ */ Scalar_UBYTE 0 SC_KZQ_EV2274A_4_1_CM_XJMotroModelEnum 5 255 /end CHARACTERISTIC
/begin CHARACTERISTIC gs_M2_eMotorModel_gp "" VALUE 0xfd1751 /* @ECU_Address@gs_M2_eMotorModel_gp@ */ Scalar_UBYTE 0 SC_KZQ_EV2274A_4_1_CM_XJMotroModelEnum 5 255 /end CHARACTERISTIC
/begin CHARACTERISTIC System_gp_Model_xSimulation "" VALUE 0xfd0004 /* @ECU_Address@System_gp_Model_xSimulation@ */ Scalar_BOOLEAN 0 SC_KZQ_EV2274A_4_1_CM_boolean 0 1 /end CHARACTERISTIC
/begin CHARACTERISTIC System_gp_Model_xVirtualTest "" VALUE 0xfd0005 /* @ECU_Address@System_gp_Model_xVirtualTest@ */ Scalar_BOOLEAN 0 SC_KZQ_EV2274A_4_1_CM_boolean 0 1 /end CHARACTERISTIC
/begin CHARACTERISTIC fbBMSPower_xOffProcessDone_gp "" VALUE 0xfd0015 /* @ECU_Address@fbBMSPower_xOffProcessDone_gp@ */ Scalar_BOOLEAN 0 SC_KZQ_EV2274A_4_1_CM_boolean 0 1 /end CHARACTERISTIC
/begin CHARACTERISTIC fbBMSPower_xOffWaitingDone_gp "" VALUE 0xfd0016 /* @ECU_Address@fbBMSPower_xOffWaitingDone_gp@ */ Scalar_BOOLEAN 0 SC_KZQ_EV2274A_4_1_CM_boolean 0 1 /end CHARACTERISTIC
/begin CHARACTERISTIC fbBMSPower_xOnProcessDone_gp "" VALUE 0xfd0017 /* @ECU_Address@fbBMSPower_xOnProcessDone_gp@ */ Scalar_BOOLEAN 0 SC_KZQ_EV2274A_4_1_CM_boolean 0 1 /end CHARACTERISTIC
/begin CHARACTERISTIC fbBMSPower_xOnProcessErr_gp "" VALUE 0xfd0018 /* @ECU_Address@fbBMSPower_xOnProcessErr_gp@ */ Scalar_BOOLEAN 0 SC_KZQ_EV2274A_4_1_CM_boolean 0 1 /end CHARACTERISTIC
/begin CHARACTERISTIC fbBMSPower_xPowerHoldErr_gp "" VALUE 0xfd0019 /* @ECU_Address@fbBMSPower_xPowerHoldErr_gp@ */ Scalar_BOOLEAN 0 SC_KZQ_EV2274A_4_1_CM_boolean 0 1 /end CHARACTERISTIC
/begin CHARACTERISTIC fbBMSPower_xStandbyErr_gp "" VALUE 0xfd001a /* @ECU_Address@fbBMSPower_xStandbyErr_gp@ */ Scalar_BOOLEAN 0 SC_KZQ_EV2274A_4_1_CM_boolean 0 1 /end CHARACTERISTIC
/begin CHARACTERISTIC fbDCAC2Power_xOffProcessDone_gp "" VALUE 0xfd001b /* @ECU_Address@fbDCAC2Power_xOffProcessDone_gp@ */ Scalar_BOOLEAN 0 SC_KZQ_EV2274A_4_1_CM_boolean 0 1 /end CHARACTERISTIC
/begin CHARACTERISTIC fbDCAC2Power_xOnProcessDone_gp "" VALUE 0xfd001c /* @ECU_Address@fbDCAC2Power_xOnProcessDone_gp@ */ Scalar_BOOLEAN 0 SC_KZQ_EV2274A_4_1_CM_boolean 0 1 /end CHARACTERISTIC
/begin CHARACTERISTIC fbDCACPower_xOffProcessDone_gp "" VALUE 0xfd001d /* @ECU_Address@fbDCACPower_xOffProcessDone_gp@ */ Scalar_BOOLEAN 0 SC_KZQ_EV2274A_4_1_CM_boolean 0 1 /end CHARACTERISTIC
/begin CHARACTERISTIC fbDCACPower_xOnProcessDone_gp "" VALUE 0xfd001e /* @ECU_Address@fbDCACPower_xOnProcessDone_gp@ */ Scalar_BOOLEAN 0 SC_KZQ_EV2274A_4_1_CM_boolean 0 1 /end CHARACTERISTIC
/begin CHARACTERISTIC fbDCDCPower_xOffProcessDone_gp "" VALUE 0xfd001f /* @ECU_Address@fbDCDCPower_xOffProcessDone_gp@ */ Scalar_BOOLEAN 0 SC_KZQ_EV2274A_4_1_CM_boolean 0 1 /end CHARACTERISTIC
/begin CHARACTERISTIC fbDCDCPower_xOnProcessDone_gp "" VALUE 0xfd0020 /* @ECU_Address@fbDCDCPower_xOnProcessDone_gp@ */ Scalar_BOOLEAN 0 SC_KZQ_EV2274A_4_1_CM_boolean 0 1 /end CHARACTERISTIC
/begin CHARACTERISTIC fbM1Power_xOffContactorDone_gp "" VALUE 0xfd0023 /* @ECU_Address@fbM1Power_xOffContactorDone_gp@ */ Scalar_BOOLEAN 0 SC_KZQ_EV2274A_4_1_CM_boolean 0 1 /end CHARACTERISTIC
/begin CHARACTERISTIC fbM1Power_xOffControllerDone_gp "" VALUE 0xfd0024 /* @ECU_Address@fbM1Power_xOffControllerDone_gp@ */ Scalar_BOOLEAN 0 SC_KZQ_EV2274A_4_1_CM_boolean 0 1 /end CHARACTERISTIC
/begin CHARACTERISTIC fbM1Power_xOffMotorDone_gp "" VALUE 0xfd0025 /* @ECU_Address@fbM1Power_xOffMotorDone_gp@ */ Scalar_BOOLEAN 0 SC_KZQ_EV2274A_4_1_CM_boolean 0 1 /end CHARACTERISTIC
/begin CHARACTERISTIC fbM1Power_xOnContactorDone_gp "" VALUE 0xfd0026 /* @ECU_Address@fbM1Power_xOnContactorDone_gp@ */ Scalar_BOOLEAN 0 SC_KZQ_EV2274A_4_1_CM_boolean 0 1 /end CHARACTERISTIC
/begin CHARACTERISTIC fbM1Power_xPreChargeDone_gp "" VALUE 0xfd0027 /* @ECU_Address@fbM1Power_xPreChargeDone_gp@ */ Scalar_BOOLEAN 0 SC_KZQ_EV2274A_4_1_CM_boolean 0 1 /end CHARACTERISTIC
/begin CHARACTERISTIC fbM2Power_xOffContactorDone_gp "" VALUE 0xfd0028 /* @ECU_Address@fbM2Power_xOffContactorDone_gp@ */ Scalar_BOOLEAN 0 SC_KZQ_EV2274A_4_1_CM_boolean 0 1 /end CHARACTERISTIC
/begin CHARACTERISTIC fbM2Power_xOffControllerDone_gp "" VALUE 0xfd0029 /* @ECU_Address@fbM2Power_xOffControllerDone_gp@ */ Scalar_BOOLEAN 0 SC_KZQ_EV2274A_4_1_CM_boolean 0 1 /end CHARACTERISTIC
/begin CHARACTERISTIC fbM2Power_xOffMotorDone_gp "" VALUE 0xfd002a /* @ECU_Address@fbM2Power_xOffMotorDone_gp@ */ Scalar_BOOLEAN 0 SC_KZQ_EV2274A_4_1_CM_boolean 0 1 /end CHARACTERISTIC
/begin CHARACTERISTIC fbM2Power_xOnContactorDone_gp "" VALUE 0xfd002b /* @ECU_Address@fbM2Power_xOnContactorDone_gp@ */ Scalar_BOOLEAN 0 SC_KZQ_EV2274A_4_1_CM_boolean 0 1 /end CHARACTERISTIC
/begin CHARACTERISTIC fbM2Power_xOnPreChargeDone_gp "" VALUE 0xfd002c /* @ECU_Address@fbM2Power_xOnPreChargeDone_gp@ */ Scalar_BOOLEAN 0 SC_KZQ_EV2274A_4_1_CM_boolean 0 1 /end CHARACTERISTIC
/begin CHARACTERISTIC fbOBCPower_xOffProcessDone_gp "" VALUE 0xfd002d /* @ECU_Address@fbOBCPower_xOffProcessDone_gp@ */ Scalar_BOOLEAN 0 SC_KZQ_EV2274A_4_1_CM_boolean 0 1 /end CHARACTERISTIC
/begin CHARACTERISTIC fbOBCPower_xOnProcessDone_gp "" VALUE 0xfd002e /* @ECU_Address@fbOBCPower_xOnProcessDone_gp@ */ Scalar_BOOLEAN 0 SC_KZQ_EV2274A_4_1_CM_boolean 0 1 /end CHARACTERISTIC
/begin CHARACTERISTIC in_A1_xACChargeModeRequest_gp "" VALUE 0xfd1760 /* @ECU_Address@in_A1_xACChargeModeRequest_gp@ */ Scalar_BOOLEAN 0 SC_KZQ_EV2274A_4_1_CM_boolean 0 1 /end CHARACTERISTIC
/begin CHARACTERISTIC in_A1_xACRechargeModeRequest_gp "" VALUE 0xfd1761 /* @ECU_Address@in_A1_xACRechargeModeRequest_gp@ */ Scalar_BOOLEAN 0 SC_KZQ_EV2274A_4_1_CM_boolean 0 1 /end CHARACTERISTIC
/begin CHARACTERISTIC in_A1_xChargeRequest_gp "" VALUE 0xfd1762 /* @ECU_Address@in_A1_xChargeRequest_gp@ */ Scalar_BOOLEAN 0 SC_KZQ_EV2274A_4_1_CM_boolean 0 1 /end CHARACTERISTIC
/begin CHARACTERISTIC in_A1_xRemoteRequestAviable_gp "" VALUE 0xfd1763 /* @ECU_Address@in_A1_xRemoteRequestAviable_gp@ */ Scalar_BOOLEAN 0 SC_KZQ_EV2274A_4_1_CM_boolean 0 1 /end CHARACTERISTIC
/begin CHARACTERISTIC in_BMS_xChargeCmd_gp "" VALUE 0xfd1794 /* @ECU_Address@in_BMS_xChargeCmd_gp@ */ Scalar_BOOLEAN 0 SC_KZQ_EV2274A_4_1_CM_boolean 0 1 /end CHARACTERISTIC
/begin CHARACTERISTIC in_BMS_xCooling_gp "" VALUE 0xfd1795 /* @ECU_Address@in_BMS_xCooling_gp@ */ Scalar_BOOLEAN 0 SC_KZQ_EV2274A_4_1_CM_boolean 0 1 /end CHARACTERISTIC
/begin CHARACTERISTIC in_BMS_xHeating_gp "" VALUE 0xfd1796 /* @ECU_Address@in_BMS_xHeating_gp@ */ Scalar_BOOLEAN 0 SC_KZQ_EV2274A_4_1_CM_boolean 0 1 /end CHARACTERISTIC
/begin CHARACTERISTIC in_BMS_xLimpErr_gp "" VALUE 0xfd1797 /* @ECU_Address@in_BMS_xLimpErr_gp@ */ Scalar_BOOLEAN 0 SC_KZQ_EV2274A_4_1_CM_boolean 0 1 /end CHARACTERISTIC
/begin CHARACTERISTIC in_BMS_xPowerOffRequestFromBMS_gp "" VALUE 0xfd1798 /* @ECU_Address@in_BMS_xPowerOffRequestFromBMS_gp@ */ Scalar_BOOLEAN 0 SC_KZQ_EV2274A_4_1_CM_boolean 0 1 /end CHARACTERISTIC
/begin CHARACTERISTIC in_DCAC2Control_xErr_gp "" VALUE 0xfd1799 /* @ECU_Address@in_DCAC2Control_xErr_gp@ */ Scalar_BOOLEAN 0 SC_KZQ_EV2274A_4_1_CM_boolean 0 1 /end CHARACTERISTIC
/begin CHARACTERISTIC in_DCDCControl_xErr_gp "" VALUE 0xfd179a /* @ECU_Address@in_DCDCControl_xErr_gp@ */ Scalar_BOOLEAN 0 SC_KZQ_EV2274A_4_1_CM_boolean 0 1 /end CHARACTERISTIC
/begin CHARACTERISTIC in_M1_xPreChargeAllowed_gp "" VALUE 0xfd17c8 /* @ECU_Address@in_M1_xPreChargeAllowed_gp@ */ Scalar_BOOLEAN 0 SC_KZQ_EV2274A_4_1_CM_boolean 0 1 /end CHARACTERISTIC
/begin CHARACTERISTIC in_M1_xReady_gp "" VALUE 0xfd17c9 /* @ECU_Address@in_M1_xReady_gp@ */ Scalar_BOOLEAN 0 SC_KZQ_EV2274A_4_1_CM_boolean 0 1 /end CHARACTERISTIC
/begin CHARACTERISTIC in_M1_xResetErr_gp "" VALUE 0xfd17ca /* @ECU_Address@in_M1_xResetErr_gp@ */ Scalar_BOOLEAN 0 SC_KZQ_EV2274A_4_1_CM_boolean 0 1 /end CHARACTERISTIC
/begin CHARACTERISTIC in_M1_xStopErr_gp "" VALUE 0xfd17cb /* @ECU_Address@in_M1_xStopErr_gp@ */ Scalar_BOOLEAN 0 SC_KZQ_EV2274A_4_1_CM_boolean 0 1 /end CHARACTERISTIC
/begin CHARACTERISTIC in_M2_xPreChargeAllowed_gp "" VALUE 0xfd17f0 /* @ECU_Address@in_M2_xPreChargeAllowed_gp@ */ Scalar_BOOLEAN 0 SC_KZQ_EV2274A_4_1_CM_boolean 0 1 /end CHARACTERISTIC
/begin CHARACTERISTIC in_M2_xReady_gp "" VALUE 0xfd17f1 /* @ECU_Address@in_M2_xReady_gp@ */ Scalar_BOOLEAN 0 SC_KZQ_EV2274A_4_1_CM_boolean 0 1 /end CHARACTERISTIC
/begin CHARACTERISTIC in_M2_xResetErr_gp "" VALUE 0xfd17f2 /* @ECU_Address@in_M2_xResetErr_gp@ */ Scalar_BOOLEAN 0 SC_KZQ_EV2274A_4_1_CM_boolean 0 1 /end CHARACTERISTIC
/begin CHARACTERISTIC in_M2_xStopErr_gp "" VALUE 0xfd17f3 /* @ECU_Address@in_M2_xStopErr_gp@ */ Scalar_BOOLEAN 0 SC_KZQ_EV2274A_4_1_CM_boolean 0 1 /end CHARACTERISTIC
/begin CHARACTERISTIC in_M3_xErr_gp "" VALUE 0xfd17f4 /* @ECU_Address@in_M3_xErr_gp@ */ Scalar_BOOLEAN 0 SC_KZQ_EV2274A_4_1_CM_boolean 0 1 /end CHARACTERISTIC
/begin CHARACTERISTIC in_OBC_xErr_gp "" VALUE 0xfd1800 /* @ECU_Address@in_OBC_xErr_gp@ */ Scalar_BOOLEAN 0 SC_KZQ_EV2274A_4_1_CM_boolean 0 1 /end CHARACTERISTIC
/begin CHARACTERISTIC in_OBC_xIsWakeup_gp "" VALUE 0xfd1801 /* @ECU_Address@in_OBC_xIsWakeup_gp@ */ Scalar_BOOLEAN 0 SC_KZQ_EV2274A_4_1_CM_boolean 0 1 /end CHARACTERISTIC
/begin CHARACTERISTIC in_OBC_xReady_gp "" VALUE 0xfd1802 /* @ECU_Address@in_OBC_xReady_gp@ */ Scalar_BOOLEAN 0 SC_KZQ_EV2274A_4_1_CM_boolean 0 1 /end CHARACTERISTIC
/begin CHARACTERISTIC in_xS1_gp "" VALUE 0xfd1810 /* @ECU_Address@in_xS1_gp@ */ Scalar_BOOLEAN 0 SC_KZQ_EV2274A_4_1_CM_boolean 0 1 /end CHARACTERISTIC
/begin CHARACTERISTIC in_xS2_gp "" VALUE 0xfd1811 /* @ECU_Address@in_xS2_gp@ */ Scalar_BOOLEAN 0 SC_KZQ_EV2274A_4_1_CM_boolean 0 1 /end CHARACTERISTIC
/begin CHARACTERISTIC in_xS3_gp "" VALUE 0xfd1812 /* @ECU_Address@in_xS3_gp@ */ Scalar_BOOLEAN 0 SC_KZQ_EV2274A_4_1_CM_boolean 0 1 /end CHARACTERISTIC
/begin CHARACTERISTIC in_xS4_gp "" VALUE 0xfd1813 /* @ECU_Address@in_xS4_gp@ */ Scalar_BOOLEAN 0 SC_KZQ_EV2274A_4_1_CM_boolean 0 1 /end CHARACTERISTIC
/begin CHARACTERISTIC in_xS5_gp "" VALUE 0xfd1814 /* @ECU_Address@in_xS5_gp@ */ Scalar_BOOLEAN 0 SC_KZQ_EV2274A_4_1_CM_boolean 0 1 /end CHARACTERISTIC
/begin CHARACTERISTIC in_xS8D1_gp "" VALUE 0xfd1815 /* @ECU_Address@in_xS8D1_gp@ */ Scalar_BOOLEAN 0 SC_KZQ_EV2274A_4_1_CM_boolean 0 1 /end CHARACTERISTIC
/begin CHARACTERISTIC in_xS8D2_gp "" VALUE 0xfd1816 /* @ECU_Address@in_xS8D2_gp@ */ Scalar_BOOLEAN 0 SC_KZQ_EV2274A_4_1_CM_boolean 0 1 /end CHARACTERISTIC
/begin CHARACTERISTIC in_xS8D3_gp "" VALUE 0xfd1817 /* @ECU_Address@in_xS8D3_gp@ */ Scalar_BOOLEAN 0 SC_KZQ_EV2274A_4_1_CM_boolean 0 1 /end CHARACTERISTIC
/begin CHARACTERISTIC in_xS8D4_gp "" VALUE 0xfd1818 /* @ECU_Address@in_xS8D4_gp@ */ Scalar_BOOLEAN 0 SC_KZQ_EV2274A_4_1_CM_boolean 0 1 /end CHARACTERISTIC
/begin CHARACTERISTIC in_xS8R_gp "" VALUE 0xfd1819 /* @ECU_Address@in_xS8R_gp@ */ Scalar_BOOLEAN 0 SC_KZQ_EV2274A_4_1_CM_boolean 0 1 /end CHARACTERISTIC
/begin CHARACTERISTIC in_xSHA1_gp "" VALUE 0xfd181a /* @ECU_Address@in_xSHA1_gp@ */ Scalar_BOOLEAN 0 SC_KZQ_EV2274A_4_1_CM_boolean 0 1 /end CHARACTERISTIC
/begin CHARACTERISTIC in_xSM1A_gp "" VALUE 0xfd181b /* @ECU_Address@in_xSM1A_gp@ */ Scalar_BOOLEAN 0 SC_KZQ_EV2274A_4_1_CM_boolean 0 1 /end CHARACTERISTIC
/begin CHARACTERISTIC in_xSM1_gp "" VALUE 0xfd181c /* @ECU_Address@in_xSM1_gp@ */ Scalar_BOOLEAN 0 SC_KZQ_EV2274A_4_1_CM_boolean 0 1 /end CHARACTERISTIC
/begin CHARACTERISTIC in_xSM2H_gp "" VALUE 0xfd181d /* @ECU_Address@in_xSM2H_gp@ */ Scalar_BOOLEAN 0 SC_KZQ_EV2274A_4_1_CM_boolean 0 1 /end CHARACTERISTIC
/begin CHARACTERISTIC in_xSM2L_gp "" VALUE 0xfd181e /* @ECU_Address@in_xSM2L_gp@ */ Scalar_BOOLEAN 0 SC_KZQ_EV2274A_4_1_CM_boolean 0 1 /end CHARACTERISTIC
/begin CHARACTERISTIC in_xSM3_gp "" VALUE 0xfd181f /* @ECU_Address@in_xSM3_gp@ */ Scalar_BOOLEAN 0 SC_KZQ_EV2274A_4_1_CM_boolean 0 1 /end CHARACTERISTIC
/begin CHARACTERISTIC test_cal_bool "初始的机型版本" VALUE 0xfd1820 /* @ECU_Address@test_cal_bool@ */ Scalar_BOOLEAN 0 SC_KZQ_EV2274A_4_1_CM_boolean 0 1 /end CHARACTERISTIC
/begin CHARACTERISTIC test_cal_s8 "初始的机型版本" VALUE 0xfd1840 /* @ECU_Address@test_cal_s8@ */ Scalar_BYTE 0 SC_KZQ_EV2274A_4_1_CM_int8 -128 127 /end CHARACTERISTIC
/begin CHARACTERISTIC core_gcp_byNVMOperation_None "待机，不执行操作" VALUE 0xfd0006 /* @ECU_Address@core_gcp_byNVMOperation_None@ */ Scalar_UBYTE 0 SC_KZQ_EV2274A_4_1_CM_uint8 0 255 /end CHARACTERISTIC
/begin CHARACTERISTIC core_gcp_byNVMOperation_Restore "NVM读操作，恢复数据，从ROM到RAM" VALUE 0xfd0007 /* @ECU_Address@core_gcp_byNVMOperation_Restore@ */ Scalar_UBYTE 0 SC_KZQ_EV2274A_4_1_CM_uint8 0 255 /end CHARACTERISTIC
/begin CHARACTERISTIC core_gcp_byNVMOperation_Store "NVM写操作，存储数据，从RAM到ROM。" VALUE 0xfd0008 /* @ECU_Address@core_gcp_byNVMOperation_Store@ */ Scalar_UBYTE 0 SC_KZQ_EV2274A_4_1_CM_uint8 0 255 /end CHARACTERISTIC
/begin CHARACTERISTIC test_cal_u8 "初始的机型版本" VALUE 0xfd1848 /* @ECU_Address@test_cal_u8@ */ Scalar_UBYTE 0 SC_KZQ_EV2274A_4_1_CM_uint8 0 255 /end CHARACTERISTIC
/begin AXIS_PTS gcp_M1External_TopGear145KW_arPeakTroque "特百佳145KW电机，峰值外特性的转矩" 0xfd15a8 /* @ECU_Address@gcp_M1External_TopGear145KW_arPeakTroque@ */ NO_INPUT_QUANTITY Lookup1D_X_FLOAT32_IEEE 0 SC_KZQ_EV2274A_4_1_CM_single_N_m 9 -3.4E+38 3.4E+38 /end AXIS_PTS
/begin AXIS_PTS gcp_M1External_TopGear220KW_arPeakTroque "特百佳220KW电机，峰值外特性的转矩" 0xfd15fc /* @ECU_Address@gcp_M1External_TopGear220KW_arPeakTroque@ */ NO_INPUT_QUANTITY Lookup1D_X_FLOAT32_IEEE 0 SC_KZQ_EV2274A_4_1_CM_single_N_m 12 -3.4E+38 3.4E+38 /end AXIS_PTS
/begin AXIS_PTS gcp_M1External_TopGear286KW_arPeakTroque "特百佳286KW电机，峰值外特性的转矩" 0xfd1654 /* @ECU_Address@gcp_M1External_TopGear286KW_arPeakTroque@ */ NO_INPUT_QUANTITY Lookup1D_X_FLOAT32_IEEE 0 SC_KZQ_EV2274A_4_1_CM_single_N_m 10 -3.4E+38 3.4E+38 /end AXIS_PTS
/begin AXIS_PTS gcp_M1Eff_TopGear145KW_arTorque "转矩，N.m，为Y轴，即行变量，m行，breakpoints 1" 0xfd0840 /* @ECU_Address@gcp_M1Eff_TopGear145KW_arTorque@ */ NO_INPUT_QUANTITY Lookup2D_X_FLOAT32_IEEE 0 SC_KZQ_EV2274A_4_1_CM_single_N_m 42 -3.4E+38 3.4E+38 /end AXIS_PTS
/begin AXIS_PTS gcp_M1Eff_TopGear145KW_arSpeed "转速，rpm，为X轴，即列变量，n列，breakpoints 2" 0xfd0810 /* @ECU_Address@gcp_M1Eff_TopGear145KW_arSpeed@ */ NO_INPUT_QUANTITY Lookup2D_X_FLOAT32_IEEE 0 SC_KZQ_EV2274A_4_1_CM_single_rpm 12 -3.4E+38 3.4E+38 /end AXIS_PTS
/begin AXIS_PTS gcp_M1Eff_TopGear220KW_arTorque "转矩，N.m，为Y轴，即行变量，m行，breakpoints 1" 0xfd0de4 /* @ECU_Address@gcp_M1Eff_TopGear220KW_arTorque@ */ NO_INPUT_QUANTITY Lookup2D_X_FLOAT32_IEEE 0 SC_KZQ_EV2274A_4_1_CM_single_N_m 28 -3.4E+38 3.4E+38 /end AXIS_PTS
/begin AXIS_PTS gcp_M1Eff_TopGear220KW_arSpeed "转速，rpm，为X轴，即列变量，n列，breakpoints 2" 0xfd0db8 /* @ECU_Address@gcp_M1Eff_TopGear220KW_arSpeed@ */ NO_INPUT_QUANTITY Lookup2D_X_FLOAT32_IEEE 0 SC_KZQ_EV2274A_4_1_CM_single_rpm 11 -3.4E+38 3.4E+38 /end AXIS_PTS
/begin AXIS_PTS gcp_M1Eff_TopGear286KW_arTorque "转矩，N.m，为Y轴，即行变量，m行，breakpoints 1" 0xfd119c /* @ECU_Address@gcp_M1Eff_TopGear286KW_arTorque@ */ NO_INPUT_QUANTITY Lookup2D_X_FLOAT32_IEEE 0 SC_KZQ_EV2274A_4_1_CM_single_N_m 20 -3.4E+38 3.4E+38 /end AXIS_PTS
/begin AXIS_PTS gcp_M1Eff_TopGear286KW_arSpeed "转速，rpm，为X轴，即列变量，n列，breakpoints 2" 0xfd1174 /* @ECU_Address@gcp_M1Eff_TopGear286KW_arSpeed@ */ NO_INPUT_QUANTITY Lookup2D_X_FLOAT32_IEEE 0 SC_KZQ_EV2274A_4_1_CM_single_rpm 10 -3.4E+38 3.4E+38 /end AXIS_PTS
/begin MEASUREMENT test_msr_double "" FLOAT64_IEEE SC_KZQ_EV2274A_4_1_CM_double 0 0 -1.7E+308 1.7E+308 ECU_ADDRESS 0x40019840 /* @ECU_Address@test_msr_double@ */ /end MEASUREMENT
/begin MEASUREMENT test_msr_u32 "" ULONG SC_KZQ_EV2274A_4_1_CM_uint32 0 0 0 4294967295 ECU_ADDRESS 0x4001985c /* @ECU_Address@test_msr_u32@ */ /end MEASUREMENT
/begin MEASUREMENT gsn_u32Enable_6508h_010_Disp "" ULONG SC_KZQ_EV2274A_4_1_CM_uint32 0 0 0 4294967295 ECU_ADDRESS 0x40018384 /* @ECU_Address@gsn_u32Enable_6508h_010_Disp@ */ /end MEASUREMENT
/begin MEASUREMENT gsn_u32Enable_6508h_020_Disp "" ULONG SC_KZQ_EV2274A_4_1_CM_uint32 0 0 0 4294967295 ECU_ADDRESS 0x40018388 /* @ECU_Address@gsn_u32Enable_6508h_020_Disp@ */ /end MEASUREMENT
/begin MEASUREMENT gsn_u32Enable_6508h_001_Disp "" ULONG SC_KZQ_EV2274A_4_1_CM_uint32 0 0 0 4294967295 ECU_ADDRESS 0x40018380 /* @ECU_Address@gsn_u32Enable_6508h_001_Disp@ */ /end MEASUREMENT
/begin MEASUREMENT gsn_GPS_u32Directive_Disp "" ULONG SC_KZQ_EV2274A_4_1_CM_uint32 0 0 0 4294967295 ECU_ADDRESS 0x40018304 /* @ECU_Address@gsn_GPS_u32Directive_Disp@ */ /end MEASUREMENT
/begin MEASUREMENT gsn_GPS_imAntiCrack_Disp "" ULONG SC_KZQ_EV2274A_4_1_CM_uint32 0 0 0 4294967295 ECU_ADDRESS 0x400182fc /* @ECU_Address@gsn_GPS_imAntiCrack_Disp@ */ /end MEASUREMENT
/begin MEASUREMENT gsn_GPS_timAntiCrackRemaining_Disp "" ULONG SC_KZQ_EV2274A_4_1_CM_uint32 0 0 0 4294967295 ECU_ADDRESS 0x40018300 /* @ECU_Address@gsn_GPS_timAntiCrackRemaining_Disp@ */ /end MEASUREMENT
/begin MEASUREMENT gsn_GPS_u32KeyGroup1_Disp "" ULONG SC_KZQ_EV2274A_4_1_CM_uint32 0 0 0 4294967295 ECU_ADDRESS 0x40018308 /* @ECU_Address@gsn_GPS_u32KeyGroup1_Disp@ */ /end MEASUREMENT
/begin MEASUREMENT gsn_GPS_u32KeyGroup2_Disp "" ULONG SC_KZQ_EV2274A_4_1_CM_uint32 0 0 0 4294967295 ECU_ADDRESS 0x4001830c /* @ECU_Address@gsn_GPS_u32KeyGroup2_Disp@ */ /end MEASUREMENT
/begin MEASUREMENT gsn_Statistics_u32CumulativeWorkSeconds_Disp "" ULONG SC_KZQ_EV2274A_4_1_CM_uint32 0 0 0 4294967295 ECU_ADDRESS 0x40018378 /* @ECU_Address@gsn_Statistics_u32CumulativeWorkSeconds_Disp@ */ /end MEASUREMENT
/begin MEASUREMENT gsn_Statistics_u32M1CumulativeWorkSeconds_Disp "" ULONG SC_KZQ_EV2274A_4_1_CM_uint32 0 0 0 4294967295 ECU_ADDRESS 0x4001837c /* @ECU_Address@gsn_Statistics_u32M1CumulativeWorkSeconds_Disp@ */ /end MEASUREMENT
/begin MEASUREMENT Can_Z1_u32PeriodTime_Disp "" ULONG SC_KZQ_EV2274A_4_1_CM_uint32 0 0 0 4294967295 ECU_ADDRESS 0x40018030 /* @ECU_Address@Can_Z1_u32PeriodTime_Disp@ */ /end MEASUREMENT
/begin MEASUREMENT test_msr_float "" FLOAT32_IEEE SC_KZQ_EV2274A_4_1_CM_single 0 0 -3.4E+38 3.4E+38 ECU_ADDRESS 0x4001984c /* @ECU_Address@test_msr_float@ */ /end MEASUREMENT
/begin MEASUREMENT msr_gcp_M1External_TopGear145KW_arPeakSpeed_9_1 "" FLOAT32_IEEE SC_KZQ_EV2274A_4_1_CM_single_rpm 0 0 -3.4E+38 3.4E+38 ARRAY_SIZE 9 ECU_ADDRESS 0x40019674 /* @ECU_Address@msr_gcp_M1External_TopGear145KW_arPeakSpeed_9_1@ */ /end MEASUREMENT
/begin MEASUREMENT msr_gcp_M1External_TopGear145KW_arPeakTroque_9_1 "" FLOAT32_IEEE SC_KZQ_EV2274A_4_1_CM_single_N_m 0 0 -3.4E+38 3.4E+38 ARRAY_SIZE 9 ECU_ADDRESS 0x40019698 /* @ECU_Address@msr_gcp_M1External_TopGear145KW_arPeakTroque_9_1@ */ /end MEASUREMENT
/begin MEASUREMENT msr_gcp_M1External_TopGear220KW_arPeakSpeed_1_12 "" FLOAT32_IEEE SC_KZQ_EV2274A_4_1_CM_single_rpm 0 0 -3.4E+38 3.4E+38 ARRAY_SIZE 12 ECU_ADDRESS 0x400196bc /* @ECU_Address@msr_gcp_M1External_TopGear220KW_arPeakSpeed_1_12@ */ /end MEASUREMENT
/begin MEASUREMENT msr_gcp_M1External_TopGear220KW_arPeakTroque_1_12 "" FLOAT32_IEEE SC_KZQ_EV2274A_4_1_CM_single_N_m 0 0 -3.4E+38 3.4E+38 ARRAY_SIZE 12 ECU_ADDRESS 0x400196ec /* @ECU_Address@msr_gcp_M1External_TopGear220KW_arPeakTroque_1_12@ */ /end MEASUREMENT
/begin MEASUREMENT msr_gcp_M1External_TopGear286KW_arPeakSpeed_1_10 "" FLOAT32_IEEE SC_KZQ_EV2274A_4_1_CM_single_rpm 0 0 -3.4E+38 3.4E+38 ARRAY_SIZE 10 ECU_ADDRESS 0x4001971c /* @ECU_Address@msr_gcp_M1External_TopGear286KW_arPeakSpeed_1_10@ */ /end MEASUREMENT
/begin MEASUREMENT msr_gcp_M1External_TopGear286KW_arPeakTroque_1_10 "" FLOAT32_IEEE SC_KZQ_EV2274A_4_1_CM_single_N_m 0 0 -3.4E+38 3.4E+38 ARRAY_SIZE 10 ECU_ADDRESS 0x40019744 /* @ECU_Address@msr_gcp_M1External_TopGear286KW_arPeakTroque_1_10@ */ /end MEASUREMENT
/begin MEASUREMENT msr_gcp_M1test_1_5 "" FLOAT32_IEEE SC_KZQ_EV2274A_4_1_CM_single_N_m 0 0 -3.4E+38 3.4E+38 ARRAY_SIZE 5 ECU_ADDRESS 0x4001976c /* @ECU_Address@msr_gcp_M1test_1_5@ */ /end MEASUREMENT
/begin MEASUREMENT msr_gcp_M1test_2_5 "" FLOAT32_IEEE SC_KZQ_EV2274A_4_1_CM_single_N_m 0 0 -3.4E+38 3.4E+38 ARRAY_SIZE 10 ECU_ADDRESS 0x40019780 /* @ECU_Address@msr_gcp_M1test_2_5@ */ /end MEASUREMENT
/begin MEASUREMENT msr_gcp_M1Eff_TopGear145KW_aarEff_42_12 "" FLOAT32_IEEE SC_KZQ_EV2274A_4_1_CM_single__ 0 0 -3.4E+38 3.4E+38 ARRAY_SIZE 504 ECU_ADDRESS 0x400184b8 /* @ECU_Address@msr_gcp_M1Eff_TopGear145KW_aarEff_42_12@ */ /end MEASUREMENT
/begin MEASUREMENT msr_gcp_M1Eff_TopGear145KW_arSpeed_1_12 "" FLOAT32_IEEE SC_KZQ_EV2274A_4_1_CM_single_RPM 0 0 -3.4E+38 3.4E+38 ARRAY_SIZE 12 ECU_ADDRESS 0x40018c98 /* @ECU_Address@msr_gcp_M1Eff_TopGear145KW_arSpeed_1_12@ */ /end MEASUREMENT
/begin MEASUREMENT msr_gcp_M1Eff_TopGear145KW_arTorque_1_42 "" FLOAT32_IEEE SC_KZQ_EV2274A_4_1_CM_single_N_m 0 0 -3.4E+38 3.4E+38 ARRAY_SIZE 42 ECU_ADDRESS 0x40018cc8 /* @ECU_Address@msr_gcp_M1Eff_TopGear145KW_arTorque_1_42@ */ /end MEASUREMENT
/begin MEASUREMENT msr_gcp_M1Eff_TopGear220KW_aarEff_28_11 "" FLOAT32_IEEE SC_KZQ_EV2274A_4_1_CM_single__ 0 0 -3.4E+38 3.4E+38 ARRAY_SIZE 308 ECU_ADDRESS 0x40018d70 /* @ECU_Address@msr_gcp_M1Eff_TopGear220KW_aarEff_28_11@ */ /end MEASUREMENT
/begin MEASUREMENT msr_gcp_M1Eff_TopGear220KW_arSpeed_1_11 "" FLOAT32_IEEE SC_KZQ_EV2274A_4_1_CM_single_RPM 0 0 -3.4E+38 3.4E+38 ARRAY_SIZE 11 ECU_ADDRESS 0x40019240 /* @ECU_Address@msr_gcp_M1Eff_TopGear220KW_arSpeed_1_11@ */ /end MEASUREMENT
/begin MEASUREMENT msr_gcp_M1Eff_TopGear220KW_arTorque_1_28 "" FLOAT32_IEEE SC_KZQ_EV2274A_4_1_CM_single_N_m 0 0 -3.4E+38 3.4E+38 ARRAY_SIZE 28 ECU_ADDRESS 0x4001926c /* @ECU_Address@msr_gcp_M1Eff_TopGear220KW_arTorque_1_28@ */ /end MEASUREMENT
/begin MEASUREMENT msr_gcp_M1Eff_TopGear286KW_aarEff_20_10 "" FLOAT32_IEEE SC_KZQ_EV2274A_4_1_CM_single__ 0 0 -3.4E+38 3.4E+38 ARRAY_SIZE 200 ECU_ADDRESS 0x400192dc /* @ECU_Address@msr_gcp_M1Eff_TopGear286KW_aarEff_20_10@ */ /end MEASUREMENT
/begin MEASUREMENT msr_gcp_M1Eff_TopGear286KW_arSpeed_1_10 "" FLOAT32_IEEE SC_KZQ_EV2274A_4_1_CM_single_RPM 0 0 -3.4E+38 3.4E+38 ARRAY_SIZE 10 ECU_ADDRESS 0x400195fc /* @ECU_Address@msr_gcp_M1Eff_TopGear286KW_arSpeed_1_10@ */ /end MEASUREMENT
/begin MEASUREMENT msr_gcp_M1Eff_TopGear286KW_arTorque_1_20 "" FLOAT32_IEEE SC_KZQ_EV2274A_4_1_CM_single_N_m 0 0 -3.4E+38 3.4E+38 ARRAY_SIZE 20 ECU_ADDRESS 0x40019624 /* @ECU_Address@msr_gcp_M1Eff_TopGear286KW_arTorque_1_20@ */ /end MEASUREMENT
/begin MEASUREMENT msr_gcp_M1test_6_1 "" FLOAT32_IEEE SC_KZQ_EV2274A_4_1_CM_single_N_m 0 0 -3.4E+38 3.4E+38 ARRAY_SIZE 6 ECU_ADDRESS 0x400197a8 /* @ECU_Address@msr_gcp_M1test_6_1@ */ /end MEASUREMENT
/begin MEASUREMENT msr_gcp_M1test_6_2 "" FLOAT32_IEEE SC_KZQ_EV2274A_4_1_CM_single_N_m 0 0 -3.4E+38 3.4E+38 ARRAY_SIZE 12 ECU_ADDRESS 0x400197c0 /* @ECU_Address@msr_gcp_M1test_6_2@ */ /end MEASUREMENT
/begin MEASUREMENT gsn_M3_rWorkSpeed_Disp "" FLOAT32_IEEE SC_KZQ_EV2274A_4_1_CM_single 0 0 -3.4E+38 3.4E+38 ECU_ADDRESS 0x40018344 /* @ECU_Address@gsn_M3_rWorkSpeed_Disp@ */ /end MEASUREMENT
/begin MEASUREMENT gsn_DCDC_rWorkVoltage_Disp "DCDC的工作电压，V" FLOAT32_IEEE SC_KZQ_EV2274A_4_1_CM_single_V 0 0 -3.4E+38 3.4E+38 ECU_ADDRESS 0x400182f0 /* @ECU_Address@gsn_DCDC_rWorkVoltage_Disp@ */ /end MEASUREMENT
/begin MEASUREMENT gsn_M3_rStopPressure_Disp "" FLOAT32_IEEE SC_KZQ_EV2274A_4_1_CM_single 0 0 -3.4E+38 3.4E+38 ECU_ADDRESS 0x40018340 /* @ECU_Address@gsn_M3_rStopPressure_Disp@ */ /end MEASUREMENT
/begin MEASUREMENT gsn_M3_rStartPressure_Disp "" FLOAT32_IEEE SC_KZQ_EV2274A_4_1_CM_single 0 0 -3.4E+38 3.4E+38 ECU_ADDRESS 0x4001833c /* @ECU_Address@gsn_M3_rStartPressure_Disp@ */ /end MEASUREMENT
/begin MEASUREMENT gsn_Charge_rStartBMSTempForLimiting_Disp "限制充电功率的电池起始温度，℃" FLOAT32_IEEE SC_KZQ_EV2274A_4_1_CM_single 0 0 -3.4E+38 3.4E+38 ECU_ADDRESS 0x400182e8 /* @ECU_Address@gsn_Charge_rStartBMSTempForLimiting_Disp@ */ /end MEASUREMENT
/begin MEASUREMENT gsn_Charge_rStartSOCForLimiting_Disp "限制充电功率的电池起始温度，℃" FLOAT32_IEEE SC_KZQ_EV2274A_4_1_CM_single 0 0 -3.4E+38 3.4E+38 ECU_ADDRESS 0x400182ec /* @ECU_Address@gsn_Charge_rStartSOCForLimiting_Disp@ */ /end MEASUREMENT
/begin MEASUREMENT gsn_M1_rMaxMotorSpeed_Disp "" FLOAT32_IEEE SC_KZQ_EV2274A_4_1_CM_single 0 0 -3.4E+38 3.4E+38 ECU_ADDRESS 0x4001832c /* @ECU_Address@gsn_M1_rMaxMotorSpeed_Disp@ */ /end MEASUREMENT
/begin MEASUREMENT gsn_M1_rMaxHookSpeed_Disp "" FLOAT32_IEEE SC_KZQ_EV2274A_4_1_CM_single 0 0 -3.4E+38 3.4E+38 ECU_ADDRESS 0x40018328 /* @ECU_Address@gsn_M1_rMaxHookSpeed_Disp@ */ /end MEASUREMENT
/begin MEASUREMENT gsn_BMS_rLimpCurrent_Disp "" FLOAT32_IEEE SC_KZQ_EV2274A_4_1_CM_single_A 0 0 -3.4E+38 3.4E+38 ECU_ADDRESS 0x4001827c /* @ECU_Address@gsn_BMS_rLimpCurrent_Disp@ */ /end MEASUREMENT
/begin MEASUREMENT gsn_M3_rRatedPower_Disp "" FLOAT32_IEEE SC_KZQ_EV2274A_4_1_CM_single 0 0 -3.4E+38 3.4E+38 ECU_ADDRESS 0x40018338 /* @ECU_Address@gsn_M3_rRatedPower_Disp@ */ /end MEASUREMENT
/begin MEASUREMENT gsn_Hook_rRearTransCoef_Disp "" FLOAT32_IEEE SC_KZQ_EV2274A_4_1_CM_single 0 0 -3.4E+38 3.4E+38 ECU_ADDRESS 0x40018310 /* @ECU_Address@gsn_Hook_rRearTransCoef_Disp@ */ /end MEASUREMENT
/begin MEASUREMENT gsn_M1Regen_rRegenIntensity_Disp "主驱电机变速箱D3档的速比" FLOAT32_IEEE SC_KZQ_EV2274A_4_1_CM_single 0 0 -3.4E+38 3.4E+38 ECU_ADDRESS 0x40018314 /* @ECU_Address@gsn_M1Regen_rRegenIntensity_Disp@ */ /end MEASUREMENT
/begin MEASUREMENT gsn_M2_rSM2LSpeed_Disp "油泵电机低速开关的设定转速，rpm" FLOAT32_IEEE SC_KZQ_EV2274A_4_1_CM_single 0 0 -3.4E+38 3.4E+38 ECU_ADDRESS 0x40018334 /* @ECU_Address@gsn_M2_rSM2LSpeed_Disp@ */ /end MEASUREMENT
/begin MEASUREMENT gsn_M2_rSM2HSpeed_Disp "油泵电机高速开关的设定转速" FLOAT32_IEEE SC_KZQ_EV2274A_4_1_CM_single 0 0 -3.4E+38 3.4E+38 ECU_ADDRESS 0x40018330 /* @ECU_Address@gsn_M2_rSM2HSpeed_Disp@ */ /end MEASUREMENT
/begin MEASUREMENT gsn_M1Trans_GearLevelRatio_rD1_Disp "主驱电机变速箱D1档的速比" FLOAT32_IEEE SC_KZQ_EV2274A_4_1_CM_single 0 0 -3.4E+38 3.4E+38 ECU_ADDRESS 0x40018318 /* @ECU_Address@gsn_M1Trans_GearLevelRatio_rD1_Disp@ */ /end MEASUREMENT
/begin MEASUREMENT gsn_M1Trans_GearLevelRatio_rD2_Disp "主驱电机变速箱D2档的速比" FLOAT32_IEEE SC_KZQ_EV2274A_4_1_CM_single 0 0 -3.4E+38 3.4E+38 ECU_ADDRESS 0x4001831c /* @ECU_Address@gsn_M1Trans_GearLevelRatio_rD2_Disp@ */ /end MEASUREMENT
/begin MEASUREMENT gsn_M1Trans_GearLevelRatio_rD3_Disp "主驱电机变速箱D3档的速比" FLOAT32_IEEE SC_KZQ_EV2274A_4_1_CM_single 0 0 -3.4E+38 3.4E+38 ECU_ADDRESS 0x40018320 /* @ECU_Address@gsn_M1Trans_GearLevelRatio_rD3_Disp@ */ /end MEASUREMENT
/begin MEASUREMENT gsn_M1Trans_GearLevelRatio_rD4_Disp "主驱电机变速箱D4档的速比" FLOAT32_IEEE SC_KZQ_EV2274A_4_1_CM_single 0 0 -3.4E+38 3.4E+38 ECU_ADDRESS 0x40018324 /* @ECU_Address@gsn_M1Trans_GearLevelRatio_rD4_Disp@ */ /end MEASUREMENT
/begin MEASUREMENT gsn_Charge_rMaxChargePower_Disp "最大充电功率，W" FLOAT32_IEEE SC_KZQ_EV2274A_4_1_CM_single_W 0 0 -3.4E+38 3.4E+38 ECU_ADDRESS 0x400182e0 /* @ECU_Address@gsn_Charge_rMaxChargePower_Disp@ */ /end MEASUREMENT
/begin MEASUREMENT gsn_Dial_rRearTransCoef_Disp "" FLOAT32_IEEE SC_KZQ_EV2274A_4_1_CM_single 0 0 -3.4E+38 3.4E+38 ECU_ADDRESS 0x400182f4 /* @ECU_Address@gsn_Dial_rRearTransCoef_Disp@ */ /end MEASUREMENT
/begin MEASUREMENT gsn_Dial_rRearTransEff_Disp "" FLOAT32_IEEE SC_KZQ_EV2274A_4_1_CM_single 0 0 -3.4E+38 3.4E+38 ECU_ADDRESS 0x400182f8 /* @ECU_Address@gsn_Dial_rRearTransEff_Disp@ */ /end MEASUREMENT
/begin MEASUREMENT gsn_Charge_rMaxDischargeCurrentInCharging_Disp "交流充电时的最大放电电流值，A" FLOAT32_IEEE SC_KZQ_EV2274A_4_1_CM_single_A 0 0 -3.4E+38 3.4E+38 ECU_ADDRESS 0x400182e4 /* @ECU_Address@gsn_Charge_rMaxDischargeCurrentInCharging_Disp@ */ /end MEASUREMENT
/begin MEASUREMENT test_msr_s32 "" SLONG SC_KZQ_EV2274A_4_1_CM_int32 0 0 -2147483648 2147483647 ECU_ADDRESS 0x40019854 /* @ECU_Address@test_msr_s32@ */ /end MEASUREMENT
/begin MEASUREMENT System_gsn_eMachineModel_Disp "机型版本
      " ULONG SC_KZQ_EV2274A_4_1_CM_XJMachineModelEnum 0 0 58982657 104857857 ECU_ADDRESS 0x40018054 /* @ECU_Address@System_gsn_eMachineModel_Disp@ */ /end MEASUREMENT
/begin MEASUREMENT test_msr_u16 "" UWORD SC_KZQ_EV2274A_4_1_CM_uint16 0 0 0 65535 ECU_ADDRESS 0x4001985a /* @ECU_Address@test_msr_u16@ */ /end MEASUREMENT
/begin MEASUREMENT test_msr_s16 "" SWORD SC_KZQ_EV2274A_4_1_CM_int16 0 0 -32768 32767 ECU_ADDRESS 0x40019850 /* @ECU_Address@test_msr_s16@ */ /end MEASUREMENT
/begin MEASUREMENT test_msr_u8 "" UBYTE SC_KZQ_EV2274A_4_1_CM_uint8 0 0 0 255 ECU_ADDRESS 0x40019860 /* @ECU_Address@test_msr_u8@ */ /end MEASUREMENT
/begin MEASUREMENT Can_Z1_u8Ports_Disp "" UBYTE SC_KZQ_EV2274A_4_1_CM_uint8 0 0 0 255 ECU_ADDRESS 0x40018034 /* @ECU_Address@Can_Z1_u8Ports_Disp@ */ /end MEASUREMENT
/begin MEASUREMENT System_HeartBeat_gsn_byDispType_Disp "" UBYTE SC_KZQ_EV2274A_4_1_CM_uint8 0 0 0 255 ECU_ADDRESS 0x40018037 /* @ECU_Address@System_HeartBeat_gsn_byDispType_Disp@ */ /end MEASUREMENT
/begin MEASUREMENT test_msr_s8 "" SBYTE SC_KZQ_EV2274A_4_1_CM_int8 0 0 -128 127 ECU_ADDRESS 0x40019858 /* @ECU_Address@test_msr_s8@ */ /end MEASUREMENT
/begin MEASUREMENT System_gsn_xIECDownloadInit_Disp "" UBYTE SC_KZQ_EV2274A_4_1_CM_boolean 0 0 0 1 ECU_ADDRESS 0x40018058 /* @ECU_Address@System_gsn_xIECDownloadInit_Disp@ */ /end MEASUREMENT
/begin MEASUREMENT test_msr_bool "" UBYTE SC_KZQ_EV2274A_4_1_CM_boolean 0 0 0 1 ECU_ADDRESS 0x4001983d /* @ECU_Address@test_msr_bool@ */ /end MEASUREMENT
/begin MEASUREMENT core_gs_T_PLC_lrMS "" FLOAT64_IEEE SC_KZQ_EV2274A_4_1_CM_double 0 0 -1.7E+308 1.7E+308 ECU_ADDRESS 0x40018060 /* @ECU_Address@core_gs_T_PLC_lrMS@ */ /end MEASUREMENT
/begin MEASUREMENT fbBQ1_rMaxValue "" FLOAT32_IEEE SC_KZQ_EV2274A_4_1_CM_single 0 0 -3.4E+38 3.4E+38 ECU_ADDRESS 0x4001808c /* @ECU_Address@fbBQ1_rMaxValue@ */ /end MEASUREMENT
/begin MEASUREMENT fbBQ1_rMinValue "" FLOAT32_IEEE SC_KZQ_EV2274A_4_1_CM_single 0 0 -3.4E+38 3.4E+38 ECU_ADDRESS 0x40018090 /* @ECU_Address@fbBQ1_rMinValue@ */ /end MEASUREMENT
/begin MEASUREMENT fbBQ1_rOut "" FLOAT32_IEEE SC_KZQ_EV2274A_4_1_CM_single 0 0 -3.4E+38 3.4E+38 ECU_ADDRESS 0x40018094 /* @ECU_Address@fbBQ1_rOut@ */ /end MEASUREMENT
/begin MEASUREMENT fbBQ1_rOutA "" FLOAT32_IEEE SC_KZQ_EV2274A_4_1_CM_single 0 0 -3.4E+38 3.4E+38 ECU_ADDRESS 0x40018098 /* @ECU_Address@fbBQ1_rOutA@ */ /end MEASUREMENT
/begin MEASUREMENT fbBQ1_rOutB "" FLOAT32_IEEE SC_KZQ_EV2274A_4_1_CM_single 0 0 -3.4E+38 3.4E+38 ECU_ADDRESS 0x4001809c /* @ECU_Address@fbBQ1_rOutB@ */ /end MEASUREMENT
/begin MEASUREMENT fbBQ1_rRatio "" FLOAT32_IEEE SC_KZQ_EV2274A_4_1_CM_single 0 0 -3.4E+38 3.4E+38 ECU_ADDRESS 0x400180a0 /* @ECU_Address@fbBQ1_rRatio@ */ /end MEASUREMENT
/begin MEASUREMENT fbBQ1_rRatioA "" FLOAT32_IEEE SC_KZQ_EV2274A_4_1_CM_single 0 0 -3.4E+38 3.4E+38 ECU_ADDRESS 0x400180a4 /* @ECU_Address@fbBQ1_rRatioA@ */ /end MEASUREMENT
/begin MEASUREMENT fbBQ1_rRatioB "" FLOAT32_IEEE SC_KZQ_EV2274A_4_1_CM_single 0 0 -3.4E+38 3.4E+38 ECU_ADDRESS 0x400180a8 /* @ECU_Address@fbBQ1_rRatioB@ */ /end MEASUREMENT
/begin MEASUREMENT fbBQ2_rMaxValue "" FLOAT32_IEEE SC_KZQ_EV2274A_4_1_CM_single 0 0 -3.4E+38 3.4E+38 ECU_ADDRESS 0x400180b4 /* @ECU_Address@fbBQ2_rMaxValue@ */ /end MEASUREMENT
/begin MEASUREMENT fbBQ2_rMinValue "" FLOAT32_IEEE SC_KZQ_EV2274A_4_1_CM_single 0 0 -3.4E+38 3.4E+38 ECU_ADDRESS 0x400180b8 /* @ECU_Address@fbBQ2_rMinValue@ */ /end MEASUREMENT
/begin MEASUREMENT fbBQ2_rOut "" FLOAT32_IEEE SC_KZQ_EV2274A_4_1_CM_single 0 0 -3.4E+38 3.4E+38 ECU_ADDRESS 0x400180bc /* @ECU_Address@fbBQ2_rOut@ */ /end MEASUREMENT
/begin MEASUREMENT fbBQ2_rOutA "" FLOAT32_IEEE SC_KZQ_EV2274A_4_1_CM_single 0 0 -3.4E+38 3.4E+38 ECU_ADDRESS 0x400180c0 /* @ECU_Address@fbBQ2_rOutA@ */ /end MEASUREMENT
/begin MEASUREMENT fbBQ2_rOutB "" FLOAT32_IEEE SC_KZQ_EV2274A_4_1_CM_single 0 0 -3.4E+38 3.4E+38 ECU_ADDRESS 0x400180c4 /* @ECU_Address@fbBQ2_rOutB@ */ /end MEASUREMENT
/begin MEASUREMENT fbBQ2_rRatio "" FLOAT32_IEEE SC_KZQ_EV2274A_4_1_CM_single 0 0 -3.4E+38 3.4E+38 ECU_ADDRESS 0x400180c8 /* @ECU_Address@fbBQ2_rRatio@ */ /end MEASUREMENT
/begin MEASUREMENT fbBQ2_rRatioA "" FLOAT32_IEEE SC_KZQ_EV2274A_4_1_CM_single 0 0 -3.4E+38 3.4E+38 ECU_ADDRESS 0x400180cc /* @ECU_Address@fbBQ2_rRatioA@ */ /end MEASUREMENT
/begin MEASUREMENT fbBQ2_rRatioB "" FLOAT32_IEEE SC_KZQ_EV2274A_4_1_CM_single 0 0 -3.4E+38 3.4E+38 ECU_ADDRESS 0x400180d0 /* @ECU_Address@fbBQ2_rRatioB@ */ /end MEASUREMENT
/begin MEASUREMENT fbBQ3_rMaxValue "" FLOAT32_IEEE SC_KZQ_EV2274A_4_1_CM_single 0 0 -3.4E+38 3.4E+38 ECU_ADDRESS 0x400180dc /* @ECU_Address@fbBQ3_rMaxValue@ */ /end MEASUREMENT
/begin MEASUREMENT fbBQ3_rMinValue "" FLOAT32_IEEE SC_KZQ_EV2274A_4_1_CM_single 0 0 -3.4E+38 3.4E+38 ECU_ADDRESS 0x400180e0 /* @ECU_Address@fbBQ3_rMinValue@ */ /end MEASUREMENT
/begin MEASUREMENT fbBQ3_rOut "" FLOAT32_IEEE SC_KZQ_EV2274A_4_1_CM_single 0 0 -3.4E+38 3.4E+38 ECU_ADDRESS 0x400180e4 /* @ECU_Address@fbBQ3_rOut@ */ /end MEASUREMENT
/begin MEASUREMENT fbBQ3_rOutA "" FLOAT32_IEEE SC_KZQ_EV2274A_4_1_CM_single 0 0 -3.4E+38 3.4E+38 ECU_ADDRESS 0x400180e8 /* @ECU_Address@fbBQ3_rOutA@ */ /end MEASUREMENT
/begin MEASUREMENT fbBQ3_rOutB "" FLOAT32_IEEE SC_KZQ_EV2274A_4_1_CM_single 0 0 -3.4E+38 3.4E+38 ECU_ADDRESS 0x400180ec /* @ECU_Address@fbBQ3_rOutB@ */ /end MEASUREMENT
/begin MEASUREMENT fbBQ3_rRatio "" FLOAT32_IEEE SC_KZQ_EV2274A_4_1_CM_single 0 0 -3.4E+38 3.4E+38 ECU_ADDRESS 0x400180f0 /* @ECU_Address@fbBQ3_rRatio@ */ /end MEASUREMENT
/begin MEASUREMENT fbBQ3_rRatioA "" FLOAT32_IEEE SC_KZQ_EV2274A_4_1_CM_single 0 0 -3.4E+38 3.4E+38 ECU_ADDRESS 0x400180f4 /* @ECU_Address@fbBQ3_rRatioA@ */ /end MEASUREMENT
/begin MEASUREMENT fbBQ3_rRatioB "" FLOAT32_IEEE SC_KZQ_EV2274A_4_1_CM_single 0 0 -3.4E+38 3.4E+38 ECU_ADDRESS 0x400180f8 /* @ECU_Address@fbBQ3_rRatioB@ */ /end MEASUREMENT
/begin MEASUREMENT fbBQ4_rMaxValue "" FLOAT32_IEEE SC_KZQ_EV2274A_4_1_CM_single 0 0 -3.4E+38 3.4E+38 ECU_ADDRESS 0x40018104 /* @ECU_Address@fbBQ4_rMaxValue@ */ /end MEASUREMENT
/begin MEASUREMENT fbBQ4_rMinValue "" FLOAT32_IEEE SC_KZQ_EV2274A_4_1_CM_single 0 0 -3.4E+38 3.4E+38 ECU_ADDRESS 0x40018108 /* @ECU_Address@fbBQ4_rMinValue@ */ /end MEASUREMENT
/begin MEASUREMENT fbBQ4_rOut "" FLOAT32_IEEE SC_KZQ_EV2274A_4_1_CM_single 0 0 -3.4E+38 3.4E+38 ECU_ADDRESS 0x4001810c /* @ECU_Address@fbBQ4_rOut@ */ /end MEASUREMENT
/begin MEASUREMENT fbBQ4_rOutA "" FLOAT32_IEEE SC_KZQ_EV2274A_4_1_CM_single 0 0 -3.4E+38 3.4E+38 ECU_ADDRESS 0x40018110 /* @ECU_Address@fbBQ4_rOutA@ */ /end MEASUREMENT
/begin MEASUREMENT fbBQ4_rOutB "" FLOAT32_IEEE SC_KZQ_EV2274A_4_1_CM_single 0 0 -3.4E+38 3.4E+38 ECU_ADDRESS 0x40018114 /* @ECU_Address@fbBQ4_rOutB@ */ /end MEASUREMENT
/begin MEASUREMENT fbBQ4_rRatio "" FLOAT32_IEEE SC_KZQ_EV2274A_4_1_CM_single 0 0 -3.4E+38 3.4E+38 ECU_ADDRESS 0x40018118 /* @ECU_Address@fbBQ4_rRatio@ */ /end MEASUREMENT
/begin MEASUREMENT fbBQ4_rRatioA "" FLOAT32_IEEE SC_KZQ_EV2274A_4_1_CM_single 0 0 -3.4E+38 3.4E+38 ECU_ADDRESS 0x4001811c /* @ECU_Address@fbBQ4_rRatioA@ */ /end MEASUREMENT
/begin MEASUREMENT fbBQ4_rRatioB "" FLOAT32_IEEE SC_KZQ_EV2274A_4_1_CM_single 0 0 -3.4E+38 3.4E+38 ECU_ADDRESS 0x40018120 /* @ECU_Address@fbBQ4_rRatioB@ */ /end MEASUREMENT
/begin MEASUREMENT fbChargeManagement_rLoadPower "" FLOAT32_IEEE SC_KZQ_EV2274A_4_1_CM_single_W 0 0 -3.4E+38 3.4E+38 ECU_ADDRESS 0x40018128 /* @ECU_Address@fbChargeManagement_rLoadPower@ */ /end MEASUREMENT
/begin MEASUREMENT fbChargeManagement_rMaxChargePower "设置的OBC最大充电功率，W
      " FLOAT32_IEEE SC_KZQ_EV2274A_4_1_CM_single_W 0 0 -3.4E+38 3.4E+38 ECU_ADDRESS 0x4001812c /* @ECU_Address@fbChargeManagement_rMaxChargePower@ */ /end MEASUREMENT
/begin MEASUREMENT fbM1Control_rEfficiency "" FLOAT32_IEEE SC_KZQ_EV2274A_4_1_CM_single 0 0 -3.4E+38 3.4E+38 ECU_ADDRESS 0x4001815c /* @ECU_Address@fbM1Control_rEfficiency@ */ /end MEASUREMENT
/begin MEASUREMENT fbM1Control_rLimitErr "" FLOAT32_IEEE SC_KZQ_EV2274A_4_1_CM_single 0 0 -3.4E+38 3.4E+38 ECU_ADDRESS 0x40018160 /* @ECU_Address@fbM1Control_rLimitErr@ */ /end MEASUREMENT
/begin MEASUREMENT fbM1Control_rMaxAviableDirveTorque "" FLOAT32_IEEE SC_KZQ_EV2274A_4_1_CM_single 0 0 -3.4E+38 3.4E+38 ECU_ADDRESS 0x40018164 /* @ECU_Address@fbM1Control_rMaxAviableDirveTorque@ */ /end MEASUREMENT
/begin MEASUREMENT fbM1Control_rMaxAviableRegenTorque "" FLOAT32_IEEE SC_KZQ_EV2274A_4_1_CM_single 0 0 -3.4E+38 3.4E+38 ECU_ADDRESS 0x40018168 /* @ECU_Address@fbM1Control_rMaxAviableRegenTorque@ */ /end MEASUREMENT
/begin MEASUREMENT fbM1Control_rMaxAviableSpeed "" FLOAT32_IEEE SC_KZQ_EV2274A_4_1_CM_single 0 0 -3.4E+38 3.4E+38 ECU_ADDRESS 0x4001816c /* @ECU_Address@fbM1Control_rMaxAviableSpeed@ */ /end MEASUREMENT
/begin MEASUREMENT fbM1Control_rSpeed "" FLOAT32_IEEE SC_KZQ_EV2274A_4_1_CM_single 0 0 -3.4E+38 3.4E+38 ECU_ADDRESS 0x40018170 /* @ECU_Address@fbM1Control_rSpeed@ */ /end MEASUREMENT
/begin MEASUREMENT fbM1Control_rSpeedCmd "" FLOAT32_IEEE SC_KZQ_EV2274A_4_1_CM_single 0 0 -3.4E+38 3.4E+38 ECU_ADDRESS 0x40018174 /* @ECU_Address@fbM1Control_rSpeedCmd@ */ /end MEASUREMENT
/begin MEASUREMENT fbM1Control_rTorque "" FLOAT32_IEEE SC_KZQ_EV2274A_4_1_CM_single 0 0 -3.4E+38 3.4E+38 ECU_ADDRESS 0x40018178 /* @ECU_Address@fbM1Control_rTorque@ */ /end MEASUREMENT
/begin MEASUREMENT fbM1Control_rTorqueCmd "" FLOAT32_IEEE SC_KZQ_EV2274A_4_1_CM_single 0 0 -3.4E+38 3.4E+38 ECU_ADDRESS 0x4001817c /* @ECU_Address@fbM1Control_rTorqueCmd@ */ /end MEASUREMENT
/begin MEASUREMENT fbM1GearControl_rTransRatio "" FLOAT32_IEEE SC_KZQ_EV2274A_4_1_CM_single 0 0 -3.4E+38 3.4E+38 ECU_ADDRESS 0x40018188 /* @ECU_Address@fbM1GearControl_rTransRatio@ */ /end MEASUREMENT
/begin MEASUREMENT fbM1Regen_rG1ResidualChargePower "" FLOAT32_IEEE SC_KZQ_EV2274A_4_1_CM_single 0 0 -3.4E+38 3.4E+38 ECU_ADDRESS 0x400181a0 /* @ECU_Address@fbM1Regen_rG1ResidualChargePower@ */ /end MEASUREMENT
/begin MEASUREMENT fbM1Regen_rTorqueCmd "" FLOAT32_IEEE SC_KZQ_EV2274A_4_1_CM_single 0 0 -3.4E+38 3.4E+38 ECU_ADDRESS 0x400181a4 /* @ECU_Address@fbM1Regen_rTorqueCmd@ */ /end MEASUREMENT
/begin MEASUREMENT fbM2Control_rLimitErr "" FLOAT32_IEEE SC_KZQ_EV2274A_4_1_CM_single 0 0 -3.4E+38 3.4E+38 ECU_ADDRESS 0x400181ac /* @ECU_Address@fbM2Control_rLimitErr@ */ /end MEASUREMENT
/begin MEASUREMENT fbM2Control_rMaxAviableSpeed "" FLOAT32_IEEE SC_KZQ_EV2274A_4_1_CM_single 0 0 -3.4E+38 3.4E+38 ECU_ADDRESS 0x400181b0 /* @ECU_Address@fbM2Control_rMaxAviableSpeed@ */ /end MEASUREMENT
/begin MEASUREMENT fbM2Control_rSpeed "" FLOAT32_IEEE SC_KZQ_EV2274A_4_1_CM_single 0 0 -3.4E+38 3.4E+38 ECU_ADDRESS 0x400181b4 /* @ECU_Address@fbM2Control_rSpeed@ */ /end MEASUREMENT
/begin MEASUREMENT fbM2Control_rSpeedCmd "" FLOAT32_IEEE SC_KZQ_EV2274A_4_1_CM_single 0 0 -3.4E+38 3.4E+38 ECU_ADDRESS 0x400181b8 /* @ECU_Address@fbM2Control_rSpeedCmd@ */ /end MEASUREMENT
/begin MEASUREMENT fbM2Control_rTorque "" FLOAT32_IEEE SC_KZQ_EV2274A_4_1_CM_single 0 0 -3.4E+38 3.4E+38 ECU_ADDRESS 0x400181bc /* @ECU_Address@fbM2Control_rTorque@ */ /end MEASUREMENT
/begin MEASUREMENT fbRM1A_rMaxValue "" FLOAT32_IEEE SC_KZQ_EV2274A_4_1_CM_single 0 0 -3.4E+38 3.4E+38 ECU_ADDRESS 0x400181e8 /* @ECU_Address@fbRM1A_rMaxValue@ */ /end MEASUREMENT
/begin MEASUREMENT fbRM1A_rMinValue "" FLOAT32_IEEE SC_KZQ_EV2274A_4_1_CM_single 0 0 -3.4E+38 3.4E+38 ECU_ADDRESS 0x400181ec /* @ECU_Address@fbRM1A_rMinValue@ */ /end MEASUREMENT
/begin MEASUREMENT fbRM1A_rOut "" FLOAT32_IEEE SC_KZQ_EV2274A_4_1_CM_single 0 0 -3.4E+38 3.4E+38 ECU_ADDRESS 0x400181f0 /* @ECU_Address@fbRM1A_rOut@ */ /end MEASUREMENT
/begin MEASUREMENT fbRM1A_rOutA "" FLOAT32_IEEE SC_KZQ_EV2274A_4_1_CM_single 0 0 -3.4E+38 3.4E+38 ECU_ADDRESS 0x400181f4 /* @ECU_Address@fbRM1A_rOutA@ */ /end MEASUREMENT
/begin MEASUREMENT fbRM1A_rOutB "" FLOAT32_IEEE SC_KZQ_EV2274A_4_1_CM_single 0 0 -3.4E+38 3.4E+38 ECU_ADDRESS 0x400181f8 /* @ECU_Address@fbRM1A_rOutB@ */ /end MEASUREMENT
/begin MEASUREMENT fbRM1A_rRatio "" FLOAT32_IEEE SC_KZQ_EV2274A_4_1_CM_single 0 0 -3.4E+38 3.4E+38 ECU_ADDRESS 0x400181fc /* @ECU_Address@fbRM1A_rRatio@ */ /end MEASUREMENT
/begin MEASUREMENT fbRM1A_rRatioA "" FLOAT32_IEEE SC_KZQ_EV2274A_4_1_CM_single 0 0 -3.4E+38 3.4E+38 ECU_ADDRESS 0x40018200 /* @ECU_Address@fbRM1A_rRatioA@ */ /end MEASUREMENT
/begin MEASUREMENT fbRM1A_rRatioB "" FLOAT32_IEEE SC_KZQ_EV2274A_4_1_CM_single 0 0 -3.4E+38 3.4E+38 ECU_ADDRESS 0x40018204 /* @ECU_Address@fbRM1A_rRatioB@ */ /end MEASUREMENT
/begin MEASUREMENT fbRM1_rMaxValue "" FLOAT32_IEEE SC_KZQ_EV2274A_4_1_CM_single 0 0 -3.4E+38 3.4E+38 ECU_ADDRESS 0x40018210 /* @ECU_Address@fbRM1_rMaxValue@ */ /end MEASUREMENT
/begin MEASUREMENT fbRM1_rMinValue "" FLOAT32_IEEE SC_KZQ_EV2274A_4_1_CM_single 0 0 -3.4E+38 3.4E+38 ECU_ADDRESS 0x40018214 /* @ECU_Address@fbRM1_rMinValue@ */ /end MEASUREMENT
/begin MEASUREMENT fbRM1_rOut "" FLOAT32_IEEE SC_KZQ_EV2274A_4_1_CM_single 0 0 -3.4E+38 3.4E+38 ECU_ADDRESS 0x40018218 /* @ECU_Address@fbRM1_rOut@ */ /end MEASUREMENT
/begin MEASUREMENT fbRM1_rOutA "" FLOAT32_IEEE SC_KZQ_EV2274A_4_1_CM_single 0 0 -3.4E+38 3.4E+38 ECU_ADDRESS 0x4001821c /* @ECU_Address@fbRM1_rOutA@ */ /end MEASUREMENT
/begin MEASUREMENT fbRM1_rOutB "" FLOAT32_IEEE SC_KZQ_EV2274A_4_1_CM_single 0 0 -3.4E+38 3.4E+38 ECU_ADDRESS 0x40018220 /* @ECU_Address@fbRM1_rOutB@ */ /end MEASUREMENT
/begin MEASUREMENT fbRM1_rRatio "" FLOAT32_IEEE SC_KZQ_EV2274A_4_1_CM_single 0 0 -3.4E+38 3.4E+38 ECU_ADDRESS 0x40018224 /* @ECU_Address@fbRM1_rRatio@ */ /end MEASUREMENT
/begin MEASUREMENT fbRM1_rRatioA "" FLOAT32_IEEE SC_KZQ_EV2274A_4_1_CM_single 0 0 -3.4E+38 3.4E+38 ECU_ADDRESS 0x40018228 /* @ECU_Address@fbRM1_rRatioA@ */ /end MEASUREMENT
/begin MEASUREMENT fbRM1_rRatioB "" FLOAT32_IEEE SC_KZQ_EV2274A_4_1_CM_single 0 0 -3.4E+38 3.4E+38 ECU_ADDRESS 0x4001822c /* @ECU_Address@fbRM1_rRatioB@ */ /end MEASUREMENT
/begin MEASUREMENT gsn_BQ1_rAccuracy_Disp "" FLOAT32_IEEE SC_KZQ_EV2274A_4_1_CM_single 0 0 -3.4E+38 3.4E+38 ECU_ADDRESS 0x40018280 /* @ECU_Address@gsn_BQ1_rAccuracy_Disp@ */ /end MEASUREMENT
/begin MEASUREMENT gsn_BQ1_rCoef_Disp "" FLOAT32_IEEE SC_KZQ_EV2274A_4_1_CM_single 0 0 -3.4E+38 3.4E+38 ECU_ADDRESS 0x40018284 /* @ECU_Address@gsn_BQ1_rCoef_Disp@ */ /end MEASUREMENT
/begin MEASUREMENT gsn_BQ1_rRefValue_Disp "" FLOAT32_IEEE SC_KZQ_EV2274A_4_1_CM_single 0 0 -3.4E+38 3.4E+38 ECU_ADDRESS 0x40018288 /* @ECU_Address@gsn_BQ1_rRefValue_Disp@ */ /end MEASUREMENT
/begin MEASUREMENT gsn_BQ2_rAccuracy_Disp "" FLOAT32_IEEE SC_KZQ_EV2274A_4_1_CM_single 0 0 -3.4E+38 3.4E+38 ECU_ADDRESS 0x40018298 /* @ECU_Address@gsn_BQ2_rAccuracy_Disp@ */ /end MEASUREMENT
/begin MEASUREMENT gsn_BQ2_rCoef_Disp "" FLOAT32_IEEE SC_KZQ_EV2274A_4_1_CM_single 0 0 -3.4E+38 3.4E+38 ECU_ADDRESS 0x4001829c /* @ECU_Address@gsn_BQ2_rCoef_Disp@ */ /end MEASUREMENT
/begin MEASUREMENT gsn_BQ2_rRefValue_Disp "" FLOAT32_IEEE SC_KZQ_EV2274A_4_1_CM_single 0 0 -3.4E+38 3.4E+38 ECU_ADDRESS 0x400182a0 /* @ECU_Address@gsn_BQ2_rRefValue_Disp@ */ /end MEASUREMENT
/begin MEASUREMENT gsn_BQ3_rAccuracy_Disp "" FLOAT32_IEEE SC_KZQ_EV2274A_4_1_CM_single 0 0 -3.4E+38 3.4E+38 ECU_ADDRESS 0x400182b0 /* @ECU_Address@gsn_BQ3_rAccuracy_Disp@ */ /end MEASUREMENT
/begin MEASUREMENT gsn_BQ3_rCoef_Disp "" FLOAT32_IEEE SC_KZQ_EV2274A_4_1_CM_single 0 0 -3.4E+38 3.4E+38 ECU_ADDRESS 0x400182b4 /* @ECU_Address@gsn_BQ3_rCoef_Disp@ */ /end MEASUREMENT
/begin MEASUREMENT gsn_BQ3_rRefValue_Disp "" FLOAT32_IEEE SC_KZQ_EV2274A_4_1_CM_single 0 0 -3.4E+38 3.4E+38 ECU_ADDRESS 0x400182b8 /* @ECU_Address@gsn_BQ3_rRefValue_Disp@ */ /end MEASUREMENT
/begin MEASUREMENT gsn_BQ4_rAccuracy_Disp "" FLOAT32_IEEE SC_KZQ_EV2274A_4_1_CM_single 0 0 -3.4E+38 3.4E+38 ECU_ADDRESS 0x400182c8 /* @ECU_Address@gsn_BQ4_rAccuracy_Disp@ */ /end MEASUREMENT
/begin MEASUREMENT gsn_BQ4_rCoef_Disp "" FLOAT32_IEEE SC_KZQ_EV2274A_4_1_CM_single 0 0 -3.4E+38 3.4E+38 ECU_ADDRESS 0x400182cc /* @ECU_Address@gsn_BQ4_rCoef_Disp@ */ /end MEASUREMENT
/begin MEASUREMENT gsn_BQ4_rRefValue_Disp "" FLOAT32_IEEE SC_KZQ_EV2274A_4_1_CM_single 0 0 -3.4E+38 3.4E+38 ECU_ADDRESS 0x400182d0 /* @ECU_Address@gsn_BQ4_rRefValue_Disp@ */ /end MEASUREMENT
/begin MEASUREMENT gsn_RM1A_rAccuracy_Disp "" FLOAT32_IEEE SC_KZQ_EV2274A_4_1_CM_single 0 0 -3.4E+38 3.4E+38 ECU_ADDRESS 0x40018348 /* @ECU_Address@gsn_RM1A_rAccuracy_Disp@ */ /end MEASUREMENT
/begin MEASUREMENT gsn_RM1A_rCoef_Disp "" FLOAT32_IEEE SC_KZQ_EV2274A_4_1_CM_single 0 0 -3.4E+38 3.4E+38 ECU_ADDRESS 0x4001834c /* @ECU_Address@gsn_RM1A_rCoef_Disp@ */ /end MEASUREMENT
/begin MEASUREMENT gsn_RM1A_rRefValue_Disp "" FLOAT32_IEEE SC_KZQ_EV2274A_4_1_CM_single 0 0 -3.4E+38 3.4E+38 ECU_ADDRESS 0x40018350 /* @ECU_Address@gsn_RM1A_rRefValue_Disp@ */ /end MEASUREMENT
/begin MEASUREMENT gsn_RM1_rAccuracy_Disp "" FLOAT32_IEEE SC_KZQ_EV2274A_4_1_CM_single 0 0 -3.4E+38 3.4E+38 ECU_ADDRESS 0x40018360 /* @ECU_Address@gsn_RM1_rAccuracy_Disp@ */ /end MEASUREMENT
/begin MEASUREMENT gsn_RM1_rCoef_Disp "" FLOAT32_IEEE SC_KZQ_EV2274A_4_1_CM_single 0 0 -3.4E+38 3.4E+38 ECU_ADDRESS 0x40018364 /* @ECU_Address@gsn_RM1_rCoef_Disp@ */ /end MEASUREMENT
/begin MEASUREMENT gsn_RM1_rRefValue_Disp "" FLOAT32_IEEE SC_KZQ_EV2274A_4_1_CM_single 0 0 -3.4E+38 3.4E+38 ECU_ADDRESS 0x40018368 /* @ECU_Address@gsn_RM1_rRefValue_Disp@ */ /end MEASUREMENT
/begin MEASUREMENT in_A1_rM2HighSpeed "" FLOAT32_IEEE SC_KZQ_EV2274A_4_1_CM_single 0 0 -3.4E+38 3.4E+38 ECU_ADDRESS 0x4001838c /* @ECU_Address@in_A1_rM2HighSpeed@ */ /end MEASUREMENT
/begin MEASUREMENT in_A1_rM2LowSpeed "" FLOAT32_IEEE SC_KZQ_EV2274A_4_1_CM_single 0 0 -3.4E+38 3.4E+38 ECU_ADDRESS 0x40018390 /* @ECU_Address@in_A1_rM2LowSpeed@ */ /end MEASUREMENT
/begin MEASUREMENT in_A1_rMaxAllowedChargePower "" FLOAT32_IEEE SC_KZQ_EV2274A_4_1_CM_single 0 0 -3.4E+38 3.4E+38 ECU_ADDRESS 0x40018394 /* @ECU_Address@in_A1_rMaxAllowedChargePower@ */ /end MEASUREMENT
/begin MEASUREMENT in_BMS_rChargeCurrentCmd "交流充电模式下，电池的请求充电电流值，A" FLOAT32_IEEE SC_KZQ_EV2274A_4_1_CM_single_A 0 0 -3.4E+38 3.4E+38 ECU_ADDRESS 0x400183a0 /* @ECU_Address@in_BMS_rChargeCurrentCmd@ */ /end MEASUREMENT
/begin MEASUREMENT in_BMS_rChargeLimitErr "充电功率限制比率，0～1" FLOAT32_IEEE SC_KZQ_EV2274A_4_1_CM_single 0 0 -3.4E+38 3.4E+38 ECU_ADDRESS 0x400183a4 /* @ECU_Address@in_BMS_rChargeLimitErr@ */ /end MEASUREMENT
/begin MEASUREMENT in_BMS_rCoolingPower "BMS冷却功率，W" FLOAT32_IEEE SC_KZQ_EV2274A_4_1_CM_single_W 0 0 -3.4E+38 3.4E+38 ECU_ADDRESS 0x400183a8 /* @ECU_Address@in_BMS_rCoolingPower@ */ /end MEASUREMENT
/begin MEASUREMENT in_BMS_rCurrent "电池当前电流值,充电为负值，放电为正值，A" FLOAT32_IEEE SC_KZQ_EV2274A_4_1_CM_single_A 0 0 -3.4E+38 3.4E+38 ECU_ADDRESS 0x400183ac /* @ECU_Address@in_BMS_rCurrent@ */ /end MEASUREMENT
/begin MEASUREMENT in_BMS_rDischargeLimitErr "放电功率异常的限制系数，0~1
      " FLOAT32_IEEE SC_KZQ_EV2274A_4_1_CM_single 0 0 -3.4E+38 3.4E+38 ECU_ADDRESS 0x400183b0 /* @ECU_Address@in_BMS_rDischargeLimitErr@ */ /end MEASUREMENT
/begin MEASUREMENT in_BMS_rDischargeLimitErrTemp "放电功率异常的限制系数，每个周期复位1.
      " FLOAT32_IEEE SC_KZQ_EV2274A_4_1_CM_single 0 0 -3.4E+38 3.4E+38 ECU_ADDRESS 0x400183b4 /* @ECU_Address@in_BMS_rDischargeLimitErrTemp@ */ /end MEASUREMENT
/begin MEASUREMENT in_BMS_rMaxAviableChargeCurrent "电池允许的最大充电电流值，A" FLOAT32_IEEE SC_KZQ_EV2274A_4_1_CM_single_A 0 0 -3.4E+38 3.4E+38 ECU_ADDRESS 0x400183b8 /* @ECU_Address@in_BMS_rMaxAviableChargeCurrent@ */ /end MEASUREMENT
/begin MEASUREMENT in_BMS_rMaxAviableDischargeCurrent "电池允许的最大放电电流，A
      " FLOAT32_IEEE SC_KZQ_EV2274A_4_1_CM_single_A 0 0 -3.4E+38 3.4E+38 ECU_ADDRESS 0x400183bc /* @ECU_Address@in_BMS_rMaxAviableDischargeCurrent@ */ /end MEASUREMENT
/begin MEASUREMENT in_BMS_rMaxAviableTemperature "电池可用温度上限
      " FLOAT32_IEEE SC_KZQ_EV2274A_4_1_CM_single 0 0 -3.4E+38 3.4E+38 ECU_ADDRESS 0x400183c0 /* @ECU_Address@in_BMS_rMaxAviableTemperature@ */ /end MEASUREMENT
/begin MEASUREMENT in_BMS_rMaxAviableVoltage "电池可用电压上限
      " FLOAT32_IEEE SC_KZQ_EV2274A_4_1_CM_single_V 0 0 -3.4E+38 3.4E+38 ECU_ADDRESS 0x400183c4 /* @ECU_Address@in_BMS_rMaxAviableVoltage@ */ /end MEASUREMENT
/begin MEASUREMENT in_BMS_rSOC "" FLOAT32_IEEE SC_KZQ_EV2274A_4_1_CM_single_V 0 0 -3.4E+38 3.4E+38 ECU_ADDRESS 0x400183c8 /* @ECU_Address@in_BMS_rSOC@ */ /end MEASUREMENT
/begin MEASUREMENT in_BMS_rTemperature "电池当前温度值" FLOAT32_IEEE SC_KZQ_EV2274A_4_1_CM_single 0 0 -3.4E+38 3.4E+38 ECU_ADDRESS 0x400183cc /* @ECU_Address@in_BMS_rTemperature@ */ /end MEASUREMENT
/begin MEASUREMENT in_BMS_rVoltage "电池当前电压值" FLOAT32_IEEE SC_KZQ_EV2274A_4_1_CM_single_V 0 0 -3.4E+38 3.4E+38 ECU_ADDRESS 0x400183d0 /* @ECU_Address@in_BMS_rVoltage@ */ /end MEASUREMENT
/begin MEASUREMENT in_M1_rACCurrent "" FLOAT32_IEEE SC_KZQ_EV2274A_4_1_CM_single 0 0 -3.4E+38 3.4E+38 ECU_ADDRESS 0x400183e0 /* @ECU_Address@in_M1_rACCurrent@ */ /end MEASUREMENT
/begin MEASUREMENT in_M1_rACVoltage "" FLOAT32_IEEE SC_KZQ_EV2274A_4_1_CM_single 0 0 -3.4E+38 3.4E+38 ECU_ADDRESS 0x400183e4 /* @ECU_Address@in_M1_rACVoltage@ */ /end MEASUREMENT
/begin MEASUREMENT in_M1_rBusCurrent "" FLOAT32_IEEE SC_KZQ_EV2274A_4_1_CM_single 0 0 -3.4E+38 3.4E+38 ECU_ADDRESS 0x400183e8 /* @ECU_Address@in_M1_rBusCurrent@ */ /end MEASUREMENT
/begin MEASUREMENT in_M1_rBusVoltage "" FLOAT32_IEEE SC_KZQ_EV2274A_4_1_CM_single 0 0 -3.4E+38 3.4E+38 ECU_ADDRESS 0x400183ec /* @ECU_Address@in_M1_rBusVoltage@ */ /end MEASUREMENT
/begin MEASUREMENT in_M1_rControllerTemp "" FLOAT32_IEEE SC_KZQ_EV2274A_4_1_CM_single 0 0 -3.4E+38 3.4E+38 ECU_ADDRESS 0x400183f0 /* @ECU_Address@in_M1_rControllerTemp@ */ /end MEASUREMENT
/begin MEASUREMENT in_M1_rLimitErr "" FLOAT32_IEEE SC_KZQ_EV2274A_4_1_CM_single 0 0 -3.4E+38 3.4E+38 ECU_ADDRESS 0x400183f4 /* @ECU_Address@in_M1_rLimitErr@ */ /end MEASUREMENT
/begin MEASUREMENT in_M1_rMotorTemp "" FLOAT32_IEEE SC_KZQ_EV2274A_4_1_CM_single 0 0 -3.4E+38 3.4E+38 ECU_ADDRESS 0x400183f8 /* @ECU_Address@in_M1_rMotorTemp@ */ /end MEASUREMENT
/begin MEASUREMENT in_M1_rSpeed "" FLOAT32_IEEE SC_KZQ_EV2274A_4_1_CM_single 0 0 -3.4E+38 3.4E+38 ECU_ADDRESS 0x400183fc /* @ECU_Address@in_M1_rSpeed@ */ /end MEASUREMENT
/begin MEASUREMENT in_M1_rTorque "" FLOAT32_IEEE SC_KZQ_EV2274A_4_1_CM_single 0 0 -3.4E+38 3.4E+38 ECU_ADDRESS 0x40018400 /* @ECU_Address@in_M1_rTorque@ */ /end MEASUREMENT
/begin MEASUREMENT in_M1_rTorqueNegtiveLimit "" FLOAT32_IEEE SC_KZQ_EV2274A_4_1_CM_single 0 0 -3.4E+38 3.4E+38 ECU_ADDRESS 0x40018404 /* @ECU_Address@in_M1_rTorqueNegtiveLimit@ */ /end MEASUREMENT
/begin MEASUREMENT in_M1_rTorquePositiveLimit "" FLOAT32_IEEE SC_KZQ_EV2274A_4_1_CM_single 0 0 -3.4E+38 3.4E+38 ECU_ADDRESS 0x40018408 /* @ECU_Address@in_M1_rTorquePositiveLimit@ */ /end MEASUREMENT
/begin MEASUREMENT in_M2_rACCurrent "" FLOAT32_IEEE SC_KZQ_EV2274A_4_1_CM_single 0 0 -3.4E+38 3.4E+38 ECU_ADDRESS 0x40018424 /* @ECU_Address@in_M2_rACCurrent@ */ /end MEASUREMENT
/begin MEASUREMENT in_M2_rACVoltage "" FLOAT32_IEEE SC_KZQ_EV2274A_4_1_CM_single 0 0 -3.4E+38 3.4E+38 ECU_ADDRESS 0x40018428 /* @ECU_Address@in_M2_rACVoltage@ */ /end MEASUREMENT
/begin MEASUREMENT in_M2_rBusCurrent "" FLOAT32_IEEE SC_KZQ_EV2274A_4_1_CM_single 0 0 -3.4E+38 3.4E+38 ECU_ADDRESS 0x4001842c /* @ECU_Address@in_M2_rBusCurrent@ */ /end MEASUREMENT
/begin MEASUREMENT in_M2_rBusVoltage "" FLOAT32_IEEE SC_KZQ_EV2274A_4_1_CM_single 0 0 -3.4E+38 3.4E+38 ECU_ADDRESS 0x40018430 /* @ECU_Address@in_M2_rBusVoltage@ */ /end MEASUREMENT
/begin MEASUREMENT in_M2_rControllerTemp "" FLOAT32_IEEE SC_KZQ_EV2274A_4_1_CM_single 0 0 -3.4E+38 3.4E+38 ECU_ADDRESS 0x40018434 /* @ECU_Address@in_M2_rControllerTemp@ */ /end MEASUREMENT
/begin MEASUREMENT in_M2_rLimitErr "" FLOAT32_IEEE SC_KZQ_EV2274A_4_1_CM_single 0 0 -3.4E+38 3.4E+38 ECU_ADDRESS 0x40018438 /* @ECU_Address@in_M2_rLimitErr@ */ /end MEASUREMENT
/begin MEASUREMENT in_M2_rMotorTemp "" FLOAT32_IEEE SC_KZQ_EV2274A_4_1_CM_single 0 0 -3.4E+38 3.4E+38 ECU_ADDRESS 0x4001843c /* @ECU_Address@in_M2_rMotorTemp@ */ /end MEASUREMENT
/begin MEASUREMENT in_M2_rSpeed "" FLOAT32_IEEE SC_KZQ_EV2274A_4_1_CM_single 0 0 -3.4E+38 3.4E+38 ECU_ADDRESS 0x40018440 /* @ECU_Address@in_M2_rSpeed@ */ /end MEASUREMENT
/begin MEASUREMENT in_M2_rTorque "" FLOAT32_IEEE SC_KZQ_EV2274A_4_1_CM_single 0 0 -3.4E+38 3.4E+38 ECU_ADDRESS 0x40018444 /* @ECU_Address@in_M2_rTorque@ */ /end MEASUREMENT
/begin MEASUREMENT in_OBC_rCurrent "OBC的充电输出电流，A
      " FLOAT32_IEEE SC_KZQ_EV2274A_4_1_CM_single_A 0 0 -3.4E+38 3.4E+38 ECU_ADDRESS 0x40018454 /* @ECU_Address@in_OBC_rCurrent@ */ /end MEASUREMENT
/begin MEASUREMENT in_OBC_rVoltage "OBC的充电输出电压，V
      " FLOAT32_IEEE SC_KZQ_EV2274A_4_1_CM_single_V 0 0 -3.4E+38 3.4E+38 ECU_ADDRESS 0x40018458 /* @ECU_Address@in_OBC_rVoltage@ */ /end MEASUREMENT
/begin MEASUREMENT out_Dial_rSpeed "" FLOAT32_IEEE SC_KZQ_EV2274A_4_1_CM_single 0 0 -3.4E+38 3.4E+38 ECU_ADDRESS 0x400197f0 /* @ECU_Address@out_Dial_rSpeed@ */ /end MEASUREMENT
/begin MEASUREMENT out_Dial_rTorque "" FLOAT32_IEEE SC_KZQ_EV2274A_4_1_CM_single 0 0 -3.4E+38 3.4E+38 ECU_ADDRESS 0x400197f4 /* @ECU_Address@out_Dial_rTorque@ */ /end MEASUREMENT
/begin MEASUREMENT out_Hook_rSpeed "OBC请求的充电电流，A
      " FLOAT32_IEEE SC_KZQ_EV2274A_4_1_CM_single_A 0 0 -3.4E+38 3.4E+38 ECU_ADDRESS 0x400197fc /* @ECU_Address@out_Hook_rSpeed@ */ /end MEASUREMENT
/begin MEASUREMENT out_M1_rSpeedCmd "" FLOAT32_IEEE SC_KZQ_EV2274A_4_1_CM_single 0 0 -3.4E+38 3.4E+38 ECU_ADDRESS 0x40019800 /* @ECU_Address@out_M1_rSpeedCmd@ */ /end MEASUREMENT
/begin MEASUREMENT out_M1_rTorqueCmd "" FLOAT32_IEEE SC_KZQ_EV2274A_4_1_CM_single 0 0 -3.4E+38 3.4E+38 ECU_ADDRESS 0x40019804 /* @ECU_Address@out_M1_rTorqueCmd@ */ /end MEASUREMENT
/begin MEASUREMENT out_M2_rSpeedCmd "" FLOAT32_IEEE SC_KZQ_EV2274A_4_1_CM_single 0 0 -3.4E+38 3.4E+38 ECU_ADDRESS 0x4001980c /* @ECU_Address@out_M2_rSpeedCmd@ */ /end MEASUREMENT
/begin MEASUREMENT out_OBC_rChargeCurrentCmd "OBC请求的充电电流，A
      " FLOAT32_IEEE SC_KZQ_EV2274A_4_1_CM_single_A 0 0 -3.4E+38 3.4E+38 ECU_ADDRESS 0x40019814 /* @ECU_Address@out_OBC_rChargeCurrentCmd@ */ /end MEASUREMENT
/begin MEASUREMENT out_OBC_rChargePowerCmd "OBC请求的充电功率，W
      " FLOAT32_IEEE SC_KZQ_EV2274A_4_1_CM_single_W 0 0 -3.4E+38 3.4E+38 ECU_ADDRESS 0x40019818 /* @ECU_Address@out_OBC_rChargePowerCmd@ */ /end MEASUREMENT
/begin MEASUREMENT System_gs_AppVersion_u32MainMinor "" ULONG SC_KZQ_EV2274A_4_1_CM_uint32 0 0 0 4294967295 ECU_ADDRESS 0x4001803c /* @ECU_Address@System_gs_AppVersion_u32MainMinor@ */ /end MEASUREMENT
/begin MEASUREMENT System_gs_u32ProtocolVersion "" ULONG SC_KZQ_EV2274A_4_1_CM_uint32 0 0 0 4294967295 ECU_ADDRESS 0x40018044 /* @ECU_Address@System_gs_u32ProtocolVersion@ */ /end MEASUREMENT
/begin MEASUREMENT core_gs_T_PLC_u32MS "" ULONG SC_KZQ_EV2274A_4_1_CM_uint32 0 0 0 4294967295 ECU_ADDRESS 0x40018074 /* @ECU_Address@core_gs_T_PLC_u32MS@ */ /end MEASUREMENT
/begin MEASUREMENT gs_GPS_u32TempKey "" ULONG SC_KZQ_EV2274A_4_1_CM_uint32 0 0 0 4294967295 ECU_ADDRESS 0x40018270 /* @ECU_Address@gs_GPS_u32TempKey@ */ /end MEASUREMENT
/begin MEASUREMENT gs_GPS_u32TempSeed "" ULONG SC_KZQ_EV2274A_4_1_CM_uint32 0 0 0 4294967295 ECU_ADDRESS 0x40018274 /* @ECU_Address@gs_GPS_u32TempSeed@ */ /end MEASUREMENT
/begin MEASUREMENT test_msr_enum "" ULONG SC_KZQ_EV2274A_4_1_CM_XJMachineModelEnum 0 0 58982657 104857857 ECU_ADDRESS 0x40019848 /* @ECU_Address@test_msr_enum@ */ /end MEASUREMENT
/begin MEASUREMENT System_gs_AppVersion_u16Revised "" UWORD SC_KZQ_EV2274A_4_1_CM_uint16 0 0 0 65535 ECU_ADDRESS 0x40018038 /* @ECU_Address@System_gs_AppVersion_u16Revised@ */ /end MEASUREMENT
/begin MEASUREMENT System_gs_AppVersion_u8Stage "" UWORD SC_KZQ_EV2274A_4_1_CM_uint16 0 0 0 65535 ECU_ADDRESS 0x40018040 /* @ECU_Address@System_gs_AppVersion_u8Stage@ */ /end MEASUREMENT
/begin MEASUREMENT core_gs_T_PLC_u16day "" UWORD SC_KZQ_EV2274A_4_1_CM_uint16 0 0 0 65535 ECU_ADDRESS 0x40018068 /* @ECU_Address@core_gs_T_PLC_u16day@ */ /end MEASUREMENT
/begin MEASUREMENT core_gs_T_PLC_u16hour "" UWORD SC_KZQ_EV2274A_4_1_CM_uint16 0 0 0 65535 ECU_ADDRESS 0x4001806a /* @ECU_Address@core_gs_T_PLC_u16hour@ */ /end MEASUREMENT
/begin MEASUREMENT core_gs_T_PLC_u16min "" UWORD SC_KZQ_EV2274A_4_1_CM_uint16 0 0 0 65535 ECU_ADDRESS 0x4001806c /* @ECU_Address@core_gs_T_PLC_u16min@ */ /end MEASUREMENT
/begin MEASUREMENT core_gs_T_PLC_u16msec "" UWORD SC_KZQ_EV2274A_4_1_CM_uint16 0 0 0 65535 ECU_ADDRESS 0x4001806e /* @ECU_Address@core_gs_T_PLC_u16msec@ */ /end MEASUREMENT
/begin MEASUREMENT core_gs_T_PLC_u16sec "" UWORD SC_KZQ_EV2274A_4_1_CM_uint16 0 0 0 65535 ECU_ADDRESS 0x40018070 /* @ECU_Address@core_gs_T_PLC_u16sec@ */ /end MEASUREMENT
/begin MEASUREMENT core_gs_T_PLC_u16usec "" UWORD SC_KZQ_EV2274A_4_1_CM_uint16 0 0 0 65535 ECU_ADDRESS 0x40018072 /* @ECU_Address@core_gs_T_PLC_u16usec@ */ /end MEASUREMENT
/begin MEASUREMENT gsn_BQ1_u16MaxAD_Disp "" UWORD SC_KZQ_EV2274A_4_1_CM_uint16 0 0 0 65535 ECU_ADDRESS 0x4001828c /* @ECU_Address@gsn_BQ1_u16MaxAD_Disp@ */ /end MEASUREMENT
/begin MEASUREMENT gsn_BQ1_u16MinAD_Disp "" UWORD SC_KZQ_EV2274A_4_1_CM_uint16 0 0 0 65535 ECU_ADDRESS 0x4001828e /* @ECU_Address@gsn_BQ1_u16MinAD_Disp@ */ /end MEASUREMENT
/begin MEASUREMENT gsn_BQ1_u16RatedMaxAD_Disp "" UWORD SC_KZQ_EV2274A_4_1_CM_uint16 0 0 0 65535 ECU_ADDRESS 0x40018290 /* @ECU_Address@gsn_BQ1_u16RatedMaxAD_Disp@ */ /end MEASUREMENT
/begin MEASUREMENT gsn_BQ1_u16RatedMinAD_Disp "" UWORD SC_KZQ_EV2274A_4_1_CM_uint16 0 0 0 65535 ECU_ADDRESS 0x40018292 /* @ECU_Address@gsn_BQ1_u16RatedMinAD_Disp@ */ /end MEASUREMENT
/begin MEASUREMENT gsn_BQ1_u16RefAD_Disp "" UWORD SC_KZQ_EV2274A_4_1_CM_uint16 0 0 0 65535 ECU_ADDRESS 0x40018294 /* @ECU_Address@gsn_BQ1_u16RefAD_Disp@ */ /end MEASUREMENT
/begin MEASUREMENT gsn_BQ2_u16MaxAD_Disp "" UWORD SC_KZQ_EV2274A_4_1_CM_uint16 0 0 0 65535 ECU_ADDRESS 0x400182a4 /* @ECU_Address@gsn_BQ2_u16MaxAD_Disp@ */ /end MEASUREMENT
/begin MEASUREMENT gsn_BQ2_u16MinAD_Disp "" UWORD SC_KZQ_EV2274A_4_1_CM_uint16 0 0 0 65535 ECU_ADDRESS 0x400182a6 /* @ECU_Address@gsn_BQ2_u16MinAD_Disp@ */ /end MEASUREMENT
/begin MEASUREMENT gsn_BQ2_u16RatedMaxAD_Disp "" UWORD SC_KZQ_EV2274A_4_1_CM_uint16 0 0 0 65535 ECU_ADDRESS 0x400182a8 /* @ECU_Address@gsn_BQ2_u16RatedMaxAD_Disp@ */ /end MEASUREMENT
/begin MEASUREMENT gsn_BQ2_u16RatedMinAD_Disp "" UWORD SC_KZQ_EV2274A_4_1_CM_uint16 0 0 0 65535 ECU_ADDRESS 0x400182aa /* @ECU_Address@gsn_BQ2_u16RatedMinAD_Disp@ */ /end MEASUREMENT
/begin MEASUREMENT gsn_BQ2_u16RefAD_Disp "" UWORD SC_KZQ_EV2274A_4_1_CM_uint16 0 0 0 65535 ECU_ADDRESS 0x400182ac /* @ECU_Address@gsn_BQ2_u16RefAD_Disp@ */ /end MEASUREMENT
/begin MEASUREMENT gsn_BQ3_u16MaxAD_Disp "" UWORD SC_KZQ_EV2274A_4_1_CM_uint16 0 0 0 65535 ECU_ADDRESS 0x400182bc /* @ECU_Address@gsn_BQ3_u16MaxAD_Disp@ */ /end MEASUREMENT
/begin MEASUREMENT gsn_BQ3_u16MinAD_Disp "" UWORD SC_KZQ_EV2274A_4_1_CM_uint16 0 0 0 65535 ECU_ADDRESS 0x400182be /* @ECU_Address@gsn_BQ3_u16MinAD_Disp@ */ /end MEASUREMENT
/begin MEASUREMENT gsn_BQ3_u16RatedMaxAD_Disp "" UWORD SC_KZQ_EV2274A_4_1_CM_uint16 0 0 0 65535 ECU_ADDRESS 0x400182c0 /* @ECU_Address@gsn_BQ3_u16RatedMaxAD_Disp@ */ /end MEASUREMENT
/begin MEASUREMENT gsn_BQ3_u16RatedMinAD_Disp "" UWORD SC_KZQ_EV2274A_4_1_CM_uint16 0 0 0 65535 ECU_ADDRESS 0x400182c2 /* @ECU_Address@gsn_BQ3_u16RatedMinAD_Disp@ */ /end MEASUREMENT
/begin MEASUREMENT gsn_BQ3_u16RefAD_Disp "" UWORD SC_KZQ_EV2274A_4_1_CM_uint16 0 0 0 65535 ECU_ADDRESS 0x400182c4 /* @ECU_Address@gsn_BQ3_u16RefAD_Disp@ */ /end MEASUREMENT
/begin MEASUREMENT gsn_BQ4_u16MaxAD_Disp "" UWORD SC_KZQ_EV2274A_4_1_CM_uint16 0 0 0 65535 ECU_ADDRESS 0x400182d4 /* @ECU_Address@gsn_BQ4_u16MaxAD_Disp@ */ /end MEASUREMENT
/begin MEASUREMENT gsn_BQ4_u16MinAD_Disp "" UWORD SC_KZQ_EV2274A_4_1_CM_uint16 0 0 0 65535 ECU_ADDRESS 0x400182d6 /* @ECU_Address@gsn_BQ4_u16MinAD_Disp@ */ /end MEASUREMENT
/begin MEASUREMENT gsn_BQ4_u16RatedMaxAD_Disp "" UWORD SC_KZQ_EV2274A_4_1_CM_uint16 0 0 0 65535 ECU_ADDRESS 0x400182d8 /* @ECU_Address@gsn_BQ4_u16RatedMaxAD_Disp@ */ /end MEASUREMENT
/begin MEASUREMENT gsn_BQ4_u16RatedMinAD_Disp "" UWORD SC_KZQ_EV2274A_4_1_CM_uint16 0 0 0 65535 ECU_ADDRESS 0x400182da /* @ECU_Address@gsn_BQ4_u16RatedMinAD_Disp@ */ /end MEASUREMENT
/begin MEASUREMENT gsn_BQ4_u16RefAD_Disp "" UWORD SC_KZQ_EV2274A_4_1_CM_uint16 0 0 0 65535 ECU_ADDRESS 0x400182dc /* @ECU_Address@gsn_BQ4_u16RefAD_Disp@ */ /end MEASUREMENT
/begin MEASUREMENT gsn_RM1A_u16MaxAD_Disp "" UWORD SC_KZQ_EV2274A_4_1_CM_uint16 0 0 0 65535 ECU_ADDRESS 0x40018354 /* @ECU_Address@gsn_RM1A_u16MaxAD_Disp@ */ /end MEASUREMENT
/begin MEASUREMENT gsn_RM1A_u16MinAD_Disp "" UWORD SC_KZQ_EV2274A_4_1_CM_uint16 0 0 0 65535 ECU_ADDRESS 0x40018356 /* @ECU_Address@gsn_RM1A_u16MinAD_Disp@ */ /end MEASUREMENT
/begin MEASUREMENT gsn_RM1A_u16RatedMaxAD_Disp "" UWORD SC_KZQ_EV2274A_4_1_CM_uint16 0 0 0 65535 ECU_ADDRESS 0x40018358 /* @ECU_Address@gsn_RM1A_u16RatedMaxAD_Disp@ */ /end MEASUREMENT
/begin MEASUREMENT gsn_RM1A_u16RatedMinAD_Disp "" UWORD SC_KZQ_EV2274A_4_1_CM_uint16 0 0 0 65535 ECU_ADDRESS 0x4001835a /* @ECU_Address@gsn_RM1A_u16RatedMinAD_Disp@ */ /end MEASUREMENT
/begin MEASUREMENT gsn_RM1A_u16RefAD_Disp "" UWORD SC_KZQ_EV2274A_4_1_CM_uint16 0 0 0 65535 ECU_ADDRESS 0x4001835c /* @ECU_Address@gsn_RM1A_u16RefAD_Disp@ */ /end MEASUREMENT
/begin MEASUREMENT gsn_RM1_u16MaxAD_Disp "" UWORD SC_KZQ_EV2274A_4_1_CM_uint16 0 0 0 65535 ECU_ADDRESS 0x4001836c /* @ECU_Address@gsn_RM1_u16MaxAD_Disp@ */ /end MEASUREMENT
/begin MEASUREMENT gsn_RM1_u16MinAD_Disp "" UWORD SC_KZQ_EV2274A_4_1_CM_uint16 0 0 0 65535 ECU_ADDRESS 0x4001836e /* @ECU_Address@gsn_RM1_u16MinAD_Disp@ */ /end MEASUREMENT
/begin MEASUREMENT gsn_RM1_u16RatedMaxAD_Disp "" UWORD SC_KZQ_EV2274A_4_1_CM_uint16 0 0 0 65535 ECU_ADDRESS 0x40018370 /* @ECU_Address@gsn_RM1_u16RatedMaxAD_Disp@ */ /end MEASUREMENT
/begin MEASUREMENT gsn_RM1_u16RatedMinAD_Disp "" UWORD SC_KZQ_EV2274A_4_1_CM_uint16 0 0 0 65535 ECU_ADDRESS 0x40018372 /* @ECU_Address@gsn_RM1_u16RatedMinAD_Disp@ */ /end MEASUREMENT
/begin MEASUREMENT gsn_RM1_u16RefAD_Disp "" UWORD SC_KZQ_EV2274A_4_1_CM_uint16 0 0 0 65535 ECU_ADDRESS 0x40018374 /* @ECU_Address@gsn_RM1_u16RefAD_Disp@ */ /end MEASUREMENT
/begin MEASUREMENT in_u16BQ1 "" UWORD SC_KZQ_EV2274A_4_1_CM_uint16 0 0 0 65535 ECU_ADDRESS 0x40018464 /* @ECU_Address@in_u16BQ1@ */ /end MEASUREMENT
/begin MEASUREMENT in_u16BQ2 "" UWORD SC_KZQ_EV2274A_4_1_CM_uint16 0 0 0 65535 ECU_ADDRESS 0x40018466 /* @ECU_Address@in_u16BQ2@ */ /end MEASUREMENT
/begin MEASUREMENT in_u16BQ3 "" UWORD SC_KZQ_EV2274A_4_1_CM_uint16 0 0 0 65535 ECU_ADDRESS 0x40018468 /* @ECU_Address@in_u16BQ3@ */ /end MEASUREMENT
/begin MEASUREMENT in_u16BQ4 "" UWORD SC_KZQ_EV2274A_4_1_CM_uint16 0 0 0 65535 ECU_ADDRESS 0x4001846a /* @ECU_Address@in_u16BQ4@ */ /end MEASUREMENT
/begin MEASUREMENT in_u16RM1 "" UWORD SC_KZQ_EV2274A_4_1_CM_uint16 0 0 0 65535 ECU_ADDRESS 0x4001846c /* @ECU_Address@in_u16RM1@ */ /end MEASUREMENT
/begin MEASUREMENT in_u16RM1A "" UWORD SC_KZQ_EV2274A_4_1_CM_uint16 0 0 0 65535 ECU_ADDRESS 0x4001846e /* @ECU_Address@in_u16RM1A@ */ /end MEASUREMENT
/begin MEASUREMENT in_wAI03_X16 "0～32V
      12bit
      " UWORD SC_KZQ_EV2274A_4_1_CM_uint16 0 0 0 65535 ECU_ADDRESS 0x40018470 /* @ECU_Address@in_wAI03_X16@ */ /end MEASUREMENT
/begin MEASUREMENT in_wAI04_X35 "0～32V
      12bit
      " UWORD SC_KZQ_EV2274A_4_1_CM_uint16 0 0 0 65535 ECU_ADDRESS 0x40018472 /* @ECU_Address@in_wAI04_X35@ */ /end MEASUREMENT
/begin MEASUREMENT in_wAI05_X17 "0～5V
      12bit
      " UWORD SC_KZQ_EV2274A_4_1_CM_uint16 0 0 0 65535 ECU_ADDRESS 0x40018474 /* @ECU_Address@in_wAI05_X17@ */ /end MEASUREMENT
/begin MEASUREMENT in_wAI06_X36 "0～5V
      12bit
      " UWORD SC_KZQ_EV2274A_4_1_CM_uint16 0 0 0 65535 ECU_ADDRESS 0x40018476 /* @ECU_Address@in_wAI06_X36@ */ /end MEASUREMENT
/begin MEASUREMENT in_wAI07_X18 "0～5V
      12bit
      " UWORD SC_KZQ_EV2274A_4_1_CM_uint16 0 0 0 65535 ECU_ADDRESS 0x40018478 /* @ECU_Address@in_wAI07_X18@ */ /end MEASUREMENT
/begin MEASUREMENT in_wAI08_X37 "0～5V
      12bit
      " UWORD SC_KZQ_EV2274A_4_1_CM_uint16 0 0 0 65535 ECU_ADDRESS 0x4001847a /* @ECU_Address@in_wAI08_X37@ */ /end MEASUREMENT
/begin MEASUREMENT in_wAI09_X71 "0～32V
      12bit
      " UWORD SC_KZQ_EV2274A_4_1_CM_uint16 0 0 0 65535 ECU_ADDRESS 0x4001847c /* @ECU_Address@in_wAI09_X71@ */ /end MEASUREMENT
/begin MEASUREMENT in_wAI11_X24 "0～32V
      12bit
      " UWORD SC_KZQ_EV2274A_4_1_CM_uint16 0 0 0 65535 ECU_ADDRESS 0x4001847e /* @ECU_Address@in_wAI11_X24@ */ /end MEASUREMENT
/begin MEASUREMENT in_wAI12_X62 "0～5V
      12bit
      " UWORD SC_KZQ_EV2274A_4_1_CM_uint16 0 0 0 65535 ECU_ADDRESS 0x40018480 /* @ECU_Address@in_wAI12_X62@ */ /end MEASUREMENT
/begin MEASUREMENT in_wAI15_X20 "0～5V
      12bit
      " UWORD SC_KZQ_EV2274A_4_1_CM_uint16 0 0 0 65535 ECU_ADDRESS 0x40018482 /* @ECU_Address@in_wAI15_X20@ */ /end MEASUREMENT
/begin MEASUREMENT in_wAI16_X22 "0～32V
      12bit
      " UWORD SC_KZQ_EV2274A_4_1_CM_uint16 0 0 0 65535 ECU_ADDRESS 0x40018484 /* @ECU_Address@in_wAI16_X22@ */ /end MEASUREMENT
/begin MEASUREMENT in_wAI17_X79 "0～5V
      12bit
      " UWORD SC_KZQ_EV2274A_4_1_CM_uint16 0 0 0 65535 ECU_ADDRESS 0x40018486 /* @ECU_Address@in_wAI17_X79@ */ /end MEASUREMENT
/begin MEASUREMENT in_wAI18_X23 "0～32V
      12bit
      " UWORD SC_KZQ_EV2274A_4_1_CM_uint16 0 0 0 65535 ECU_ADDRESS 0x40018488 /* @ECU_Address@in_wAI18_X23@ */ /end MEASUREMENT
/begin MEASUREMENT in_wAI19_X61 "0～5V
      12bit
      " UWORD SC_KZQ_EV2274A_4_1_CM_uint16 0 0 0 65535 ECU_ADDRESS 0x4001848a /* @ECU_Address@in_wAI19_X61@ */ /end MEASUREMENT
/begin MEASUREMENT in_wAI20_X72 "0～5V
      12bit
      " UWORD SC_KZQ_EV2274A_4_1_CM_uint16 0 0 0 65535 ECU_ADDRESS 0x4001848c /* @ECU_Address@in_wAI20_X72@ */ /end MEASUREMENT
/begin MEASUREMENT in_wSystemVoltage "0～32V
      12bit
      " UWORD SC_KZQ_EV2274A_4_1_CM_uint16 0 0 0 65535 ECU_ADDRESS 0x4001848e /* @ECU_Address@in_wSystemVoltage@ */ /end MEASUREMENT
/begin MEASUREMENT Can_A1_u8Ports "" UBYTE SC_KZQ_EV2274A_4_1_CM_uint8 0 0 0 255 ECU_ADDRESS 0x40018002 /* @ECU_Address@Can_A1_u8Ports@ */ /end MEASUREMENT
/begin MEASUREMENT Can_A2_u8Ports "" UBYTE SC_KZQ_EV2274A_4_1_CM_uint8 0 0 0 255 ECU_ADDRESS 0x40018005 /* @ECU_Address@Can_A2_u8Ports@ */ /end MEASUREMENT
/begin MEASUREMENT Can_BMS_u8Ports "" UBYTE SC_KZQ_EV2274A_4_1_CM_uint8 0 0 0 255 ECU_ADDRESS 0x40018008 /* @ECU_Address@Can_BMS_u8Ports@ */ /end MEASUREMENT
/begin MEASUREMENT Can_BQ1_u8Ports "" UBYTE SC_KZQ_EV2274A_4_1_CM_uint8 0 0 0 255 ECU_ADDRESS 0x4001800a /* @ECU_Address@Can_BQ1_u8Ports@ */ /end MEASUREMENT
/begin MEASUREMENT Can_BQ2_u8Ports "" UBYTE SC_KZQ_EV2274A_4_1_CM_uint8 0 0 0 255 ECU_ADDRESS 0x4001800c /* @ECU_Address@Can_BQ2_u8Ports@ */ /end MEASUREMENT
/begin MEASUREMENT Can_BQ3_u8Ports "" UBYTE SC_KZQ_EV2274A_4_1_CM_uint8 0 0 0 255 ECU_ADDRESS 0x4001800e /* @ECU_Address@Can_BQ3_u8Ports@ */ /end MEASUREMENT
/begin MEASUREMENT Can_BQ4_u8Ports "" UBYTE SC_KZQ_EV2274A_4_1_CM_uint8 0 0 0 255 ECU_ADDRESS 0x40018010 /* @ECU_Address@Can_BQ4_u8Ports@ */ /end MEASUREMENT
/begin MEASUREMENT Can_Engine_u8PortsOfRx "" UBYTE SC_KZQ_EV2274A_4_1_CM_uint8 0 0 0 255 ECU_ADDRESS 0x40018013 /* @ECU_Address@Can_Engine_u8PortsOfRx@ */ /end MEASUREMENT
/begin MEASUREMENT Can_Engine_u8PortsOfTx "" UBYTE SC_KZQ_EV2274A_4_1_CM_uint8 0 0 0 255 ECU_ADDRESS 0x40018014 /* @ECU_Address@Can_Engine_u8PortsOfTx@ */ /end MEASUREMENT
/begin MEASUREMENT Can_M1_u8Ports "" UBYTE SC_KZQ_EV2274A_4_1_CM_uint8 0 0 0 255 ECU_ADDRESS 0x40018017 /* @ECU_Address@Can_M1_u8Ports@ */ /end MEASUREMENT
/begin MEASUREMENT Can_M2_u8Ports "" UBYTE SC_KZQ_EV2274A_4_1_CM_uint8 0 0 0 255 ECU_ADDRESS 0x4001801b /* @ECU_Address@Can_M2_u8Ports@ */ /end MEASUREMENT
/begin MEASUREMENT Can_OBC_u8Ports "" UBYTE SC_KZQ_EV2274A_4_1_CM_uint8 0 0 0 255 ECU_ADDRESS 0x4001801f /* @ECU_Address@Can_OBC_u8Ports@ */ /end MEASUREMENT
/begin MEASUREMENT Can_PDU_u8Ports "" UBYTE SC_KZQ_EV2274A_4_1_CM_uint8 0 0 0 255 ECU_ADDRESS 0x40018028 /* @ECU_Address@Can_PDU_u8Ports@ */ /end MEASUREMENT
/begin MEASUREMENT Can_RM1A_u8Ports "" UBYTE SC_KZQ_EV2274A_4_1_CM_uint8 0 0 0 255 ECU_ADDRESS 0x40018029 /* @ECU_Address@Can_RM1A_u8Ports@ */ /end MEASUREMENT
/begin MEASUREMENT Can_RM1_u8Ports "" UBYTE SC_KZQ_EV2274A_4_1_CM_uint8 0 0 0 255 ECU_ADDRESS 0x4001802b /* @ECU_Address@Can_RM1_u8Ports@ */ /end MEASUREMENT
/begin MEASUREMENT Can_TCU_u8Ports "" UBYTE SC_KZQ_EV2274A_4_1_CM_uint8 0 0 0 255 ECU_ADDRESS 0x4001802e /* @ECU_Address@Can_TCU_u8Ports@ */ /end MEASUREMENT
/begin MEASUREMENT System_HeartBeat_byState "" UBYTE SC_KZQ_EV2274A_4_1_CM_uint8 0 0 0 255 ECU_ADDRESS 0x40018035 /* @ECU_Address@System_HeartBeat_byState@ */ /end MEASUREMENT
/begin MEASUREMENT System_HeartBeat_gs_byAppCycleTime "" UBYTE SC_KZQ_EV2274A_4_1_CM_uint8 0 0 0 255 ECU_ADDRESS 0x40018036 /* @ECU_Address@System_HeartBeat_gs_byAppCycleTime@ */ /end MEASUREMENT
/begin MEASUREMENT System_gs_byNVMOperation "0-待机，无动作
      1-恢复默认设置
      2-store,存储数据，从RAM到ROM。
      4-restore，恢复数据，从ROM到RAM" UBYTE SC_KZQ_EV2274A_4_1_CM_uint8 0 0 0 255 ECU_ADDRESS 0x40018042 /* @ECU_Address@System_gs_byNVMOperation@ */ /end MEASUREMENT
/begin MEASUREMENT in_M1_u8ErrCode "" UBYTE SC_KZQ_EV2274A_4_1_CM_uint8 0 0 0 255 ECU_ADDRESS 0x4001840c /* @ECU_Address@in_M1_u8ErrCode@ */ /end MEASUREMENT
/begin MEASUREMENT in_M1_u8ErrLevel "" UBYTE SC_KZQ_EV2274A_4_1_CM_uint8 0 0 0 255 ECU_ADDRESS 0x4001840d /* @ECU_Address@in_M1_u8ErrLevel@ */ /end MEASUREMENT
/begin MEASUREMENT in_M1_u8WorkMode "" UBYTE SC_KZQ_EV2274A_4_1_CM_uint8 0 0 0 255 ECU_ADDRESS 0x4001840e /* @ECU_Address@in_M1_u8WorkMode@ */ /end MEASUREMENT
/begin MEASUREMENT in_M2_u8ErrCode "" UBYTE SC_KZQ_EV2274A_4_1_CM_uint8 0 0 0 255 ECU_ADDRESS 0x40018448 /* @ECU_Address@in_M2_u8ErrCode@ */ /end MEASUREMENT
/begin MEASUREMENT in_M2_u8ErrLevel "" UBYTE SC_KZQ_EV2274A_4_1_CM_uint8 0 0 0 255 ECU_ADDRESS 0x40018449 /* @ECU_Address@in_M2_u8ErrLevel@ */ /end MEASUREMENT
/begin MEASUREMENT in_M2_u8WorkMode "" UBYTE SC_KZQ_EV2274A_4_1_CM_uint8 0 0 0 255 ECU_ADDRESS 0x4001844a /* @ECU_Address@in_M2_u8WorkMode@ */ /end MEASUREMENT
/begin MEASUREMENT out_u8WindSpeedLevel "" UBYTE SC_KZQ_EV2274A_4_1_CM_uint8 0 0 0 255 ECU_ADDRESS 0x4001981e /* @ECU_Address@out_u8WindSpeedLevel@ */ /end MEASUREMENT
/begin MEASUREMENT Can_A1_JiachengJCP070_xEnable "" UBYTE SC_KZQ_EV2274A_4_1_CM_boolean 0 0 0 1 ECU_ADDRESS 0x40018000 /* @ECU_Address@Can_A1_JiachengJCP070_xEnable@ */ /end MEASUREMENT
/begin MEASUREMENT Can_A1_WikaICM7110_xEnable "" UBYTE SC_KZQ_EV2274A_4_1_CM_boolean 0 0 0 1 ECU_ADDRESS 0x40018001 /* @ECU_Address@Can_A1_WikaICM7110_xEnable@ */ /end MEASUREMENT
/begin MEASUREMENT Can_A1_xBusoff "" UBYTE SC_KZQ_EV2274A_4_1_CM_boolean 0 0 0 1 ECU_ADDRESS 0x40018003 /* @ECU_Address@Can_A1_xBusoff@ */ /end MEASUREMENT
/begin MEASUREMENT Can_A2_WiKaE102_xEnable "" UBYTE SC_KZQ_EV2274A_4_1_CM_boolean 0 0 0 1 ECU_ADDRESS 0x40018004 /* @ECU_Address@Can_A2_WiKaE102_xEnable@ */ /end MEASUREMENT
/begin MEASUREMENT Can_A2_xBusoff "" UBYTE SC_KZQ_EV2274A_4_1_CM_boolean 0 0 0 1 ECU_ADDRESS 0x40018006 /* @ECU_Address@Can_A2_xBusoff@ */ /end MEASUREMENT
/begin MEASUREMENT Can_BMS_CATL_xEnable "" UBYTE SC_KZQ_EV2274A_4_1_CM_boolean 0 0 0 1 ECU_ADDRESS 0x40018007 /* @ECU_Address@Can_BMS_CATL_xEnable@ */ /end MEASUREMENT
/begin MEASUREMENT Can_BMS_xBusoff "BMS节点掉线" UBYTE SC_KZQ_EV2274A_4_1_CM_boolean 0 0 0 1 ECU_ADDRESS 0x40018009 /* @ECU_Address@Can_BMS_xBusoff@ */ /end MEASUREMENT
/begin MEASUREMENT Can_BQ1_xBusoff "风速仪掉线" UBYTE SC_KZQ_EV2274A_4_1_CM_boolean 0 0 0 1 ECU_ADDRESS 0x4001800b /* @ECU_Address@Can_BQ1_xBusoff@ */ /end MEASUREMENT
/begin MEASUREMENT Can_BQ2_xBusoff "气泵气压传感器掉线" UBYTE SC_KZQ_EV2274A_4_1_CM_boolean 0 0 0 1 ECU_ADDRESS 0x4001800d /* @ECU_Address@Can_BQ2_xBusoff@ */ /end MEASUREMENT
/begin MEASUREMENT Can_BQ3_xBusoff "吊钩称重掉线" UBYTE SC_KZQ_EV2274A_4_1_CM_boolean 0 0 0 1 ECU_ADDRESS 0x4001800f /* @ECU_Address@Can_BQ3_xBusoff@ */ /end MEASUREMENT
/begin MEASUREMENT Can_BQ4_xBusoff "天窗气压传感器掉线" UBYTE SC_KZQ_EV2274A_4_1_CM_boolean 0 0 0 1 ECU_ADDRESS 0x40018011 /* @ECU_Address@Can_BQ4_xBusoff@ */ /end MEASUREMENT
/begin MEASUREMENT Can_Engine_ZQ_xEnable "" UBYTE SC_KZQ_EV2274A_4_1_CM_boolean 0 0 0 1 ECU_ADDRESS 0x40018012 /* @ECU_Address@Can_Engine_ZQ_xEnable@ */ /end MEASUREMENT
/begin MEASUREMENT Can_Engine_xBusoff "BMS节点掉线" UBYTE SC_KZQ_EV2274A_4_1_CM_boolean 0 0 0 1 ECU_ADDRESS 0x40018015 /* @ECU_Address@Can_Engine_xBusoff@ */ /end MEASUREMENT
/begin MEASUREMENT Can_M1_TopGear_xEnable "" UBYTE SC_KZQ_EV2274A_4_1_CM_boolean 0 0 0 1 ECU_ADDRESS 0x40018016 /* @ECU_Address@Can_M1_TopGear_xEnable@ */ /end MEASUREMENT
/begin MEASUREMENT Can_M1_xBusoff "" UBYTE SC_KZQ_EV2274A_4_1_CM_boolean 0 0 0 1 ECU_ADDRESS 0x40018018 /* @ECU_Address@Can_M1_xBusoff@ */ /end MEASUREMENT
/begin MEASUREMENT Can_M2_Gle_xEnable "OBC节点掉线" UBYTE SC_KZQ_EV2274A_4_1_CM_boolean 0 0 0 1 ECU_ADDRESS 0x40018019 /* @ECU_Address@Can_M2_Gle_xEnable@ */ /end MEASUREMENT
/begin MEASUREMENT Can_M2_TopGear_xEnable "" UBYTE SC_KZQ_EV2274A_4_1_CM_boolean 0 0 0 1 ECU_ADDRESS 0x4001801a /* @ECU_Address@Can_M2_TopGear_xEnable@ */ /end MEASUREMENT
/begin MEASUREMENT Can_M2_xBusoff "" UBYTE SC_KZQ_EV2274A_4_1_CM_boolean 0 0 0 1 ECU_ADDRESS 0x4001801c /* @ECU_Address@Can_M2_xBusoff@ */ /end MEASUREMENT
/begin MEASUREMENT Can_OBCPower_xBusoff "" UBYTE SC_KZQ_EV2274A_4_1_CM_boolean 0 0 0 1 ECU_ADDRESS 0x4001801d /* @ECU_Address@Can_OBCPower_xBusoff@ */ /end MEASUREMENT
/begin MEASUREMENT Can_OBC_LinkCharging_xEnable "" UBYTE SC_KZQ_EV2274A_4_1_CM_boolean 0 0 0 1 ECU_ADDRESS 0x4001801e /* @ECU_Address@Can_OBC_LinkCharging_xEnable@ */ /end MEASUREMENT
/begin MEASUREMENT Can_OBC_xBusoff "OBC节点掉线" UBYTE SC_KZQ_EV2274A_4_1_CM_boolean 0 0 0 1 ECU_ADDRESS 0x40018020 /* @ECU_Address@Can_OBC_xBusoff@ */ /end MEASUREMENT
/begin MEASUREMENT Can_PDU_DCAC2Power_xBusoff "DCAC2掉线" UBYTE SC_KZQ_EV2274A_4_1_CM_boolean 0 0 0 1 ECU_ADDRESS 0x40018021 /* @ECU_Address@Can_PDU_DCAC2Power_xBusoff@ */ /end MEASUREMENT
/begin MEASUREMENT Can_PDU_DCACPower_xBusoff "DCAC掉线" UBYTE SC_KZQ_EV2274A_4_1_CM_boolean 0 0 0 1 ECU_ADDRESS 0x40018022 /* @ECU_Address@Can_PDU_DCACPower_xBusoff@ */ /end MEASUREMENT
/begin MEASUREMENT Can_PDU_DCDCPower_xBusoff "DCDC掉线" UBYTE SC_KZQ_EV2274A_4_1_CM_boolean 0 0 0 1 ECU_ADDRESS 0x40018023 /* @ECU_Address@Can_PDU_DCDCPower_xBusoff@ */ /end MEASUREMENT
/begin MEASUREMENT Can_PDU_Haige_xEnable "" UBYTE SC_KZQ_EV2274A_4_1_CM_boolean 0 0 0 1 ECU_ADDRESS 0x40018024 /* @ECU_Address@Can_PDU_Haige_xEnable@ */ /end MEASUREMENT
/begin MEASUREMENT Can_PDU_M1Power_xBusoff "主驱电机掉线" UBYTE SC_KZQ_EV2274A_4_1_CM_boolean 0 0 0 1 ECU_ADDRESS 0x40018025 /* @ECU_Address@Can_PDU_M1Power_xBusoff@ */ /end MEASUREMENT
/begin MEASUREMENT Can_PDU_M2Power_xBusoff "油泵电机掉线" UBYTE SC_KZQ_EV2274A_4_1_CM_boolean 0 0 0 1 ECU_ADDRESS 0x40018026 /* @ECU_Address@Can_PDU_M2Power_xBusoff@ */ /end MEASUREMENT
/begin MEASUREMENT Can_PDU_XinAn_xEnable "" UBYTE SC_KZQ_EV2274A_4_1_CM_boolean 0 0 0 1 ECU_ADDRESS 0x40018027 /* @ECU_Address@Can_PDU_XinAn_xEnable@ */ /end MEASUREMENT
/begin MEASUREMENT Can_RM1A_xBusoff "" UBYTE SC_KZQ_EV2274A_4_1_CM_boolean 0 0 0 1 ECU_ADDRESS 0x4001802a /* @ECU_Address@Can_RM1A_xBusoff@ */ /end MEASUREMENT
/begin MEASUREMENT Can_RM1_xBusoff "主驱油门手柄掉线" UBYTE SC_KZQ_EV2274A_4_1_CM_boolean 0 0 0 1 ECU_ADDRESS 0x4001802c /* @ECU_Address@Can_RM1_xBusoff@ */ /end MEASUREMENT
/begin MEASUREMENT Can_TCU_TopGear_xEnable "" UBYTE SC_KZQ_EV2274A_4_1_CM_boolean 0 0 0 1 ECU_ADDRESS 0x4001802d /* @ECU_Address@Can_TCU_TopGear_xEnable@ */ /end MEASUREMENT
/begin MEASUREMENT Can_TCU_xBusoff "" UBYTE SC_KZQ_EV2274A_4_1_CM_boolean 0 0 0 1 ECU_ADDRESS 0x4001802f /* @ECU_Address@Can_TCU_xBusoff@ */ /end MEASUREMENT
/begin MEASUREMENT System_gs_xCanSleep "Can休眠信号
      " UBYTE SC_KZQ_EV2274A_4_1_CM_boolean 0 0 0 1 ECU_ADDRESS 0x40018048 /* @ECU_Address@System_gs_xCanSleep@ */ /end MEASUREMENT
/begin MEASUREMENT System_gs_xExecuteGsnVaraibleDefault "执行永久变量的默认值设置" UBYTE SC_KZQ_EV2274A_4_1_CM_boolean 0 0 0 1 ECU_ADDRESS 0x40018049 /* @ECU_Address@System_gs_xExecuteGsnVaraibleDefault@ */ /end MEASUREMENT
/begin MEASUREMENT System_gs_xExecuteModelPowerOn "执行机型版本的上电初始化
      " UBYTE SC_KZQ_EV2274A_4_1_CM_boolean 0 0 0 1 ECU_ADDRESS 0x4001804a /* @ECU_Address@System_gs_xExecuteModelPowerOn@ */ /end MEASUREMENT
/begin MEASUREMENT System_gs_xExecuteModelRetain "执行机型版本的永久变量初始化
      " UBYTE SC_KZQ_EV2274A_4_1_CM_boolean 0 0 0 1 ECU_ADDRESS 0x4001804b /* @ECU_Address@System_gs_xExecuteModelRetain@ */ /end MEASUREMENT
/begin MEASUREMENT System_gs_xHardwarePowerOn "" UBYTE SC_KZQ_EV2274A_4_1_CM_boolean 0 0 0 1 ECU_ADDRESS 0x4001804c /* @ECU_Address@System_gs_xHardwarePowerOn@ */ /end MEASUREMENT
/begin MEASUREMENT System_gs_xHardwireSleep "硬线休眠信号
      " UBYTE SC_KZQ_EV2274A_4_1_CM_boolean 0 0 0 1 ECU_ADDRESS 0x4001804d /* @ECU_Address@System_gs_xHardwireSleep@ */ /end MEASUREMENT
/begin MEASUREMENT System_gs_xSoftwarePowerOn "" UBYTE SC_KZQ_EV2274A_4_1_CM_boolean 0 0 0 1 ECU_ADDRESS 0x4001804e /* @ECU_Address@System_gs_xSoftwarePowerOn@ */ /end MEASUREMENT
/begin MEASUREMENT System_gs_xVCUPowerOffBusy "" UBYTE SC_KZQ_EV2274A_4_1_CM_boolean 0 0 0 1 ECU_ADDRESS 0x4001804f /* @ECU_Address@System_gs_xVCUPowerOffBusy@ */ /end MEASUREMENT
/begin MEASUREMENT System_gs_xVhieclePowerOffCompleted "" UBYTE SC_KZQ_EV2274A_4_1_CM_boolean 0 0 0 1 ECU_ADDRESS 0x40018050 /* @ECU_Address@System_gs_xVhieclePowerOffCompleted@ */ /end MEASUREMENT
/begin MEASUREMENT core_gs_xSDOWriteExecuted "" UBYTE SC_KZQ_EV2274A_4_1_CM_boolean 0 0 0 1 ECU_ADDRESS 0x40018078 /* @ECU_Address@core_gs_xSDOWriteExecuted@ */ /end MEASUREMENT
/begin MEASUREMENT fbBMSPower_xEnable "" UBYTE SC_KZQ_EV2274A_4_1_CM_boolean 0 0 0 1 ECU_ADDRESS 0x4001807a /* @ECU_Address@fbBMSPower_xEnable@ */ /end MEASUREMENT
/begin MEASUREMENT fbBMSPower_xFaultWaitingBusy "" UBYTE SC_KZQ_EV2274A_4_1_CM_boolean 0 0 0 1 ECU_ADDRESS 0x4001807b /* @ECU_Address@fbBMSPower_xFaultWaitingBusy@ */ /end MEASUREMENT
/begin MEASUREMENT fbBMSPower_xOffProcessBusy "" UBYTE SC_KZQ_EV2274A_4_1_CM_boolean 0 0 0 1 ECU_ADDRESS 0x4001807c /* @ECU_Address@fbBMSPower_xOffProcessBusy@ */ /end MEASUREMENT
/begin MEASUREMENT fbBMSPower_xOffProcessDone "" UBYTE SC_KZQ_EV2274A_4_1_CM_boolean 0 0 0 1 ECU_ADDRESS 0x4001807d /* @ECU_Address@fbBMSPower_xOffProcessDone@ */ /end MEASUREMENT
/begin MEASUREMENT fbBMSPower_xOffWaitingBusy "" UBYTE SC_KZQ_EV2274A_4_1_CM_boolean 0 0 0 1 ECU_ADDRESS 0x4001807e /* @ECU_Address@fbBMSPower_xOffWaitingBusy@ */ /end MEASUREMENT
/begin MEASUREMENT fbBMSPower_xOffWaitingDone "" UBYTE SC_KZQ_EV2274A_4_1_CM_boolean 0 0 0 1 ECU_ADDRESS 0x4001807f /* @ECU_Address@fbBMSPower_xOffWaitingDone@ */ /end MEASUREMENT
/begin MEASUREMENT fbBMSPower_xOnProcessBusy "" UBYTE SC_KZQ_EV2274A_4_1_CM_boolean 0 0 0 1 ECU_ADDRESS 0x40018080 /* @ECU_Address@fbBMSPower_xOnProcessBusy@ */ /end MEASUREMENT
/begin MEASUREMENT fbBMSPower_xOnProcessDone "" UBYTE SC_KZQ_EV2274A_4_1_CM_boolean 0 0 0 1 ECU_ADDRESS 0x40018081 /* @ECU_Address@fbBMSPower_xOnProcessDone@ */ /end MEASUREMENT
/begin MEASUREMENT fbBMSPower_xOnProcessErr "" UBYTE SC_KZQ_EV2274A_4_1_CM_boolean 0 0 0 1 ECU_ADDRESS 0x40018082 /* @ECU_Address@fbBMSPower_xOnProcessErr@ */ /end MEASUREMENT
/begin MEASUREMENT fbBMSPower_xPowerHoldBusy "上电保持执行中" UBYTE SC_KZQ_EV2274A_4_1_CM_boolean 0 0 0 1 ECU_ADDRESS 0x40018083 /* @ECU_Address@fbBMSPower_xPowerHoldBusy@ */ /end MEASUREMENT
/begin MEASUREMENT fbBMSPower_xPowerHoldErr "上电保持异常" UBYTE SC_KZQ_EV2274A_4_1_CM_boolean 0 0 0 1 ECU_ADDRESS 0x40018084 /* @ECU_Address@fbBMSPower_xPowerHoldErr@ */ /end MEASUREMENT
/begin MEASUREMENT fbBMSPower_xRunAllowed "" UBYTE SC_KZQ_EV2274A_4_1_CM_boolean 0 0 0 1 ECU_ADDRESS 0x40018085 /* @ECU_Address@fbBMSPower_xRunAllowed@ */ /end MEASUREMENT
/begin MEASUREMENT fbBMSPower_xStandbyBusy "等待过程中(包含自检过程)" UBYTE SC_KZQ_EV2274A_4_1_CM_boolean 0 0 0 1 ECU_ADDRESS 0x40018086 /* @ECU_Address@fbBMSPower_xStandbyBusy@ */ /end MEASUREMENT
/begin MEASUREMENT fbBMSPower_xStandbyErr "等待异常(包含自检过程)" UBYTE SC_KZQ_EV2274A_4_1_CM_boolean 0 0 0 1 ECU_ADDRESS 0x40018087 /* @ECU_Address@fbBMSPower_xStandbyErr@ */ /end MEASUREMENT
/begin MEASUREMENT fbBQ1_xEnable "" UBYTE SC_KZQ_EV2274A_4_1_CM_boolean 0 0 0 1 ECU_ADDRESS 0x400180ac /* @ECU_Address@fbBQ1_xEnable@ */ /end MEASUREMENT
/begin MEASUREMENT fbBQ1_xErr "" UBYTE SC_KZQ_EV2274A_4_1_CM_boolean 0 0 0 1 ECU_ADDRESS 0x400180ad /* @ECU_Address@fbBQ1_xErr@ */ /end MEASUREMENT
/begin MEASUREMENT fbBQ1_xOutA "" UBYTE SC_KZQ_EV2274A_4_1_CM_boolean 0 0 0 1 ECU_ADDRESS 0x400180ae /* @ECU_Address@fbBQ1_xOutA@ */ /end MEASUREMENT
/begin MEASUREMENT fbBQ1_xOutB "" UBYTE SC_KZQ_EV2274A_4_1_CM_boolean 0 0 0 1 ECU_ADDRESS 0x400180af /* @ECU_Address@fbBQ1_xOutB@ */ /end MEASUREMENT
/begin MEASUREMENT fbBQ2_xEnable "" UBYTE SC_KZQ_EV2274A_4_1_CM_boolean 0 0 0 1 ECU_ADDRESS 0x400180d4 /* @ECU_Address@fbBQ2_xEnable@ */ /end MEASUREMENT
/begin MEASUREMENT fbBQ2_xErr "" UBYTE SC_KZQ_EV2274A_4_1_CM_boolean 0 0 0 1 ECU_ADDRESS 0x400180d5 /* @ECU_Address@fbBQ2_xErr@ */ /end MEASUREMENT
/begin MEASUREMENT fbBQ2_xOutA "" UBYTE SC_KZQ_EV2274A_4_1_CM_boolean 0 0 0 1 ECU_ADDRESS 0x400180d6 /* @ECU_Address@fbBQ2_xOutA@ */ /end MEASUREMENT
/begin MEASUREMENT fbBQ2_xOutB "" UBYTE SC_KZQ_EV2274A_4_1_CM_boolean 0 0 0 1 ECU_ADDRESS 0x400180d7 /* @ECU_Address@fbBQ2_xOutB@ */ /end MEASUREMENT
/begin MEASUREMENT fbBQ3_xEnable "" UBYTE SC_KZQ_EV2274A_4_1_CM_boolean 0 0 0 1 ECU_ADDRESS 0x400180fc /* @ECU_Address@fbBQ3_xEnable@ */ /end MEASUREMENT
/begin MEASUREMENT fbBQ3_xErr "" UBYTE SC_KZQ_EV2274A_4_1_CM_boolean 0 0 0 1 ECU_ADDRESS 0x400180fd /* @ECU_Address@fbBQ3_xErr@ */ /end MEASUREMENT
/begin MEASUREMENT fbBQ3_xOutA "" UBYTE SC_KZQ_EV2274A_4_1_CM_boolean 0 0 0 1 ECU_ADDRESS 0x400180fe /* @ECU_Address@fbBQ3_xOutA@ */ /end MEASUREMENT
/begin MEASUREMENT fbBQ3_xOutB "" UBYTE SC_KZQ_EV2274A_4_1_CM_boolean 0 0 0 1 ECU_ADDRESS 0x400180ff /* @ECU_Address@fbBQ3_xOutB@ */ /end MEASUREMENT
/begin MEASUREMENT fbBQ4_xEnable "" UBYTE SC_KZQ_EV2274A_4_1_CM_boolean 0 0 0 1 ECU_ADDRESS 0x40018124 /* @ECU_Address@fbBQ4_xEnable@ */ /end MEASUREMENT
/begin MEASUREMENT fbBQ4_xErr "" UBYTE SC_KZQ_EV2274A_4_1_CM_boolean 0 0 0 1 ECU_ADDRESS 0x40018125 /* @ECU_Address@fbBQ4_xErr@ */ /end MEASUREMENT
/begin MEASUREMENT fbBQ4_xOutA "" UBYTE SC_KZQ_EV2274A_4_1_CM_boolean 0 0 0 1 ECU_ADDRESS 0x40018126 /* @ECU_Address@fbBQ4_xOutA@ */ /end MEASUREMENT
/begin MEASUREMENT fbBQ4_xOutB "" UBYTE SC_KZQ_EV2274A_4_1_CM_boolean 0 0 0 1 ECU_ADDRESS 0x40018127 /* @ECU_Address@fbBQ4_xOutB@ */ /end MEASUREMENT
/begin MEASUREMENT fbChargeManagement_xACChargeAllowed "" UBYTE SC_KZQ_EV2274A_4_1_CM_boolean 0 0 0 1 ECU_ADDRESS 0x40018130 /* @ECU_Address@fbChargeManagement_xACChargeAllowed@ */ /end MEASUREMENT
/begin MEASUREMENT fbChargeManagement_xEnable "" UBYTE SC_KZQ_EV2274A_4_1_CM_boolean 0 0 0 1 ECU_ADDRESS 0x40018131 /* @ECU_Address@fbChargeManagement_xEnable@ */ /end MEASUREMENT
/begin MEASUREMENT fbChargeManagement_xLoadRequest "" UBYTE SC_KZQ_EV2274A_4_1_CM_boolean 0 0 0 1 ECU_ADDRESS 0x40018132 /* @ECU_Address@fbChargeManagement_xLoadRequest@ */ /end MEASUREMENT
/begin MEASUREMENT fbChargeManagement_xRunAllowed "" UBYTE SC_KZQ_EV2274A_4_1_CM_boolean 0 0 0 1 ECU_ADDRESS 0x40018133 /* @ECU_Address@fbChargeManagement_xRunAllowed@ */ /end MEASUREMENT
/begin MEASUREMENT fbDCAC2Control_xEnable "" UBYTE SC_KZQ_EV2274A_4_1_CM_boolean 0 0 0 1 ECU_ADDRESS 0x40018135 /* @ECU_Address@fbDCAC2Control_xEnable@ */ /end MEASUREMENT
/begin MEASUREMENT fbDCAC2Control_xIn "" UBYTE SC_KZQ_EV2274A_4_1_CM_boolean 0 0 0 1 ECU_ADDRESS 0x40018136 /* @ECU_Address@fbDCAC2Control_xIn@ */ /end MEASUREMENT
/begin MEASUREMENT fbDCAC2Control_xOut "" UBYTE SC_KZQ_EV2274A_4_1_CM_boolean 0 0 0 1 ECU_ADDRESS 0x40018137 /* @ECU_Address@fbDCAC2Control_xOut@ */ /end MEASUREMENT
/begin MEASUREMENT fbDCAC2Power_xEnable "" UBYTE SC_KZQ_EV2274A_4_1_CM_boolean 0 0 0 1 ECU_ADDRESS 0x40018139 /* @ECU_Address@fbDCAC2Power_xEnable@ */ /end MEASUREMENT
/begin MEASUREMENT fbDCAC2Power_xOffProcessBusy "" UBYTE SC_KZQ_EV2274A_4_1_CM_boolean 0 0 0 1 ECU_ADDRESS 0x4001813a /* @ECU_Address@fbDCAC2Power_xOffProcessBusy@ */ /end MEASUREMENT
/begin MEASUREMENT fbDCAC2Power_xOffProcessDone "" UBYTE SC_KZQ_EV2274A_4_1_CM_boolean 0 0 0 1 ECU_ADDRESS 0x4001813b /* @ECU_Address@fbDCAC2Power_xOffProcessDone@ */ /end MEASUREMENT
/begin MEASUREMENT fbDCAC2Power_xOnProcessBusy "" UBYTE SC_KZQ_EV2274A_4_1_CM_boolean 0 0 0 1 ECU_ADDRESS 0x4001813c /* @ECU_Address@fbDCAC2Power_xOnProcessBusy@ */ /end MEASUREMENT
/begin MEASUREMENT fbDCAC2Power_xOnProcessDone "" UBYTE SC_KZQ_EV2274A_4_1_CM_boolean 0 0 0 1 ECU_ADDRESS 0x4001813d /* @ECU_Address@fbDCAC2Power_xOnProcessDone@ */ /end MEASUREMENT
/begin MEASUREMENT fbDCAC2Power_xPowerHoldBusy "" UBYTE SC_KZQ_EV2274A_4_1_CM_boolean 0 0 0 1 ECU_ADDRESS 0x4001813e /* @ECU_Address@fbDCAC2Power_xPowerHoldBusy@ */ /end MEASUREMENT
/begin MEASUREMENT fbDCAC2Power_xRunAllowed "" UBYTE SC_KZQ_EV2274A_4_1_CM_boolean 0 0 0 1 ECU_ADDRESS 0x4001813f /* @ECU_Address@fbDCAC2Power_xRunAllowed@ */ /end MEASUREMENT
/begin MEASUREMENT fbDCAC2Power_xStandbyBusy "" UBYTE SC_KZQ_EV2274A_4_1_CM_boolean 0 0 0 1 ECU_ADDRESS 0x40018140 /* @ECU_Address@fbDCAC2Power_xStandbyBusy@ */ /end MEASUREMENT
/begin MEASUREMENT fbDCACPower_xEnable "" UBYTE SC_KZQ_EV2274A_4_1_CM_boolean 0 0 0 1 ECU_ADDRESS 0x40018142 /* @ECU_Address@fbDCACPower_xEnable@ */ /end MEASUREMENT
/begin MEASUREMENT fbDCACPower_xOffProcessBusy "" UBYTE SC_KZQ_EV2274A_4_1_CM_boolean 0 0 0 1 ECU_ADDRESS 0x40018143 /* @ECU_Address@fbDCACPower_xOffProcessBusy@ */ /end MEASUREMENT
/begin MEASUREMENT fbDCACPower_xOffProcessDone "" UBYTE SC_KZQ_EV2274A_4_1_CM_boolean 0 0 0 1 ECU_ADDRESS 0x40018144 /* @ECU_Address@fbDCACPower_xOffProcessDone@ */ /end MEASUREMENT
/begin MEASUREMENT fbDCACPower_xOnProcessBusy "" UBYTE SC_KZQ_EV2274A_4_1_CM_boolean 0 0 0 1 ECU_ADDRESS 0x40018145 /* @ECU_Address@fbDCACPower_xOnProcessBusy@ */ /end MEASUREMENT
/begin MEASUREMENT fbDCACPower_xOnProcessDone "" UBYTE SC_KZQ_EV2274A_4_1_CM_boolean 0 0 0 1 ECU_ADDRESS 0x40018146 /* @ECU_Address@fbDCACPower_xOnProcessDone@ */ /end MEASUREMENT
/begin MEASUREMENT fbDCACPower_xPowerHoldBusy "" UBYTE SC_KZQ_EV2274A_4_1_CM_boolean 0 0 0 1 ECU_ADDRESS 0x40018147 /* @ECU_Address@fbDCACPower_xPowerHoldBusy@ */ /end MEASUREMENT
/begin MEASUREMENT fbDCACPower_xRunAllowed "" UBYTE SC_KZQ_EV2274A_4_1_CM_boolean 0 0 0 1 ECU_ADDRESS 0x40018148 /* @ECU_Address@fbDCACPower_xRunAllowed@ */ /end MEASUREMENT
/begin MEASUREMENT fbDCACPower_xStandbyBusy "" UBYTE SC_KZQ_EV2274A_4_1_CM_boolean 0 0 0 1 ECU_ADDRESS 0x40018149 /* @ECU_Address@fbDCACPower_xStandbyBusy@ */ /end MEASUREMENT
/begin MEASUREMENT fbDCDCControl_xEnable "" UBYTE SC_KZQ_EV2274A_4_1_CM_boolean 0 0 0 1 ECU_ADDRESS 0x4001814b /* @ECU_Address@fbDCDCControl_xEnable@ */ /end MEASUREMENT
/begin MEASUREMENT fbDCDCControl_xIn "" UBYTE SC_KZQ_EV2274A_4_1_CM_boolean 0 0 0 1 ECU_ADDRESS 0x4001814c /* @ECU_Address@fbDCDCControl_xIn@ */ /end MEASUREMENT
/begin MEASUREMENT fbDCDCControl_xOut "" UBYTE SC_KZQ_EV2274A_4_1_CM_boolean 0 0 0 1 ECU_ADDRESS 0x4001814d /* @ECU_Address@fbDCDCControl_xOut@ */ /end MEASUREMENT
/begin MEASUREMENT fbDCDCPower_xEnable "" UBYTE SC_KZQ_EV2274A_4_1_CM_boolean 0 0 0 1 ECU_ADDRESS 0x4001814f /* @ECU_Address@fbDCDCPower_xEnable@ */ /end MEASUREMENT
/begin MEASUREMENT fbDCDCPower_xOffProcessBusy "" UBYTE SC_KZQ_EV2274A_4_1_CM_boolean 0 0 0 1 ECU_ADDRESS 0x40018150 /* @ECU_Address@fbDCDCPower_xOffProcessBusy@ */ /end MEASUREMENT
/begin MEASUREMENT fbDCDCPower_xOffProcessDone "" UBYTE SC_KZQ_EV2274A_4_1_CM_boolean 0 0 0 1 ECU_ADDRESS 0x40018151 /* @ECU_Address@fbDCDCPower_xOffProcessDone@ */ /end MEASUREMENT
/begin MEASUREMENT fbDCDCPower_xOnProcessBusy "" UBYTE SC_KZQ_EV2274A_4_1_CM_boolean 0 0 0 1 ECU_ADDRESS 0x40018152 /* @ECU_Address@fbDCDCPower_xOnProcessBusy@ */ /end MEASUREMENT
/begin MEASUREMENT fbDCDCPower_xOnProcessDone "" UBYTE SC_KZQ_EV2274A_4_1_CM_boolean 0 0 0 1 ECU_ADDRESS 0x40018153 /* @ECU_Address@fbDCDCPower_xOnProcessDone@ */ /end MEASUREMENT
/begin MEASUREMENT fbDCDCPower_xPowerHoldBusy "" UBYTE SC_KZQ_EV2274A_4_1_CM_boolean 0 0 0 1 ECU_ADDRESS 0x40018154 /* @ECU_Address@fbDCDCPower_xPowerHoldBusy@ */ /end MEASUREMENT
/begin MEASUREMENT fbDCDCPower_xRunAllowed "" UBYTE SC_KZQ_EV2274A_4_1_CM_boolean 0 0 0 1 ECU_ADDRESS 0x40018155 /* @ECU_Address@fbDCDCPower_xRunAllowed@ */ /end MEASUREMENT
/begin MEASUREMENT fbDCDCPower_xStandbyBusy "" UBYTE SC_KZQ_EV2274A_4_1_CM_boolean 0 0 0 1 ECU_ADDRESS 0x40018156 /* @ECU_Address@fbDCDCPower_xStandbyBusy@ */ /end MEASUREMENT
/begin MEASUREMENT fbHA1_xEnable "" UBYTE SC_KZQ_EV2274A_4_1_CM_boolean 0 0 0 1 ECU_ADDRESS 0x40018158 /* @ECU_Address@fbHA1_xEnable@ */ /end MEASUREMENT
/begin MEASUREMENT fbHA1_xIn "" UBYTE SC_KZQ_EV2274A_4_1_CM_boolean 0 0 0 1 ECU_ADDRESS 0x40018159 /* @ECU_Address@fbHA1_xIn@ */ /end MEASUREMENT
/begin MEASUREMENT fbM1Clutch_xClosed "" UBYTE SC_KZQ_EV2274A_4_1_CM_boolean 0 0 0 1 ECU_ADDRESS 0x4001815a /* @ECU_Address@fbM1Clutch_xClosed@ */ /end MEASUREMENT
/begin MEASUREMENT fbM1Control_xBusy "" UBYTE SC_KZQ_EV2274A_4_1_CM_boolean 0 0 0 1 ECU_ADDRESS 0x40018180 /* @ECU_Address@fbM1Control_xBusy@ */ /end MEASUREMENT
/begin MEASUREMENT fbM1Control_xEnable "" UBYTE SC_KZQ_EV2274A_4_1_CM_boolean 0 0 0 1 ECU_ADDRESS 0x40018181 /* @ECU_Address@fbM1Control_xEnable@ */ /end MEASUREMENT
/begin MEASUREMENT fbM1Control_xRunAllowed "" UBYTE SC_KZQ_EV2274A_4_1_CM_boolean 0 0 0 1 ECU_ADDRESS 0x40018182 /* @ECU_Address@fbM1Control_xRunAllowed@ */ /end MEASUREMENT
/begin MEASUREMENT fbM1Control_xSpeedCmd "" UBYTE SC_KZQ_EV2274A_4_1_CM_boolean 0 0 0 1 ECU_ADDRESS 0x40018183 /* @ECU_Address@fbM1Control_xSpeedCmd@ */ /end MEASUREMENT
/begin MEASUREMENT fbM1Control_xTorqueCmd "" UBYTE SC_KZQ_EV2274A_4_1_CM_boolean 0 0 0 1 ECU_ADDRESS 0x40018184 /* @ECU_Address@fbM1Control_xTorqueCmd@ */ /end MEASUREMENT
/begin MEASUREMENT fbM1GearControl_xAvaiable "" UBYTE SC_KZQ_EV2274A_4_1_CM_boolean 0 0 0 1 ECU_ADDRESS 0x4001818c /* @ECU_Address@fbM1GearControl_xAvaiable@ */ /end MEASUREMENT
/begin MEASUREMENT fbM1GearControl_xEnable "" UBYTE SC_KZQ_EV2274A_4_1_CM_boolean 0 0 0 1 ECU_ADDRESS 0x4001818d /* @ECU_Address@fbM1GearControl_xEnable@ */ /end MEASUREMENT
/begin MEASUREMENT fbM1GearControl_xSwitchAllowed "" UBYTE SC_KZQ_EV2274A_4_1_CM_boolean 0 0 0 1 ECU_ADDRESS 0x4001818e /* @ECU_Address@fbM1GearControl_xSwitchAllowed@ */ /end MEASUREMENT
/begin MEASUREMENT fbM1GearLevel_xEnable "" UBYTE SC_KZQ_EV2274A_4_1_CM_boolean 0 0 0 1 ECU_ADDRESS 0x40018190 /* @ECU_Address@fbM1GearLevel_xEnable@ */ /end MEASUREMENT
/begin MEASUREMENT fbM1Power_xEnable "" UBYTE SC_KZQ_EV2274A_4_1_CM_boolean 0 0 0 1 ECU_ADDRESS 0x40018192 /* @ECU_Address@fbM1Power_xEnable@ */ /end MEASUREMENT
/begin MEASUREMENT fbM1Power_xOffContactorBusy "" UBYTE SC_KZQ_EV2274A_4_1_CM_boolean 0 0 0 1 ECU_ADDRESS 0x40018193 /* @ECU_Address@fbM1Power_xOffContactorBusy@ */ /end MEASUREMENT
/begin MEASUREMENT fbM1Power_xOffContactorDone "" UBYTE SC_KZQ_EV2274A_4_1_CM_boolean 0 0 0 1 ECU_ADDRESS 0x40018194 /* @ECU_Address@fbM1Power_xOffContactorDone@ */ /end MEASUREMENT
/begin MEASUREMENT fbM1Power_xOffControllerBusy "" UBYTE SC_KZQ_EV2274A_4_1_CM_boolean 0 0 0 1 ECU_ADDRESS 0x40018195 /* @ECU_Address@fbM1Power_xOffControllerBusy@ */ /end MEASUREMENT
/begin MEASUREMENT fbM1Power_xOffControllerDone "" UBYTE SC_KZQ_EV2274A_4_1_CM_boolean 0 0 0 1 ECU_ADDRESS 0x40018196 /* @ECU_Address@fbM1Power_xOffControllerDone@ */ /end MEASUREMENT
/begin MEASUREMENT fbM1Power_xOffMotorBusy "" UBYTE SC_KZQ_EV2274A_4_1_CM_boolean 0 0 0 1 ECU_ADDRESS 0x40018197 /* @ECU_Address@fbM1Power_xOffMotorBusy@ */ /end MEASUREMENT
/begin MEASUREMENT fbM1Power_xOffMotorDone "" UBYTE SC_KZQ_EV2274A_4_1_CM_boolean 0 0 0 1 ECU_ADDRESS 0x40018198 /* @ECU_Address@fbM1Power_xOffMotorDone@ */ /end MEASUREMENT
/begin MEASUREMENT fbM1Power_xOnContactorBusy "上电过程执行" UBYTE SC_KZQ_EV2274A_4_1_CM_boolean 0 0 0 1 ECU_ADDRESS 0x40018199 /* @ECU_Address@fbM1Power_xOnContactorBusy@ */ /end MEASUREMENT
/begin MEASUREMENT fbM1Power_xOnContactorDone "上电过程完成" UBYTE SC_KZQ_EV2274A_4_1_CM_boolean 0 0 0 1 ECU_ADDRESS 0x4001819a /* @ECU_Address@fbM1Power_xOnContactorDone@ */ /end MEASUREMENT
/begin MEASUREMENT fbM1Power_xOnPreChargeBusy "上电预充执行" UBYTE SC_KZQ_EV2274A_4_1_CM_boolean 0 0 0 1 ECU_ADDRESS 0x4001819b /* @ECU_Address@fbM1Power_xOnPreChargeBusy@ */ /end MEASUREMENT
/begin MEASUREMENT fbM1Power_xOnPreChargeDone "上电预充完成" UBYTE SC_KZQ_EV2274A_4_1_CM_boolean 0 0 0 1 ECU_ADDRESS 0x4001819c /* @ECU_Address@fbM1Power_xOnPreChargeDone@ */ /end MEASUREMENT
/begin MEASUREMENT fbM1Power_xPowerHoldBusy "" UBYTE SC_KZQ_EV2274A_4_1_CM_boolean 0 0 0 1 ECU_ADDRESS 0x4001819d /* @ECU_Address@fbM1Power_xPowerHoldBusy@ */ /end MEASUREMENT
/begin MEASUREMENT fbM1Power_xRunAllowed "允许运行" UBYTE SC_KZQ_EV2274A_4_1_CM_boolean 0 0 0 1 ECU_ADDRESS 0x4001819e /* @ECU_Address@fbM1Power_xRunAllowed@ */ /end MEASUREMENT
/begin MEASUREMENT fbM1Power_xStandbyBusy "等待过程中(包含自检过程)" UBYTE SC_KZQ_EV2274A_4_1_CM_boolean 0 0 0 1 ECU_ADDRESS 0x4001819f /* @ECU_Address@fbM1Power_xStandbyBusy@ */ /end MEASUREMENT
/begin MEASUREMENT fbM1Regen_xEnable "" UBYTE SC_KZQ_EV2274A_4_1_CM_boolean 0 0 0 1 ECU_ADDRESS 0x400181a8 /* @ECU_Address@fbM1Regen_xEnable@ */ /end MEASUREMENT
/begin MEASUREMENT fbM1Regen_xRunAllowed "" UBYTE SC_KZQ_EV2274A_4_1_CM_boolean 0 0 0 1 ECU_ADDRESS 0x400181a9 /* @ECU_Address@fbM1Regen_xRunAllowed@ */ /end MEASUREMENT
/begin MEASUREMENT fbM1Regen_xTorqueCmd "" UBYTE SC_KZQ_EV2274A_4_1_CM_boolean 0 0 0 1 ECU_ADDRESS 0x400181aa /* @ECU_Address@fbM1Regen_xTorqueCmd@ */ /end MEASUREMENT
/begin MEASUREMENT fbM2Control_xBusy "" UBYTE SC_KZQ_EV2274A_4_1_CM_boolean 0 0 0 1 ECU_ADDRESS 0x400181c0 /* @ECU_Address@fbM2Control_xBusy@ */ /end MEASUREMENT
/begin MEASUREMENT fbM2Control_xEnable "" UBYTE SC_KZQ_EV2274A_4_1_CM_boolean 0 0 0 1 ECU_ADDRESS 0x400181c1 /* @ECU_Address@fbM2Control_xEnable@ */ /end MEASUREMENT
/begin MEASUREMENT fbM2Control_xRunAllowed "" UBYTE SC_KZQ_EV2274A_4_1_CM_boolean 0 0 0 1 ECU_ADDRESS 0x400181c2 /* @ECU_Address@fbM2Control_xRunAllowed@ */ /end MEASUREMENT
/begin MEASUREMENT fbM2Control_xSpeedCmd "" UBYTE SC_KZQ_EV2274A_4_1_CM_boolean 0 0 0 1 ECU_ADDRESS 0x400181c3 /* @ECU_Address@fbM2Control_xSpeedCmd@ */ /end MEASUREMENT
/begin MEASUREMENT fbM2Control_xSpeedLimited "" UBYTE SC_KZQ_EV2274A_4_1_CM_boolean 0 0 0 1 ECU_ADDRESS 0x400181c4 /* @ECU_Address@fbM2Control_xSpeedLimited@ */ /end MEASUREMENT
/begin MEASUREMENT fbM2Power_xEnable "BMSPower使能开关，配置使能" UBYTE SC_KZQ_EV2274A_4_1_CM_boolean 0 0 0 1 ECU_ADDRESS 0x400181c6 /* @ECU_Address@fbM2Power_xEnable@ */ /end MEASUREMENT
/begin MEASUREMENT fbM2Power_xOffContactorBusy "上电过程执行
      " UBYTE SC_KZQ_EV2274A_4_1_CM_boolean 0 0 0 1 ECU_ADDRESS 0x400181c7 /* @ECU_Address@fbM2Power_xOffContactorBusy@ */ /end MEASUREMENT
/begin MEASUREMENT fbM2Power_xOffContactorDone "下电过程完成" UBYTE SC_KZQ_EV2274A_4_1_CM_boolean 0 0 0 1 ECU_ADDRESS 0x400181c8 /* @ECU_Address@fbM2Power_xOffContactorDone@ */ /end MEASUREMENT
/begin MEASUREMENT fbM2Power_xOffControllerBusy "下电等待执行
      " UBYTE SC_KZQ_EV2274A_4_1_CM_boolean 0 0 0 1 ECU_ADDRESS 0x400181c9 /* @ECU_Address@fbM2Power_xOffControllerBusy@ */ /end MEASUREMENT
/begin MEASUREMENT fbM2Power_xOffControllerDone "下电等待完成" UBYTE SC_KZQ_EV2274A_4_1_CM_boolean 0 0 0 1 ECU_ADDRESS 0x400181ca /* @ECU_Address@fbM2Power_xOffControllerDone@ */ /end MEASUREMENT
/begin MEASUREMENT fbM2Power_xOffMotorBusy "下电等待执行
      " UBYTE SC_KZQ_EV2274A_4_1_CM_boolean 0 0 0 1 ECU_ADDRESS 0x400181cb /* @ECU_Address@fbM2Power_xOffMotorBusy@ */ /end MEASUREMENT
/begin MEASUREMENT fbM2Power_xOffMotorDone "下电等待完成" UBYTE SC_KZQ_EV2274A_4_1_CM_boolean 0 0 0 1 ECU_ADDRESS 0x400181cc /* @ECU_Address@fbM2Power_xOffMotorDone@ */ /end MEASUREMENT
/begin MEASUREMENT fbM2Power_xOnContactorBusy "上电过程执行" UBYTE SC_KZQ_EV2274A_4_1_CM_boolean 0 0 0 1 ECU_ADDRESS 0x400181cd /* @ECU_Address@fbM2Power_xOnContactorBusy@ */ /end MEASUREMENT
/begin MEASUREMENT fbM2Power_xOnContactorDone "上电过程完成" UBYTE SC_KZQ_EV2274A_4_1_CM_boolean 0 0 0 1 ECU_ADDRESS 0x400181ce /* @ECU_Address@fbM2Power_xOnContactorDone@ */ /end MEASUREMENT
/begin MEASUREMENT fbM2Power_xOnPreChargeBusy "" UBYTE SC_KZQ_EV2274A_4_1_CM_boolean 0 0 0 1 ECU_ADDRESS 0x400181cf /* @ECU_Address@fbM2Power_xOnPreChargeBusy@ */ /end MEASUREMENT
/begin MEASUREMENT fbM2Power_xOnPreChargeDone "" UBYTE SC_KZQ_EV2274A_4_1_CM_boolean 0 0 0 1 ECU_ADDRESS 0x400181d0 /* @ECU_Address@fbM2Power_xOnPreChargeDone@ */ /end MEASUREMENT
/begin MEASUREMENT fbM2Power_xPowerHoldBusy "上电保持执行" UBYTE SC_KZQ_EV2274A_4_1_CM_boolean 0 0 0 1 ECU_ADDRESS 0x400181d1 /* @ECU_Address@fbM2Power_xPowerHoldBusy@ */ /end MEASUREMENT
/begin MEASUREMENT fbM2Power_xRunAllowed "允许运行" UBYTE SC_KZQ_EV2274A_4_1_CM_boolean 0 0 0 1 ECU_ADDRESS 0x400181d2 /* @ECU_Address@fbM2Power_xRunAllowed@ */ /end MEASUREMENT
/begin MEASUREMENT fbM2Power_xStandbyBusy "等待过程中(包含自检过程)" UBYTE SC_KZQ_EV2274A_4_1_CM_boolean 0 0 0 1 ECU_ADDRESS 0x400181d3 /* @ECU_Address@fbM2Power_xStandbyBusy@ */ /end MEASUREMENT
/begin MEASUREMENT fbM3_xEnable "" UBYTE SC_KZQ_EV2274A_4_1_CM_boolean 0 0 0 1 ECU_ADDRESS 0x400181d5 /* @ECU_Address@fbM3_xEnable@ */ /end MEASUREMENT
/begin MEASUREMENT fbM3_xIn "" UBYTE SC_KZQ_EV2274A_4_1_CM_boolean 0 0 0 1 ECU_ADDRESS 0x400181d6 /* @ECU_Address@fbM3_xIn@ */ /end MEASUREMENT
/begin MEASUREMENT fbM3_xOut "" UBYTE SC_KZQ_EV2274A_4_1_CM_boolean 0 0 0 1 ECU_ADDRESS 0x400181d7 /* @ECU_Address@fbM3_xOut@ */ /end MEASUREMENT
/begin MEASUREMENT fbOBCPower_xEnable "" UBYTE SC_KZQ_EV2274A_4_1_CM_boolean 0 0 0 1 ECU_ADDRESS 0x400181d9 /* @ECU_Address@fbOBCPower_xEnable@ */ /end MEASUREMENT
/begin MEASUREMENT fbOBCPower_xOffProcessBusy "" UBYTE SC_KZQ_EV2274A_4_1_CM_boolean 0 0 0 1 ECU_ADDRESS 0x400181da /* @ECU_Address@fbOBCPower_xOffProcessBusy@ */ /end MEASUREMENT
/begin MEASUREMENT fbOBCPower_xOffProcessDone "" UBYTE SC_KZQ_EV2274A_4_1_CM_boolean 0 0 0 1 ECU_ADDRESS 0x400181db /* @ECU_Address@fbOBCPower_xOffProcessDone@ */ /end MEASUREMENT
/begin MEASUREMENT fbOBCPower_xOnProcessBusy "" UBYTE SC_KZQ_EV2274A_4_1_CM_boolean 0 0 0 1 ECU_ADDRESS 0x400181dc /* @ECU_Address@fbOBCPower_xOnProcessBusy@ */ /end MEASUREMENT
/begin MEASUREMENT fbOBCPower_xOnProcessDone "" UBYTE SC_KZQ_EV2274A_4_1_CM_boolean 0 0 0 1 ECU_ADDRESS 0x400181dd /* @ECU_Address@fbOBCPower_xOnProcessDone@ */ /end MEASUREMENT
/begin MEASUREMENT fbOBCPower_xPowerHoldBusy "" UBYTE SC_KZQ_EV2274A_4_1_CM_boolean 0 0 0 1 ECU_ADDRESS 0x400181de /* @ECU_Address@fbOBCPower_xPowerHoldBusy@ */ /end MEASUREMENT
/begin MEASUREMENT fbOBCPower_xRunAllowed "" UBYTE SC_KZQ_EV2274A_4_1_CM_boolean 0 0 0 1 ECU_ADDRESS 0x400181df /* @ECU_Address@fbOBCPower_xRunAllowed@ */ /end MEASUREMENT
/begin MEASUREMENT fbOBCPower_xStandbyBusy "" UBYTE SC_KZQ_EV2274A_4_1_CM_boolean 0 0 0 1 ECU_ADDRESS 0x400181e0 /* @ECU_Address@fbOBCPower_xStandbyBusy@ */ /end MEASUREMENT
/begin MEASUREMENT fbPTO_xEnable "" UBYTE SC_KZQ_EV2274A_4_1_CM_boolean 0 0 0 1 ECU_ADDRESS 0x400181e2 /* @ECU_Address@fbPTO_xEnable@ */ /end MEASUREMENT
/begin MEASUREMENT fbPTO_xIn "" UBYTE SC_KZQ_EV2274A_4_1_CM_boolean 0 0 0 1 ECU_ADDRESS 0x400181e3 /* @ECU_Address@fbPTO_xIn@ */ /end MEASUREMENT
/begin MEASUREMENT fbRM1A_xEnable "" UBYTE SC_KZQ_EV2274A_4_1_CM_boolean 0 0 0 1 ECU_ADDRESS 0x40018208 /* @ECU_Address@fbRM1A_xEnable@ */ /end MEASUREMENT
/begin MEASUREMENT fbRM1A_xErr "" UBYTE SC_KZQ_EV2274A_4_1_CM_boolean 0 0 0 1 ECU_ADDRESS 0x40018209 /* @ECU_Address@fbRM1A_xErr@ */ /end MEASUREMENT
/begin MEASUREMENT fbRM1A_xOutA "" UBYTE SC_KZQ_EV2274A_4_1_CM_boolean 0 0 0 1 ECU_ADDRESS 0x4001820a /* @ECU_Address@fbRM1A_xOutA@ */ /end MEASUREMENT
/begin MEASUREMENT fbRM1A_xOutB "" UBYTE SC_KZQ_EV2274A_4_1_CM_boolean 0 0 0 1 ECU_ADDRESS 0x4001820b /* @ECU_Address@fbRM1A_xOutB@ */ /end MEASUREMENT
/begin MEASUREMENT fbRM1_xEnable "" UBYTE SC_KZQ_EV2274A_4_1_CM_boolean 0 0 0 1 ECU_ADDRESS 0x40018230 /* @ECU_Address@fbRM1_xEnable@ */ /end MEASUREMENT
/begin MEASUREMENT fbRM1_xErr "" UBYTE SC_KZQ_EV2274A_4_1_CM_boolean 0 0 0 1 ECU_ADDRESS 0x40018231 /* @ECU_Address@fbRM1_xErr@ */ /end MEASUREMENT
/begin MEASUREMENT fbRM1_xOutA "" UBYTE SC_KZQ_EV2274A_4_1_CM_boolean 0 0 0 1 ECU_ADDRESS 0x40018232 /* @ECU_Address@fbRM1_xOutA@ */ /end MEASUREMENT
/begin MEASUREMENT fbRM1_xOutB "" UBYTE SC_KZQ_EV2274A_4_1_CM_boolean 0 0 0 1 ECU_ADDRESS 0x40018233 /* @ECU_Address@fbRM1_xOutB@ */ /end MEASUREMENT
/begin MEASUREMENT fbS1_xEnable "" UBYTE SC_KZQ_EV2274A_4_1_CM_boolean 0 0 0 1 ECU_ADDRESS 0x40018235 /* @ECU_Address@fbS1_xEnable@ */ /end MEASUREMENT
/begin MEASUREMENT fbS1_xOut "" UBYTE SC_KZQ_EV2274A_4_1_CM_boolean 0 0 0 1 ECU_ADDRESS 0x40018236 /* @ECU_Address@fbS1_xOut@ */ /end MEASUREMENT
/begin MEASUREMENT fbS2_xEnable "" UBYTE SC_KZQ_EV2274A_4_1_CM_boolean 0 0 0 1 ECU_ADDRESS 0x40018238 /* @ECU_Address@fbS2_xEnable@ */ /end MEASUREMENT
/begin MEASUREMENT fbS2_xOut "" UBYTE SC_KZQ_EV2274A_4_1_CM_boolean 0 0 0 1 ECU_ADDRESS 0x40018239 /* @ECU_Address@fbS2_xOut@ */ /end MEASUREMENT
/begin MEASUREMENT fbS3_xEnable "" UBYTE SC_KZQ_EV2274A_4_1_CM_boolean 0 0 0 1 ECU_ADDRESS 0x4001823b /* @ECU_Address@fbS3_xEnable@ */ /end MEASUREMENT
/begin MEASUREMENT fbS3_xOut "" UBYTE SC_KZQ_EV2274A_4_1_CM_boolean 0 0 0 1 ECU_ADDRESS 0x4001823c /* @ECU_Address@fbS3_xOut@ */ /end MEASUREMENT
/begin MEASUREMENT fbS4_xEnable "" UBYTE SC_KZQ_EV2274A_4_1_CM_boolean 0 0 0 1 ECU_ADDRESS 0x4001823e /* @ECU_Address@fbS4_xEnable@ */ /end MEASUREMENT
/begin MEASUREMENT fbS4_xOut "" UBYTE SC_KZQ_EV2274A_4_1_CM_boolean 0 0 0 1 ECU_ADDRESS 0x4001823f /* @ECU_Address@fbS4_xOut@ */ /end MEASUREMENT
/begin MEASUREMENT fbS5_xEnable "" UBYTE SC_KZQ_EV2274A_4_1_CM_boolean 0 0 0 1 ECU_ADDRESS 0x40018241 /* @ECU_Address@fbS5_xEnable@ */ /end MEASUREMENT
/begin MEASUREMENT fbS5_xOut "" UBYTE SC_KZQ_EV2274A_4_1_CM_boolean 0 0 0 1 ECU_ADDRESS 0x40018242 /* @ECU_Address@fbS5_xOut@ */ /end MEASUREMENT
/begin MEASUREMENT fbS8D1_xEnable "" UBYTE SC_KZQ_EV2274A_4_1_CM_boolean 0 0 0 1 ECU_ADDRESS 0x40018244 /* @ECU_Address@fbS8D1_xEnable@ */ /end MEASUREMENT
/begin MEASUREMENT fbS8D1_xOut "" UBYTE SC_KZQ_EV2274A_4_1_CM_boolean 0 0 0 1 ECU_ADDRESS 0x40018245 /* @ECU_Address@fbS8D1_xOut@ */ /end MEASUREMENT
/begin MEASUREMENT fbS8D2_xEnable "" UBYTE SC_KZQ_EV2274A_4_1_CM_boolean 0 0 0 1 ECU_ADDRESS 0x40018247 /* @ECU_Address@fbS8D2_xEnable@ */ /end MEASUREMENT
/begin MEASUREMENT fbS8D2_xOut "" UBYTE SC_KZQ_EV2274A_4_1_CM_boolean 0 0 0 1 ECU_ADDRESS 0x40018248 /* @ECU_Address@fbS8D2_xOut@ */ /end MEASUREMENT
/begin MEASUREMENT fbS8D3_xEnable "" UBYTE SC_KZQ_EV2274A_4_1_CM_boolean 0 0 0 1 ECU_ADDRESS 0x4001824a /* @ECU_Address@fbS8D3_xEnable@ */ /end MEASUREMENT
/begin MEASUREMENT fbS8D3_xOut "" UBYTE SC_KZQ_EV2274A_4_1_CM_boolean 0 0 0 1 ECU_ADDRESS 0x4001824b /* @ECU_Address@fbS8D3_xOut@ */ /end MEASUREMENT
/begin MEASUREMENT fbS8D4_xEnable "" UBYTE SC_KZQ_EV2274A_4_1_CM_boolean 0 0 0 1 ECU_ADDRESS 0x4001824d /* @ECU_Address@fbS8D4_xEnable@ */ /end MEASUREMENT
/begin MEASUREMENT fbS8D4_xOut "" UBYTE SC_KZQ_EV2274A_4_1_CM_boolean 0 0 0 1 ECU_ADDRESS 0x4001824e /* @ECU_Address@fbS8D4_xOut@ */ /end MEASUREMENT
/begin MEASUREMENT fbS8R_xEnable "" UBYTE SC_KZQ_EV2274A_4_1_CM_boolean 0 0 0 1 ECU_ADDRESS 0x40018250 /* @ECU_Address@fbS8R_xEnable@ */ /end MEASUREMENT
/begin MEASUREMENT fbS8R_xOut "" UBYTE SC_KZQ_EV2274A_4_1_CM_boolean 0 0 0 1 ECU_ADDRESS 0x40018251 /* @ECU_Address@fbS8R_xOut@ */ /end MEASUREMENT
/begin MEASUREMENT fbSHA1_xEnable "" UBYTE SC_KZQ_EV2274A_4_1_CM_boolean 0 0 0 1 ECU_ADDRESS 0x40018253 /* @ECU_Address@fbSHA1_xEnable@ */ /end MEASUREMENT
/begin MEASUREMENT fbSHA1_xOut "" UBYTE SC_KZQ_EV2274A_4_1_CM_boolean 0 0 0 1 ECU_ADDRESS 0x40018254 /* @ECU_Address@fbSHA1_xOut@ */ /end MEASUREMENT
/begin MEASUREMENT fbSM1A_xEnable "" UBYTE SC_KZQ_EV2274A_4_1_CM_boolean 0 0 0 1 ECU_ADDRESS 0x40018256 /* @ECU_Address@fbSM1A_xEnable@ */ /end MEASUREMENT
/begin MEASUREMENT fbSM1A_xOut "" UBYTE SC_KZQ_EV2274A_4_1_CM_boolean 0 0 0 1 ECU_ADDRESS 0x40018257 /* @ECU_Address@fbSM1A_xOut@ */ /end MEASUREMENT
/begin MEASUREMENT fbSM1_xEnable "" UBYTE SC_KZQ_EV2274A_4_1_CM_boolean 0 0 0 1 ECU_ADDRESS 0x40018259 /* @ECU_Address@fbSM1_xEnable@ */ /end MEASUREMENT
/begin MEASUREMENT fbSM1_xOut "" UBYTE SC_KZQ_EV2274A_4_1_CM_boolean 0 0 0 1 ECU_ADDRESS 0x4001825a /* @ECU_Address@fbSM1_xOut@ */ /end MEASUREMENT
/begin MEASUREMENT fbSM2H_xEnable "" UBYTE SC_KZQ_EV2274A_4_1_CM_boolean 0 0 0 1 ECU_ADDRESS 0x4001825c /* @ECU_Address@fbSM2H_xEnable@ */ /end MEASUREMENT
/begin MEASUREMENT fbSM2H_xOut "" UBYTE SC_KZQ_EV2274A_4_1_CM_boolean 0 0 0 1 ECU_ADDRESS 0x4001825d /* @ECU_Address@fbSM2H_xOut@ */ /end MEASUREMENT
/begin MEASUREMENT fbSM2L_xEnable "" UBYTE SC_KZQ_EV2274A_4_1_CM_boolean 0 0 0 1 ECU_ADDRESS 0x4001825f /* @ECU_Address@fbSM2L_xEnable@ */ /end MEASUREMENT
/begin MEASUREMENT fbSM2L_xOut "" UBYTE SC_KZQ_EV2274A_4_1_CM_boolean 0 0 0 1 ECU_ADDRESS 0x40018260 /* @ECU_Address@fbSM2L_xOut@ */ /end MEASUREMENT
/begin MEASUREMENT fbSM3_xEnable "" UBYTE SC_KZQ_EV2274A_4_1_CM_boolean 0 0 0 1 ECU_ADDRESS 0x40018262 /* @ECU_Address@fbSM3_xEnable@ */ /end MEASUREMENT
/begin MEASUREMENT fbSM3_xOut "" UBYTE SC_KZQ_EV2274A_4_1_CM_boolean 0 0 0 1 ECU_ADDRESS 0x40018263 /* @ECU_Address@fbSM3_xOut@ */ /end MEASUREMENT
/begin MEASUREMENT fbSQ1_xEnable "" UBYTE SC_KZQ_EV2274A_4_1_CM_boolean 0 0 0 1 ECU_ADDRESS 0x40018265 /* @ECU_Address@fbSQ1_xEnable@ */ /end MEASUREMENT
/begin MEASUREMENT fbSQ1_xOut "" UBYTE SC_KZQ_EV2274A_4_1_CM_boolean 0 0 0 1 ECU_ADDRESS 0x40018266 /* @ECU_Address@fbSQ1_xOut@ */ /end MEASUREMENT
/begin MEASUREMENT gs_Enable_GPS_xAnitHeartbeatOffDirective "" UBYTE SC_KZQ_EV2274A_4_1_CM_boolean 0 0 0 1 ECU_ADDRESS 0x40018267 /* @ECU_Address@gs_Enable_GPS_xAnitHeartbeatOffDirective@ */ /end MEASUREMENT
/begin MEASUREMENT gs_Enable_GPS_xAnitNetOffDirective "" UBYTE SC_KZQ_EV2274A_4_1_CM_boolean 0 0 0 1 ECU_ADDRESS 0x40018268 /* @ECU_Address@gs_Enable_GPS_xAnitNetOffDirective@ */ /end MEASUREMENT
/begin MEASUREMENT gs_Enable_GPS_xLockDirective "" UBYTE SC_KZQ_EV2274A_4_1_CM_boolean 0 0 0 1 ECU_ADDRESS 0x40018269 /* @ECU_Address@gs_Enable_GPS_xLockDirective@ */ /end MEASUREMENT
/begin MEASUREMENT gs_Enable_xM1ReverseDirection "M1主驱电机工作方向反向" UBYTE SC_KZQ_EV2274A_4_1_CM_boolean 0 0 0 1 ECU_ADDRESS 0x4001826a /* @ECU_Address@gs_Enable_xM1ReverseDirection@ */ /end MEASUREMENT
/begin MEASUREMENT gs_Enable_xM2ReverseDirection "M2油泵电机工作方向反向" UBYTE SC_KZQ_EV2274A_4_1_CM_boolean 0 0 0 1 ECU_ADDRESS 0x4001826b /* @ECU_Address@gs_Enable_xM2ReverseDirection@ */ /end MEASUREMENT
/begin MEASUREMENT gs_Enable_xRM1CtrlClutch "吊钩手柄控制离合" UBYTE SC_KZQ_EV2274A_4_1_CM_boolean 0 0 0 1 ECU_ADDRESS 0x4001826c /* @ECU_Address@gs_Enable_xRM1CtrlClutch@ */ /end MEASUREMENT
/begin MEASUREMENT gs_GPS_xKeyActived "" UBYTE SC_KZQ_EV2274A_4_1_CM_boolean 0 0 0 1 ECU_ADDRESS 0x40018278 /* @ECU_Address@gs_GPS_xKeyActived@ */ /end MEASUREMENT
/begin MEASUREMENT gs_GPS_xSeedActived "" UBYTE SC_KZQ_EV2274A_4_1_CM_boolean 0 0 0 1 ECU_ADDRESS 0x40018279 /* @ECU_Address@gs_GPS_xSeedActived@ */ /end MEASUREMENT
/begin MEASUREMENT in_A1_xACChargeModeRequest "" UBYTE SC_KZQ_EV2274A_4_1_CM_boolean 0 0 0 1 ECU_ADDRESS 0x40018398 /* @ECU_Address@in_A1_xACChargeModeRequest@ */ /end MEASUREMENT
/begin MEASUREMENT in_A1_xACRechargeModeRequest "" UBYTE SC_KZQ_EV2274A_4_1_CM_boolean 0 0 0 1 ECU_ADDRESS 0x40018399 /* @ECU_Address@in_A1_xACRechargeModeRequest@ */ /end MEASUREMENT
/begin MEASUREMENT in_A1_xChargeRequest "" UBYTE SC_KZQ_EV2274A_4_1_CM_boolean 0 0 0 1 ECU_ADDRESS 0x4001839a /* @ECU_Address@in_A1_xChargeRequest@ */ /end MEASUREMENT
/begin MEASUREMENT in_A1_xDCAC2Request "" UBYTE SC_KZQ_EV2274A_4_1_CM_boolean 0 0 0 1 ECU_ADDRESS 0x4001839b /* @ECU_Address@in_A1_xDCAC2Request@ */ /end MEASUREMENT
/begin MEASUREMENT in_A1_xRemoteRequestAviable "" UBYTE SC_KZQ_EV2274A_4_1_CM_boolean 0 0 0 1 ECU_ADDRESS 0x4001839c /* @ECU_Address@in_A1_xRemoteRequestAviable@ */ /end MEASUREMENT
/begin MEASUREMENT in_BMS_xChargeCmd "交流充电模式下，电池的充电请求" UBYTE SC_KZQ_EV2274A_4_1_CM_boolean 0 0 0 1 ECU_ADDRESS 0x400183d4 /* @ECU_Address@in_BMS_xChargeCmd@ */ /end MEASUREMENT
/begin MEASUREMENT in_BMS_xCooling "BMS冷却中" UBYTE SC_KZQ_EV2274A_4_1_CM_boolean 0 0 0 1 ECU_ADDRESS 0x400183d5 /* @ECU_Address@in_BMS_xCooling@ */ /end MEASUREMENT
/begin MEASUREMENT in_BMS_xHeating "BMS加热中" UBYTE SC_KZQ_EV2274A_4_1_CM_boolean 0 0 0 1 ECU_ADDRESS 0x400183d6 /* @ECU_Address@in_BMS_xHeating@ */ /end MEASUREMENT
/begin MEASUREMENT in_BMS_xLimpErr "跛行异常" UBYTE SC_KZQ_EV2274A_4_1_CM_boolean 0 0 0 1 ECU_ADDRESS 0x400183d7 /* @ECU_Address@in_BMS_xLimpErr@ */ /end MEASUREMENT
/begin MEASUREMENT in_BMS_xPowerOffRequestFromBMS "高压下电请求" UBYTE SC_KZQ_EV2274A_4_1_CM_boolean 0 0 0 1 ECU_ADDRESS 0x400183d8 /* @ECU_Address@in_BMS_xPowerOffRequestFromBMS@ */ /end MEASUREMENT
/begin MEASUREMENT in_DCAC2Control_xErr "" UBYTE SC_KZQ_EV2274A_4_1_CM_boolean 0 0 0 1 ECU_ADDRESS 0x400183d9 /* @ECU_Address@in_DCAC2Control_xErr@ */ /end MEASUREMENT
/begin MEASUREMENT in_DCDCControl_xErr "" UBYTE SC_KZQ_EV2274A_4_1_CM_boolean 0 0 0 1 ECU_ADDRESS 0x400183da /* @ECU_Address@in_DCDCControl_xErr@ */ /end MEASUREMENT
/begin MEASUREMENT in_GPS_xAppNetOff "" UBYTE SC_KZQ_EV2274A_4_1_CM_boolean 0 0 0 1 ECU_ADDRESS 0x400183db /* @ECU_Address@in_GPS_xAppNetOff@ */ /end MEASUREMENT
/begin MEASUREMENT in_GPS_xCarrierNetOff "" UBYTE SC_KZQ_EV2274A_4_1_CM_boolean 0 0 0 1 ECU_ADDRESS 0x400183dc /* @ECU_Address@in_GPS_xCarrierNetOff@ */ /end MEASUREMENT
/begin MEASUREMENT in_GPS_xHeartbeatOff "" UBYTE SC_KZQ_EV2274A_4_1_CM_boolean 0 0 0 1 ECU_ADDRESS 0x400183dd /* @ECU_Address@in_GPS_xHeartbeatOff@ */ /end MEASUREMENT
/begin MEASUREMENT in_GPS_xSimCardOff "" UBYTE SC_KZQ_EV2274A_4_1_CM_boolean 0 0 0 1 ECU_ADDRESS 0x400183de /* @ECU_Address@in_GPS_xSimCardOff@ */ /end MEASUREMENT
/begin MEASUREMENT in_M1_xPreChargeAllowed "" UBYTE SC_KZQ_EV2274A_4_1_CM_boolean 0 0 0 1 ECU_ADDRESS 0x4001840f /* @ECU_Address@in_M1_xPreChargeAllowed@ */ /end MEASUREMENT
/begin MEASUREMENT in_M1_xReady "" UBYTE SC_KZQ_EV2274A_4_1_CM_boolean 0 0 0 1 ECU_ADDRESS 0x40018410 /* @ECU_Address@in_M1_xReady@ */ /end MEASUREMENT
/begin MEASUREMENT in_M1_xResetErr "" UBYTE SC_KZQ_EV2274A_4_1_CM_boolean 0 0 0 1 ECU_ADDRESS 0x40018411 /* @ECU_Address@in_M1_xResetErr@ */ /end MEASUREMENT
/begin MEASUREMENT in_M1_xStopErr "" UBYTE SC_KZQ_EV2274A_4_1_CM_boolean 0 0 0 1 ECU_ADDRESS 0x40018412 /* @ECU_Address@in_M1_xStopErr@ */ /end MEASUREMENT
/begin MEASUREMENT in_M2_Err_xControllerCurrentSensorErr "" UBYTE SC_KZQ_EV2274A_4_1_CM_boolean 0 0 0 1 ECU_ADDRESS 0x40018413 /* @ECU_Address@in_M2_Err_xControllerCurrentSensorErr@ */ /end MEASUREMENT
/begin MEASUREMENT in_M2_Err_xControllerIGBTErr "" UBYTE SC_KZQ_EV2274A_4_1_CM_boolean 0 0 0 1 ECU_ADDRESS 0x40018414 /* @ECU_Address@in_M2_Err_xControllerIGBTErr@ */ /end MEASUREMENT
/begin MEASUREMENT in_M2_Err_xControllerLosePhase "" UBYTE SC_KZQ_EV2274A_4_1_CM_boolean 0 0 0 1 ECU_ADDRESS 0x40018415 /* @ECU_Address@in_M2_Err_xControllerLosePhase@ */ /end MEASUREMENT
/begin MEASUREMENT in_M2_Err_xControllerLowVoltageBelow "" UBYTE SC_KZQ_EV2274A_4_1_CM_boolean 0 0 0 1 ECU_ADDRESS 0x40018416 /* @ECU_Address@in_M2_Err_xControllerLowVoltageBelow@ */ /end MEASUREMENT
/begin MEASUREMENT in_M2_Err_xControllerOverCurrent "" UBYTE SC_KZQ_EV2274A_4_1_CM_boolean 0 0 0 1 ECU_ADDRESS 0x40018417 /* @ECU_Address@in_M2_Err_xControllerOverCurrent@ */ /end MEASUREMENT
/begin MEASUREMENT in_M2_Err_xControllerOverTemp "" UBYTE SC_KZQ_EV2274A_4_1_CM_boolean 0 0 0 1 ECU_ADDRESS 0x40018418 /* @ECU_Address@in_M2_Err_xControllerOverTemp@ */ /end MEASUREMENT
/begin MEASUREMENT in_M2_Err_xControllerTempSenorErr "" UBYTE SC_KZQ_EV2274A_4_1_CM_boolean 0 0 0 1 ECU_ADDRESS 0x40018419 /* @ECU_Address@in_M2_Err_xControllerTempSenorErr@ */ /end MEASUREMENT
/begin MEASUREMENT in_M2_Err_xMotorBlocked "" UBYTE SC_KZQ_EV2274A_4_1_CM_boolean 0 0 0 1 ECU_ADDRESS 0x4001841a /* @ECU_Address@in_M2_Err_xMotorBlocked@ */ /end MEASUREMENT
/begin MEASUREMENT in_M2_Err_xMotorBusVoltageBelow "" UBYTE SC_KZQ_EV2274A_4_1_CM_boolean 0 0 0 1 ECU_ADDRESS 0x4001841b /* @ECU_Address@in_M2_Err_xMotorBusVoltageBelow@ */ /end MEASUREMENT
/begin MEASUREMENT in_M2_Err_xMotorBusVoltageOver "" UBYTE SC_KZQ_EV2274A_4_1_CM_boolean 0 0 0 1 ECU_ADDRESS 0x4001841c /* @ECU_Address@in_M2_Err_xMotorBusVoltageOver@ */ /end MEASUREMENT
/begin MEASUREMENT in_M2_Err_xMotorCanErr "" UBYTE SC_KZQ_EV2274A_4_1_CM_boolean 0 0 0 1 ECU_ADDRESS 0x4001841d /* @ECU_Address@in_M2_Err_xMotorCanErr@ */ /end MEASUREMENT
/begin MEASUREMENT in_M2_Err_xMotorEncoderErr "" UBYTE SC_KZQ_EV2274A_4_1_CM_boolean 0 0 0 1 ECU_ADDRESS 0x4001841e /* @ECU_Address@in_M2_Err_xMotorEncoderErr@ */ /end MEASUREMENT
/begin MEASUREMENT in_M2_Err_xMotorOverLoad "" UBYTE SC_KZQ_EV2274A_4_1_CM_boolean 0 0 0 1 ECU_ADDRESS 0x4001841f /* @ECU_Address@in_M2_Err_xMotorOverLoad@ */ /end MEASUREMENT
/begin MEASUREMENT in_M2_Err_xMotorOverSpeed "" UBYTE SC_KZQ_EV2274A_4_1_CM_boolean 0 0 0 1 ECU_ADDRESS 0x40018420 /* @ECU_Address@in_M2_Err_xMotorOverSpeed@ */ /end MEASUREMENT
/begin MEASUREMENT in_M2_Err_xMotorOverTemp "" UBYTE SC_KZQ_EV2274A_4_1_CM_boolean 0 0 0 1 ECU_ADDRESS 0x40018421 /* @ECU_Address@in_M2_Err_xMotorOverTemp@ */ /end MEASUREMENT
/begin MEASUREMENT in_M2_Err_xMotorTempSensorErr "" UBYTE SC_KZQ_EV2274A_4_1_CM_boolean 0 0 0 1 ECU_ADDRESS 0x40018422 /* @ECU_Address@in_M2_Err_xMotorTempSensorErr@ */ /end MEASUREMENT
/begin MEASUREMENT in_M2_xPreChargeAllowed "" UBYTE SC_KZQ_EV2274A_4_1_CM_boolean 0 0 0 1 ECU_ADDRESS 0x4001844b /* @ECU_Address@in_M2_xPreChargeAllowed@ */ /end MEASUREMENT
/begin MEASUREMENT in_M2_xReady "" UBYTE SC_KZQ_EV2274A_4_1_CM_boolean 0 0 0 1 ECU_ADDRESS 0x4001844c /* @ECU_Address@in_M2_xReady@ */ /end MEASUREMENT
/begin MEASUREMENT in_M2_xResetErr "" UBYTE SC_KZQ_EV2274A_4_1_CM_boolean 0 0 0 1 ECU_ADDRESS 0x4001844d /* @ECU_Address@in_M2_xResetErr@ */ /end MEASUREMENT
/begin MEASUREMENT in_M2_xStopErr "" UBYTE SC_KZQ_EV2274A_4_1_CM_boolean 0 0 0 1 ECU_ADDRESS 0x4001844e /* @ECU_Address@in_M2_xStopErr@ */ /end MEASUREMENT
/begin MEASUREMENT in_M3_xErr "" UBYTE SC_KZQ_EV2274A_4_1_CM_boolean 0 0 0 1 ECU_ADDRESS 0x4001844f /* @ECU_Address@in_M3_xErr@ */ /end MEASUREMENT
/begin MEASUREMENT in_OBC_Err_xChargeCanErr "" UBYTE SC_KZQ_EV2274A_4_1_CM_boolean 0 0 0 1 ECU_ADDRESS 0x40018450 /* @ECU_Address@in_OBC_Err_xChargeCanErr@ */ /end MEASUREMENT
/begin MEASUREMENT in_OBC_Err_xHardwareErr "" UBYTE SC_KZQ_EV2274A_4_1_CM_boolean 0 0 0 1 ECU_ADDRESS 0x40018451 /* @ECU_Address@in_OBC_Err_xHardwareErr@ */ /end MEASUREMENT
/begin MEASUREMENT in_OBC_Err_xInputVoltageErr "" UBYTE SC_KZQ_EV2274A_4_1_CM_boolean 0 0 0 1 ECU_ADDRESS 0x40018452 /* @ECU_Address@in_OBC_Err_xInputVoltageErr@ */ /end MEASUREMENT
/begin MEASUREMENT in_OBC_Err_xOverTemp "" UBYTE SC_KZQ_EV2274A_4_1_CM_boolean 0 0 0 1 ECU_ADDRESS 0x40018453 /* @ECU_Address@in_OBC_Err_xOverTemp@ */ /end MEASUREMENT
/begin MEASUREMENT in_OBC_xErr "异常
      
      " UBYTE SC_KZQ_EV2274A_4_1_CM_boolean 0 0 0 1 ECU_ADDRESS 0x4001845c /* @ECU_Address@in_OBC_xErr@ */ /end MEASUREMENT
/begin MEASUREMENT in_OBC_xIsWakeup "已唤醒
      " UBYTE SC_KZQ_EV2274A_4_1_CM_boolean 0 0 0 1 ECU_ADDRESS 0x4001845d /* @ECU_Address@in_OBC_xIsWakeup@ */ /end MEASUREMENT
/begin MEASUREMENT in_OBC_xReady "就绪
      
      " UBYTE SC_KZQ_EV2274A_4_1_CM_boolean 0 0 0 1 ECU_ADDRESS 0x4001845e /* @ECU_Address@in_OBC_xReady@ */ /end MEASUREMENT
/begin MEASUREMENT in_OBC_xRunning "就绪
      
      " UBYTE SC_KZQ_EV2274A_4_1_CM_boolean 0 0 0 1 ECU_ADDRESS 0x4001845f /* @ECU_Address@in_OBC_xRunning@ */ /end MEASUREMENT
/begin MEASUREMENT in_S2_Err_xRM1AOutOfInitialstate "" UBYTE SC_KZQ_EV2274A_4_1_CM_boolean 0 0 0 1 ECU_ADDRESS 0x40018460 /* @ECU_Address@in_S2_Err_xRM1AOutOfInitialstate@ */ /end MEASUREMENT
/begin MEASUREMENT in_S2_Err_xRM1OutOfInitialstate "" UBYTE SC_KZQ_EV2274A_4_1_CM_boolean 0 0 0 1 ECU_ADDRESS 0x40018461 /* @ECU_Address@in_S2_Err_xRM1OutOfInitialstate@ */ /end MEASUREMENT
/begin MEASUREMENT in_S2_Err_xTCUOutOfInitalGearLevel "" UBYTE SC_KZQ_EV2274A_4_1_CM_boolean 0 0 0 1 ECU_ADDRESS 0x40018462 /* @ECU_Address@in_S2_Err_xTCUOutOfInitalGearLevel@ */ /end MEASUREMENT
/begin MEASUREMENT in_xDI01_X42 "" UBYTE SC_KZQ_EV2274A_4_1_CM_boolean 0 0 0 1 ECU_ADDRESS 0x40018490 /* @ECU_Address@in_xDI01_X42@ */ /end MEASUREMENT
/begin MEASUREMENT in_xDI02_X52 "" UBYTE SC_KZQ_EV2274A_4_1_CM_boolean 0 0 0 1 ECU_ADDRESS 0x40018491 /* @ECU_Address@in_xDI02_X52@ */ /end MEASUREMENT
/begin MEASUREMENT in_xDI03_X53 "" UBYTE SC_KZQ_EV2274A_4_1_CM_boolean 0 0 0 1 ECU_ADDRESS 0x40018492 /* @ECU_Address@in_xDI03_X53@ */ /end MEASUREMENT
/begin MEASUREMENT in_xDI04_X38 "" UBYTE SC_KZQ_EV2274A_4_1_CM_boolean 0 0 0 1 ECU_ADDRESS 0x40018493 /* @ECU_Address@in_xDI04_X38@ */ /end MEASUREMENT
/begin MEASUREMENT in_xDI07_X43 "" UBYTE SC_KZQ_EV2274A_4_1_CM_boolean 0 0 0 1 ECU_ADDRESS 0x40018494 /* @ECU_Address@in_xDI07_X43@ */ /end MEASUREMENT
/begin MEASUREMENT in_xDI08_X31 "" UBYTE SC_KZQ_EV2274A_4_1_CM_boolean 0 0 0 1 ECU_ADDRESS 0x40018495 /* @ECU_Address@in_xDI08_X31@ */ /end MEASUREMENT
/begin MEASUREMENT in_xDI09_X25 "" UBYTE SC_KZQ_EV2274A_4_1_CM_boolean 0 0 0 1 ECU_ADDRESS 0x40018496 /* @ECU_Address@in_xDI09_X25@ */ /end MEASUREMENT
/begin MEASUREMENT in_xDI10_X65 "" UBYTE SC_KZQ_EV2274A_4_1_CM_boolean 0 0 0 1 ECU_ADDRESS 0x40018497 /* @ECU_Address@in_xDI10_X65@ */ /end MEASUREMENT
/begin MEASUREMENT in_xDI12_X21 "" UBYTE SC_KZQ_EV2274A_4_1_CM_boolean 0 0 0 1 ECU_ADDRESS 0x40018498 /* @ECU_Address@in_xDI12_X21@ */ /end MEASUREMENT
/begin MEASUREMENT in_xDI13_X26 "" UBYTE SC_KZQ_EV2274A_4_1_CM_boolean 0 0 0 1 ECU_ADDRESS 0x40018499 /* @ECU_Address@in_xDI13_X26@ */ /end MEASUREMENT
/begin MEASUREMENT in_xDI15_X45 "" UBYTE SC_KZQ_EV2274A_4_1_CM_boolean 0 0 0 1 ECU_ADDRESS 0x4001849a /* @ECU_Address@in_xDI15_X45@ */ /end MEASUREMENT
/begin MEASUREMENT in_xDI16_X63 "" UBYTE SC_KZQ_EV2274A_4_1_CM_boolean 0 0 0 1 ECU_ADDRESS 0x4001849b /* @ECU_Address@in_xDI16_X63@ */ /end MEASUREMENT
/begin MEASUREMENT in_xDI17_X67 "" UBYTE SC_KZQ_EV2274A_4_1_CM_boolean 0 0 0 1 ECU_ADDRESS 0x4001849c /* @ECU_Address@in_xDI17_X67@ */ /end MEASUREMENT
/begin MEASUREMENT in_xDI18_X68 "" UBYTE SC_KZQ_EV2274A_4_1_CM_boolean 0 0 0 1 ECU_ADDRESS 0x4001849d /* @ECU_Address@in_xDI18_X68@ */ /end MEASUREMENT
/begin MEASUREMENT in_xDI21_X40 "" UBYTE SC_KZQ_EV2274A_4_1_CM_boolean 0 0 0 1 ECU_ADDRESS 0x4001849e /* @ECU_Address@in_xDI21_X40@ */ /end MEASUREMENT
/begin MEASUREMENT in_xDI22_X81 "" UBYTE SC_KZQ_EV2274A_4_1_CM_boolean 0 0 0 1 ECU_ADDRESS 0x4001849f /* @ECU_Address@in_xDI22_X81@ */ /end MEASUREMENT
/begin MEASUREMENT in_xDI31_X64 "" UBYTE SC_KZQ_EV2274A_4_1_CM_boolean 0 0 0 1 ECU_ADDRESS 0x400184a0 /* @ECU_Address@in_xDI31_X64@ */ /end MEASUREMENT
/begin MEASUREMENT in_xDI32_X47 "" UBYTE SC_KZQ_EV2274A_4_1_CM_boolean 0 0 0 1 ECU_ADDRESS 0x400184a1 /* @ECU_Address@in_xDI32_X47@ */ /end MEASUREMENT
/begin MEASUREMENT in_xDI33_X66 "" UBYTE SC_KZQ_EV2274A_4_1_CM_boolean 0 0 0 1 ECU_ADDRESS 0x400184a2 /* @ECU_Address@in_xDI33_X66@ */ /end MEASUREMENT
/begin MEASUREMENT in_xDI34_X08 "" UBYTE SC_KZQ_EV2274A_4_1_CM_boolean 0 0 0 1 ECU_ADDRESS 0x400184a3 /* @ECU_Address@in_xDI34_X08@ */ /end MEASUREMENT
/begin MEASUREMENT in_xKeyOn_X59 "" UBYTE SC_KZQ_EV2274A_4_1_CM_boolean 0 0 0 1 ECU_ADDRESS 0x400184a4 /* @ECU_Address@in_xKeyOn_X59@ */ /end MEASUREMENT
/begin MEASUREMENT in_xS1 "" UBYTE SC_KZQ_EV2274A_4_1_CM_boolean 0 0 0 1 ECU_ADDRESS 0x400184a5 /* @ECU_Address@in_xS1@ */ /end MEASUREMENT
/begin MEASUREMENT in_xS2 "" UBYTE SC_KZQ_EV2274A_4_1_CM_boolean 0 0 0 1 ECU_ADDRESS 0x400184a6 /* @ECU_Address@in_xS2@ */ /end MEASUREMENT
/begin MEASUREMENT in_xS3 "" UBYTE SC_KZQ_EV2274A_4_1_CM_boolean 0 0 0 1 ECU_ADDRESS 0x400184a7 /* @ECU_Address@in_xS3@ */ /end MEASUREMENT
/begin MEASUREMENT in_xS4 "" UBYTE SC_KZQ_EV2274A_4_1_CM_boolean 0 0 0 1 ECU_ADDRESS 0x400184a8 /* @ECU_Address@in_xS4@ */ /end MEASUREMENT
/begin MEASUREMENT in_xS5 "" UBYTE SC_KZQ_EV2274A_4_1_CM_boolean 0 0 0 1 ECU_ADDRESS 0x400184a9 /* @ECU_Address@in_xS5@ */ /end MEASUREMENT
/begin MEASUREMENT in_xS8D1 "" UBYTE SC_KZQ_EV2274A_4_1_CM_boolean 0 0 0 1 ECU_ADDRESS 0x400184aa /* @ECU_Address@in_xS8D1@ */ /end MEASUREMENT
/begin MEASUREMENT in_xS8D2 "" UBYTE SC_KZQ_EV2274A_4_1_CM_boolean 0 0 0 1 ECU_ADDRESS 0x400184ab /* @ECU_Address@in_xS8D2@ */ /end MEASUREMENT
/begin MEASUREMENT in_xS8D3 "" UBYTE SC_KZQ_EV2274A_4_1_CM_boolean 0 0 0 1 ECU_ADDRESS 0x400184ac /* @ECU_Address@in_xS8D3@ */ /end MEASUREMENT
/begin MEASUREMENT in_xS8D4 "" UBYTE SC_KZQ_EV2274A_4_1_CM_boolean 0 0 0 1 ECU_ADDRESS 0x400184ad /* @ECU_Address@in_xS8D4@ */ /end MEASUREMENT
/begin MEASUREMENT in_xS8R "" UBYTE SC_KZQ_EV2274A_4_1_CM_boolean 0 0 0 1 ECU_ADDRESS 0x400184ae /* @ECU_Address@in_xS8R@ */ /end MEASUREMENT
/begin MEASUREMENT in_xSHA1 "" UBYTE SC_KZQ_EV2274A_4_1_CM_boolean 0 0 0 1 ECU_ADDRESS 0x400184af /* @ECU_Address@in_xSHA1@ */ /end MEASUREMENT
/begin MEASUREMENT in_xSM1 "" UBYTE SC_KZQ_EV2274A_4_1_CM_boolean 0 0 0 1 ECU_ADDRESS 0x400184b0 /* @ECU_Address@in_xSM1@ */ /end MEASUREMENT
/begin MEASUREMENT in_xSM1A "" UBYTE SC_KZQ_EV2274A_4_1_CM_boolean 0 0 0 1 ECU_ADDRESS 0x400184b1 /* @ECU_Address@in_xSM1A@ */ /end MEASUREMENT
/begin MEASUREMENT in_xSM2H "" UBYTE SC_KZQ_EV2274A_4_1_CM_boolean 0 0 0 1 ECU_ADDRESS 0x400184b2 /* @ECU_Address@in_xSM2H@ */ /end MEASUREMENT
/begin MEASUREMENT in_xSM2L "" UBYTE SC_KZQ_EV2274A_4_1_CM_boolean 0 0 0 1 ECU_ADDRESS 0x400184b3 /* @ECU_Address@in_xSM2L@ */ /end MEASUREMENT
/begin MEASUREMENT in_xSM3 "" UBYTE SC_KZQ_EV2274A_4_1_CM_boolean 0 0 0 1 ECU_ADDRESS 0x400184b4 /* @ECU_Address@in_xSM3@ */ /end MEASUREMENT
/begin MEASUREMENT in_xSQ1 "" UBYTE SC_KZQ_EV2274A_4_1_CM_boolean 0 0 0 1 ECU_ADDRESS 0x400184b5 /* @ECU_Address@in_xSQ1@ */ /end MEASUREMENT
/begin MEASUREMENT out_GPS_xAntiCrackActived "" UBYTE SC_KZQ_EV2274A_4_1_CM_boolean 0 0 0 1 ECU_ADDRESS 0x400197f8 /* @ECU_Address@out_GPS_xAntiCrackActived@ */ /end MEASUREMENT
/begin MEASUREMENT out_GPS_xLockingActived "" UBYTE SC_KZQ_EV2274A_4_1_CM_boolean 0 0 0 1 ECU_ADDRESS 0x400197f9 /* @ECU_Address@out_GPS_xLockingActived@ */ /end MEASUREMENT
/begin MEASUREMENT out_GPS_xTempResetBusy "" UBYTE SC_KZQ_EV2274A_4_1_CM_boolean 0 0 0 1 ECU_ADDRESS 0x400197fa /* @ECU_Address@out_GPS_xTempResetBusy@ */ /end MEASUREMENT
/begin MEASUREMENT out_M1_xQuickDrainCmd "" UBYTE SC_KZQ_EV2274A_4_1_CM_boolean 0 0 0 1 ECU_ADDRESS 0x40019808 /* @ECU_Address@out_M1_xQuickDrainCmd@ */ /end MEASUREMENT
/begin MEASUREMENT out_M1_xRM1AMode "" UBYTE SC_KZQ_EV2274A_4_1_CM_boolean 0 0 0 1 ECU_ADDRESS 0x40019809 /* @ECU_Address@out_M1_xRM1AMode@ */ /end MEASUREMENT
/begin MEASUREMENT out_M1_xSpeedCmd "" UBYTE SC_KZQ_EV2274A_4_1_CM_boolean 0 0 0 1 ECU_ADDRESS 0x4001980a /* @ECU_Address@out_M1_xSpeedCmd@ */ /end MEASUREMENT
/begin MEASUREMENT out_M1_xTorqueCmd "" UBYTE SC_KZQ_EV2274A_4_1_CM_boolean 0 0 0 1 ECU_ADDRESS 0x4001980b /* @ECU_Address@out_M1_xTorqueCmd@ */ /end MEASUREMENT
/begin MEASUREMENT out_M2_xQuickDrainCmd "" UBYTE SC_KZQ_EV2274A_4_1_CM_boolean 0 0 0 1 ECU_ADDRESS 0x40019810 /* @ECU_Address@out_M2_xQuickDrainCmd@ */ /end MEASUREMENT
/begin MEASUREMENT out_M2_xSpeedCmd "" UBYTE SC_KZQ_EV2274A_4_1_CM_boolean 0 0 0 1 ECU_ADDRESS 0x40019811 /* @ECU_Address@out_M2_xSpeedCmd@ */ /end MEASUREMENT
/begin MEASUREMENT out_OBC_xACChargeCmd "交流充电指令
      " UBYTE SC_KZQ_EV2274A_4_1_CM_boolean 0 0 0 1 ECU_ADDRESS 0x4001981c /* @ECU_Address@out_OBC_xACChargeCmd@ */ /end MEASUREMENT
/begin MEASUREMENT out_OBC_xACRechargeCmd "交流回充指令
      " UBYTE SC_KZQ_EV2274A_4_1_CM_boolean 0 0 0 1 ECU_ADDRESS 0x4001981d /* @ECU_Address@out_OBC_xACRechargeCmd@ */ /end MEASUREMENT
/begin MEASUREMENT out_xHA1 "" UBYTE SC_KZQ_EV2274A_4_1_CM_boolean 0 0 0 1 ECU_ADDRESS 0x4001981f /* @ECU_Address@out_xHA1@ */ /end MEASUREMENT
/begin MEASUREMENT out_xHSO01_X108 "" UBYTE SC_KZQ_EV2274A_4_1_CM_boolean 0 0 0 1 ECU_ADDRESS 0x40019820 /* @ECU_Address@out_xHSO01_X108@ */ /end MEASUREMENT
/begin MEASUREMENT out_xHSO02_X100 "" UBYTE SC_KZQ_EV2274A_4_1_CM_boolean 0 0 0 1 ECU_ADDRESS 0x40019821 /* @ECU_Address@out_xHSO02_X100@ */ /end MEASUREMENT
/begin MEASUREMENT out_xHSO03_X107 "" UBYTE SC_KZQ_EV2274A_4_1_CM_boolean 0 0 0 1 ECU_ADDRESS 0x40019822 /* @ECU_Address@out_xHSO03_X107@ */ /end MEASUREMENT
/begin MEASUREMENT out_xHSO04_X99 "" UBYTE SC_KZQ_EV2274A_4_1_CM_boolean 0 0 0 1 ECU_ADDRESS 0x40019823 /* @ECU_Address@out_xHSO04_X99@ */ /end MEASUREMENT
/begin MEASUREMENT out_xHSO05_X106 "" UBYTE SC_KZQ_EV2274A_4_1_CM_boolean 0 0 0 1 ECU_ADDRESS 0x40019824 /* @ECU_Address@out_xHSO05_X106@ */ /end MEASUREMENT
/begin MEASUREMENT out_xHSO06_X98 "" UBYTE SC_KZQ_EV2274A_4_1_CM_boolean 0 0 0 1 ECU_ADDRESS 0x40019825 /* @ECU_Address@out_xHSO06_X98@ */ /end MEASUREMENT
/begin MEASUREMENT out_xHSO07_X94 "" UBYTE SC_KZQ_EV2274A_4_1_CM_boolean 0 0 0 1 ECU_ADDRESS 0x40019826 /* @ECU_Address@out_xHSO07_X94@ */ /end MEASUREMENT
/begin MEASUREMENT out_xHSO08_X86 "" UBYTE SC_KZQ_EV2274A_4_1_CM_boolean 0 0 0 1 ECU_ADDRESS 0x40019827 /* @ECU_Address@out_xHSO08_X86@ */ /end MEASUREMENT
/begin MEASUREMENT out_xHSO10_X114 "" UBYTE SC_KZQ_EV2274A_4_1_CM_boolean 0 0 0 1 ECU_ADDRESS 0x40019828 /* @ECU_Address@out_xHSO10_X114@ */ /end MEASUREMENT
/begin MEASUREMENT out_xHSO14_X85 "" UBYTE SC_KZQ_EV2274A_4_1_CM_boolean 0 0 0 1 ECU_ADDRESS 0x40019829 /* @ECU_Address@out_xHSO14_X85@ */ /end MEASUREMENT
/begin MEASUREMENT out_xLSO01_X95 "" UBYTE SC_KZQ_EV2274A_4_1_CM_boolean 0 0 0 1 ECU_ADDRESS 0x4001982a /* @ECU_Address@out_xLSO01_X95@ */ /end MEASUREMENT
/begin MEASUREMENT out_xLSO02_X109 "" UBYTE SC_KZQ_EV2274A_4_1_CM_boolean 0 0 0 1 ECU_ADDRESS 0x4001982b /* @ECU_Address@out_xLSO02_X109@ */ /end MEASUREMENT
/begin MEASUREMENT out_xLSO03_X90 "" UBYTE SC_KZQ_EV2274A_4_1_CM_boolean 0 0 0 1 ECU_ADDRESS 0x4001982c /* @ECU_Address@out_xLSO03_X90@ */ /end MEASUREMENT
/begin MEASUREMENT out_xLSO04_X101 "" UBYTE SC_KZQ_EV2274A_4_1_CM_boolean 0 0 0 1 ECU_ADDRESS 0x4001982d /* @ECU_Address@out_xLSO04_X101@ */ /end MEASUREMENT
/begin MEASUREMENT out_xLSO06_X96 "" UBYTE SC_KZQ_EV2274A_4_1_CM_boolean 0 0 0 1 ECU_ADDRESS 0x4001982e /* @ECU_Address@out_xLSO06_X96@ */ /end MEASUREMENT
/begin MEASUREMENT out_xLSO07_X110 "" UBYTE SC_KZQ_EV2274A_4_1_CM_boolean 0 0 0 1 ECU_ADDRESS 0x4001982f /* @ECU_Address@out_xLSO07_X110@ */ /end MEASUREMENT
/begin MEASUREMENT out_xLSO08_X89 "" UBYTE SC_KZQ_EV2274A_4_1_CM_boolean 0 0 0 1 ECU_ADDRESS 0x40019830 /* @ECU_Address@out_xLSO08_X89@ */ /end MEASUREMENT
/begin MEASUREMENT out_xLSO09_X112 "" UBYTE SC_KZQ_EV2274A_4_1_CM_boolean 0 0 0 1 ECU_ADDRESS 0x40019831 /* @ECU_Address@out_xLSO09_X112@ */ /end MEASUREMENT
/begin MEASUREMENT out_xLSO10_X111 "" UBYTE SC_KZQ_EV2274A_4_1_CM_boolean 0 0 0 1 ECU_ADDRESS 0x40019832 /* @ECU_Address@out_xLSO10_X111@ */ /end MEASUREMENT
/begin MEASUREMENT out_xLSO11_X102 "" UBYTE SC_KZQ_EV2274A_4_1_CM_boolean 0 0 0 1 ECU_ADDRESS 0x40019833 /* @ECU_Address@out_xLSO11_X102@ */ /end MEASUREMENT
/begin MEASUREMENT out_xLSO12_X103 "" UBYTE SC_KZQ_EV2274A_4_1_CM_boolean 0 0 0 1 ECU_ADDRESS 0x40019834 /* @ECU_Address@out_xLSO12_X103@ */ /end MEASUREMENT
/begin MEASUREMENT out_xLSO13_X88 "" UBYTE SC_KZQ_EV2274A_4_1_CM_boolean 0 0 0 1 ECU_ADDRESS 0x40019835 /* @ECU_Address@out_xLSO13_X88@ */ /end MEASUREMENT
/begin MEASUREMENT out_xLSO14_X113 "" UBYTE SC_KZQ_EV2274A_4_1_CM_boolean 0 0 0 1 ECU_ADDRESS 0x40019836 /* @ECU_Address@out_xLSO14_X113@ */ /end MEASUREMENT
/begin MEASUREMENT out_xLSO15_X104 "" UBYTE SC_KZQ_EV2274A_4_1_CM_boolean 0 0 0 1 ECU_ADDRESS 0x40019837 /* @ECU_Address@out_xLSO15_X104@ */ /end MEASUREMENT
/begin MEASUREMENT out_xLSO16_X105 "" UBYTE SC_KZQ_EV2274A_4_1_CM_boolean 0 0 0 1 ECU_ADDRESS 0x40019838 /* @ECU_Address@out_xLSO16_X105@ */ /end MEASUREMENT
/begin MEASUREMENT out_xLSO17_X93 "" UBYTE SC_KZQ_EV2274A_4_1_CM_boolean 0 0 0 1 ECU_ADDRESS 0x40019839 /* @ECU_Address@out_xLSO17_X93@ */ /end MEASUREMENT
/begin MEASUREMENT out_xLSO18_X92 "" UBYTE SC_KZQ_EV2274A_4_1_CM_boolean 0 0 0 1 ECU_ADDRESS 0x4001983a /* @ECU_Address@out_xLSO18_X92@ */ /end MEASUREMENT
/begin MEASUREMENT out_xLSO19_X91 "" UBYTE SC_KZQ_EV2274A_4_1_CM_boolean 0 0 0 1 ECU_ADDRESS 0x4001983b /* @ECU_Address@out_xLSO19_X91@ */ /end MEASUREMENT
/begin MEASUREMENT out_xPTO "" UBYTE SC_KZQ_EV2274A_4_1_CM_boolean 0 0 0 1 ECU_ADDRESS 0x4001983c /* @ECU_Address@out_xPTO@ */ /end MEASUREMENT
/begin MEASUREMENT gs_M1_eMotorModel "" UBYTE SC_KZQ_EV2274A_4_1_CM_XJMotroModelEnum 0 0 5 255 ECU_ADDRESS 0x4001827a /* @ECU_Address@gs_M1_eMotorModel@ */ /end MEASUREMENT
/begin MEASUREMENT gs_M2_eMotorModel "" UBYTE SC_KZQ_EV2274A_4_1_CM_XJMotroModelEnum 0 0 5 255 ECU_ADDRESS 0x4001827b /* @ECU_Address@gs_M2_eMotorModel@ */ /end MEASUREMENT
/begin MEASUREMENT fbBMSPower_eState "" UBYTE SC_KZQ_EV2274A_4_1_CM_ValueStatusEnum 0 0 1 68 ECU_ADDRESS 0x40018079 /* @ECU_Address@fbBMSPower_eState@ */ /end MEASUREMENT
/begin MEASUREMENT fbBQ1_eState "" UBYTE SC_KZQ_EV2274A_4_1_CM_ValueStatusEnum 0 0 1 68 ECU_ADDRESS 0x40018088 /* @ECU_Address@fbBQ1_eState@ */ /end MEASUREMENT
/begin MEASUREMENT fbBQ2_eState "" UBYTE SC_KZQ_EV2274A_4_1_CM_ValueStatusEnum 0 0 1 68 ECU_ADDRESS 0x400180b0 /* @ECU_Address@fbBQ2_eState@ */ /end MEASUREMENT
/begin MEASUREMENT fbBQ3_eState "" UBYTE SC_KZQ_EV2274A_4_1_CM_ValueStatusEnum 0 0 1 68 ECU_ADDRESS 0x400180d8 /* @ECU_Address@fbBQ3_eState@ */ /end MEASUREMENT
/begin MEASUREMENT fbBQ4_eState "" UBYTE SC_KZQ_EV2274A_4_1_CM_ValueStatusEnum 0 0 1 68 ECU_ADDRESS 0x40018100 /* @ECU_Address@fbBQ4_eState@ */ /end MEASUREMENT
/begin MEASUREMENT fbDCAC2Control_eState "" UBYTE SC_KZQ_EV2274A_4_1_CM_ValueStatusEnum 0 0 1 68 ECU_ADDRESS 0x40018134 /* @ECU_Address@fbDCAC2Control_eState@ */ /end MEASUREMENT
/begin MEASUREMENT fbDCAC2Power_eState "" UBYTE SC_KZQ_EV2274A_4_1_CM_ValueStatusEnum 0 0 1 68 ECU_ADDRESS 0x40018138 /* @ECU_Address@fbDCAC2Power_eState@ */ /end MEASUREMENT
/begin MEASUREMENT fbDCACPower_eState "" UBYTE SC_KZQ_EV2274A_4_1_CM_ValueStatusEnum 0 0 1 68 ECU_ADDRESS 0x40018141 /* @ECU_Address@fbDCACPower_eState@ */ /end MEASUREMENT
/begin MEASUREMENT fbDCDCControl_eState "" UBYTE SC_KZQ_EV2274A_4_1_CM_ValueStatusEnum 0 0 1 68 ECU_ADDRESS 0x4001814a /* @ECU_Address@fbDCDCControl_eState@ */ /end MEASUREMENT
/begin MEASUREMENT fbDCDCPower_eState "" UBYTE SC_KZQ_EV2274A_4_1_CM_ValueStatusEnum 0 0 1 68 ECU_ADDRESS 0x4001814e /* @ECU_Address@fbDCDCPower_eState@ */ /end MEASUREMENT
/begin MEASUREMENT fbHA1_eState "" UBYTE SC_KZQ_EV2274A_4_1_CM_ValueStatusEnum 0 0 1 68 ECU_ADDRESS 0x40018157 /* @ECU_Address@fbHA1_eState@ */ /end MEASUREMENT
/begin MEASUREMENT fbM1Power_eState "高压上下电的当前阶段" UBYTE SC_KZQ_EV2274A_4_1_CM_ValueStatusEnum 0 0 1 68 ECU_ADDRESS 0x40018191 /* @ECU_Address@fbM1Power_eState@ */ /end MEASUREMENT
/begin MEASUREMENT fbM2Power_eState "高压上下电的当前阶段" UBYTE SC_KZQ_EV2274A_4_1_CM_ValueStatusEnum 0 0 1 68 ECU_ADDRESS 0x400181c5 /* @ECU_Address@fbM2Power_eState@ */ /end MEASUREMENT
/begin MEASUREMENT fbM3_eState "" UBYTE SC_KZQ_EV2274A_4_1_CM_ValueStatusEnum 0 0 1 68 ECU_ADDRESS 0x400181d4 /* @ECU_Address@fbM3_eState@ */ /end MEASUREMENT
/begin MEASUREMENT fbOBCPower_eState "高压上下电的当前阶段" UBYTE SC_KZQ_EV2274A_4_1_CM_ValueStatusEnum 0 0 1 68 ECU_ADDRESS 0x400181d8 /* @ECU_Address@fbOBCPower_eState@ */ /end MEASUREMENT
/begin MEASUREMENT fbPTO_eState "" UBYTE SC_KZQ_EV2274A_4_1_CM_ValueStatusEnum 0 0 1 68 ECU_ADDRESS 0x400181e1 /* @ECU_Address@fbPTO_eState@ */ /end MEASUREMENT
/begin MEASUREMENT fbRM1A_eState "" UBYTE SC_KZQ_EV2274A_4_1_CM_ValueStatusEnum 0 0 1 68 ECU_ADDRESS 0x400181e4 /* @ECU_Address@fbRM1A_eState@ */ /end MEASUREMENT
/begin MEASUREMENT fbRM1_eState "" UBYTE SC_KZQ_EV2274A_4_1_CM_ValueStatusEnum 0 0 1 68 ECU_ADDRESS 0x4001820c /* @ECU_Address@fbRM1_eState@ */ /end MEASUREMENT
/begin MEASUREMENT fbS1_eState "" UBYTE SC_KZQ_EV2274A_4_1_CM_ValueStatusEnum 0 0 1 68 ECU_ADDRESS 0x40018234 /* @ECU_Address@fbS1_eState@ */ /end MEASUREMENT
/begin MEASUREMENT fbS2_eState "" UBYTE SC_KZQ_EV2274A_4_1_CM_ValueStatusEnum 0 0 1 68 ECU_ADDRESS 0x40018237 /* @ECU_Address@fbS2_eState@ */ /end MEASUREMENT
/begin MEASUREMENT fbS3_eState "" UBYTE SC_KZQ_EV2274A_4_1_CM_ValueStatusEnum 0 0 1 68 ECU_ADDRESS 0x4001823a /* @ECU_Address@fbS3_eState@ */ /end MEASUREMENT
/begin MEASUREMENT fbS4_eState "" UBYTE SC_KZQ_EV2274A_4_1_CM_ValueStatusEnum 0 0 1 68 ECU_ADDRESS 0x4001823d /* @ECU_Address@fbS4_eState@ */ /end MEASUREMENT
/begin MEASUREMENT fbS5_eState "" UBYTE SC_KZQ_EV2274A_4_1_CM_ValueStatusEnum 0 0 1 68 ECU_ADDRESS 0x40018240 /* @ECU_Address@fbS5_eState@ */ /end MEASUREMENT
/begin MEASUREMENT fbS8D1_eState "" UBYTE SC_KZQ_EV2274A_4_1_CM_ValueStatusEnum 0 0 1 68 ECU_ADDRESS 0x40018243 /* @ECU_Address@fbS8D1_eState@ */ /end MEASUREMENT
/begin MEASUREMENT fbS8D2_eState "" UBYTE SC_KZQ_EV2274A_4_1_CM_ValueStatusEnum 0 0 1 68 ECU_ADDRESS 0x40018246 /* @ECU_Address@fbS8D2_eState@ */ /end MEASUREMENT
/begin MEASUREMENT fbS8D3_eState "" UBYTE SC_KZQ_EV2274A_4_1_CM_ValueStatusEnum 0 0 1 68 ECU_ADDRESS 0x40018249 /* @ECU_Address@fbS8D3_eState@ */ /end MEASUREMENT
/begin MEASUREMENT fbS8D4_eState "" UBYTE SC_KZQ_EV2274A_4_1_CM_ValueStatusEnum 0 0 1 68 ECU_ADDRESS 0x4001824c /* @ECU_Address@fbS8D4_eState@ */ /end MEASUREMENT
/begin MEASUREMENT fbS8R_eState "" UBYTE SC_KZQ_EV2274A_4_1_CM_ValueStatusEnum 0 0 1 68 ECU_ADDRESS 0x4001824f /* @ECU_Address@fbS8R_eState@ */ /end MEASUREMENT
/begin MEASUREMENT fbSHA1_eState "" UBYTE SC_KZQ_EV2274A_4_1_CM_ValueStatusEnum 0 0 1 68 ECU_ADDRESS 0x40018252 /* @ECU_Address@fbSHA1_eState@ */ /end MEASUREMENT
/begin MEASUREMENT fbSM1A_eState "" UBYTE SC_KZQ_EV2274A_4_1_CM_ValueStatusEnum 0 0 1 68 ECU_ADDRESS 0x40018255 /* @ECU_Address@fbSM1A_eState@ */ /end MEASUREMENT
/begin MEASUREMENT fbSM1_eState "" UBYTE SC_KZQ_EV2274A_4_1_CM_ValueStatusEnum 0 0 1 68 ECU_ADDRESS 0x40018258 /* @ECU_Address@fbSM1_eState@ */ /end MEASUREMENT
/begin MEASUREMENT fbSM2H_eState "" UBYTE SC_KZQ_EV2274A_4_1_CM_ValueStatusEnum 0 0 1 68 ECU_ADDRESS 0x4001825b /* @ECU_Address@fbSM2H_eState@ */ /end MEASUREMENT
/begin MEASUREMENT fbSM2L_eState "" UBYTE SC_KZQ_EV2274A_4_1_CM_ValueStatusEnum 0 0 1 68 ECU_ADDRESS 0x4001825e /* @ECU_Address@fbSM2L_eState@ */ /end MEASUREMENT
/begin MEASUREMENT fbSM3_eState "" UBYTE SC_KZQ_EV2274A_4_1_CM_ValueStatusEnum 0 0 1 68 ECU_ADDRESS 0x40018261 /* @ECU_Address@fbSM3_eState@ */ /end MEASUREMENT
/begin MEASUREMENT fbSQ1_eState "" UBYTE SC_KZQ_EV2274A_4_1_CM_ValueStatusEnum 0 0 1 68 ECU_ADDRESS 0x40018264 /* @ECU_Address@fbSQ1_eState@ */ /end MEASUREMENT
/begin MEASUREMENT fbM1GearControl_eCurrentGearFeedback "" SBYTE SC_KZQ_EV2274A_4_1_CM_XJGearLevelEnum 0 0 -1 4 ECU_ADDRESS 0x40018185 /* @ECU_Address@fbM1GearControl_eCurrentGearFeedback@ */ /end MEASUREMENT
/begin MEASUREMENT fbM1GearControl_eSelectGearCmd "" SBYTE SC_KZQ_EV2274A_4_1_CM_XJGearLevelEnum 0 0 -1 4 ECU_ADDRESS 0x40018186 /* @ECU_Address@fbM1GearControl_eSelectGearCmd@ */ /end MEASUREMENT
/begin MEASUREMENT fbM1GearControl_eTargetGearFeedback "" SBYTE SC_KZQ_EV2274A_4_1_CM_XJGearLevelEnum 0 0 -1 4 ECU_ADDRESS 0x40018187 /* @ECU_Address@fbM1GearControl_eTargetGearFeedback@ */ /end MEASUREMENT
/begin MEASUREMENT fbM1GearLevel_eSelectGear "" SBYTE SC_KZQ_EV2274A_4_1_CM_XJGearLevelEnum 0 0 -1 4 ECU_ADDRESS 0x4001818f /* @ECU_Address@fbM1GearLevel_eSelectGear@ */ /end MEASUREMENT
/begin COMPU_METHOD SC_KZQ_EV2274A_4_1_CM_single_rpm "Q = V" RAT_FUNC "%8.6" "rpm" COEFFS 0 1 0 0 0 1 /end COMPU_METHOD
/begin COMPU_METHOD SC_KZQ_EV2274A_4_1_CM_single_N_m "Q = V" RAT_FUNC "%8.6" "N.m" COEFFS 0 1 0 0 0 1 /end COMPU_METHOD
/begin COMPU_METHOD SC_KZQ_EV2274A_4_1_CM_single____ "Q = V" RAT_FUNC "%8.6" "无单位" COEFFS 0 1 0 0 0 1 /end COMPU_METHOD
/begin COMPU_METHOD SC_KZQ_EV2274A_4_1_CM_double "Q = V" RAT_FUNC "%15.10" "" COEFFS 0 1 0 0 0 1 /end COMPU_METHOD
/begin COMPU_METHOD SC_KZQ_EV2274A_4_1_CM_XJMachineModelEnum "Enumerated data type: XJMachineModelEnum" TAB_VERB "%0.6" "" COMPU_TAB_REF VTAB_FOR_SC_KZQ_EV2274A_4_1_CM_XJMachineModelEnum /end COMPU_METHOD
/begin COMPU_METHOD SC_KZQ_EV2274A_4_1_CM_int32 "Q = V" RAT_FUNC "%10.0" "" COEFFS 0 1 0 0 0 1 /end COMPU_METHOD
/begin COMPU_METHOD SC_KZQ_EV2274A_4_1_CM_single_test "Q = V" RAT_FUNC "%8.6" "test" COEFFS 0 1 0 0 0 1 /end COMPU_METHOD
/begin COMPU_METHOD SC_KZQ_EV2274A_4_1_CM_single "Q = V" RAT_FUNC "%8.6" "" COEFFS 0 1 0 0 0 1 /end COMPU_METHOD
/begin COMPU_METHOD SC_KZQ_EV2274A_4_1_CM_uint32 "Q = V" RAT_FUNC "%10.0" "" COEFFS 0 1 0 0 0 1 /end COMPU_METHOD
/begin COMPU_METHOD SC_KZQ_EV2274A_4_1_CM_int16 "Q = V" RAT_FUNC "%5.0" "" COEFFS 0 1 0 0 0 1 /end COMPU_METHOD
/begin COMPU_METHOD SC_KZQ_EV2274A_4_1_CM_uint16 "Q = V" RAT_FUNC "%5.0" "" COEFFS 0 1 0 0 0 1 /end COMPU_METHOD
/begin COMPU_METHOD SC_KZQ_EV2274A_4_1_CM_XJGearLevelEnum "Enumerated data type: XJGearLevelEnum" TAB_VERB "%0.6" "" COMPU_TAB_REF VTAB_FOR_SC_KZQ_EV2274A_4_1_CM_XJGearLevelEnum /end COMPU_METHOD
/begin COMPU_METHOD SC_KZQ_EV2274A_4_1_CM_XJMotroModelEnum "Enumerated data type: XJMotroModelEnum" TAB_VERB "%0.6" "" COMPU_TAB_REF VTAB_FOR_SC_KZQ_EV2274A_4_1_CM_XJMotroModelEnum /end COMPU_METHOD
/begin COMPU_METHOD SC_KZQ_EV2274A_4_1_CM_boolean "Q = V" RAT_FUNC "%1.0" "" COEFFS 0 1 0 0 0 1 /end COMPU_METHOD
/begin COMPU_METHOD SC_KZQ_EV2274A_4_1_CM_int8 "Q = V" RAT_FUNC "%3.0" "" COEFFS 0 1 0 0 0 1 /end COMPU_METHOD
/begin COMPU_METHOD SC_KZQ_EV2274A_4_1_CM_uint8 "Q = V" RAT_FUNC "%3.0" "" COEFFS 0 1 0 0 0 1 /end COMPU_METHOD
/begin COMPU_METHOD SC_KZQ_EV2274A_4_1_CM_single__ "Q = V" RAT_FUNC "%8.6" "无" COEFFS 0 1 0 0 0 1 /end COMPU_METHOD
/begin COMPU_METHOD SC_KZQ_EV2274A_4_1_CM_single_RPM "Q = V" RAT_FUNC "%8.6" "RPM" COEFFS 0 1 0 0 0 1 /end COMPU_METHOD
/begin COMPU_METHOD SC_KZQ_EV2274A_4_1_CM_single_V "Q = V" RAT_FUNC "%8.6" "V" COEFFS 0 1 0 0 0 1 /end COMPU_METHOD
/begin COMPU_METHOD SC_KZQ_EV2274A_4_1_CM_single_A "Q = V" RAT_FUNC "%8.6" "A" COEFFS 0 1 0 0 0 1 /end COMPU_METHOD
/begin COMPU_METHOD SC_KZQ_EV2274A_4_1_CM_single_W "Q = V" RAT_FUNC "%8.6" "W" COEFFS 0 1 0 0 0 1 /end COMPU_METHOD
/begin COMPU_METHOD SC_KZQ_EV2274A_4_1_CM_ValueStatusEnum "Enumerated data type: ValueStatusEnum" TAB_VERB "%0.6" "" COMPU_TAB_REF VTAB_FOR_SC_KZQ_EV2274A_4_1_CM_ValueStatusEnum /end COMPU_METHOD
/begin COMPU_VTAB VTAB_FOR_SC_KZQ_EV2274A_4_1_CM_XJMachineModelEnum "Enumerated data type: XJMachineModelEnum" TAB_VERB 6 58982657 "XJ900_0101" 58982913 "XJ900_0201" 58983169 "XJ900_0301" 72089857 "XJ1100_0101" 88473857 "XJ1350_0101" 104857857 "XJ1600_0101" /end COMPU_VTAB
/begin COMPU_VTAB VTAB_FOR_SC_KZQ_EV2274A_4_1_CM_XJGearLevelEnum "Enumerated data type: XJGearLevelEnum" TAB_VERB 6 -1 "GearLevel_R" 0 "GearLevel_N" 1 "GearLevel_D1" 2 "GearLevel_D2" 3 "GearLevel_D3" 4 "GearLevel_D4" /end COMPU_VTAB
/begin COMPU_VTAB VTAB_FOR_SC_KZQ_EV2274A_4_1_CM_XJMotroModelEnum "Enumerated data type: XJMotroModelEnum" TAB_VERB 6 5 "TopGear_145" 8 "TopGear_220" 10 "TopGear_286" 20 "TopGear_315" 30 "Gle_GLMP40L5" 255 "UnKnown" /end COMPU_VTAB
/begin COMPU_VTAB VTAB_FOR_SC_KZQ_EV2274A_4_1_CM_ValueStatusEnum "Enumerated data type: ValueStatusEnum" TAB_VERB 39 1 "Normal" 2 "StartPosition" 3 "UnEnabled" 10 "Equal" 11 "OverUpperLimit" 12 "OverMax" 13 "MoreMax" 14 "NearMax" 15 "NearMin" 16 "BelowMin" 17 "LessMin" 18 "BelowLowerLimit" 20 "Busoff" 30 "OpenCircuit" 31 "ShortCircuit" 32 "Short2Vcc" 33 "ShortCircuitInternal" 34 "ImpedanceAbnormal" 35 "FeebackCurrentError" 40 "MotorTorqueHigh" 41 "MotorTorqueOverload" 42 "MotorBlockProtection" 50 "ValueAbnormal" 51 "Idle" 52 "IdlePost" 53 "Busy" 54 "WaitingReply" 55 "Error" 56 "Failed" 57 "Done" 60 "SelfCheck" 61 "Standby" 62 "PowerPreCharge" 63 "PowerOnWaiting" 64 "PowerOnProcess" 65 "PowerHold" 66 "PowerOffWaiting" 67 "PowerOffWaiting2" 68 "PowerOffProcess" /end COMPU_VTAB
/begin GROUP SC_KZQ_EV2274A_4_1 "SC_KZQ_EV2274A_4_1" /* Root */ ROOT
 /begin SUB_GROUP Root_IECDownload_Init_Subsystem Root_Main Root_NVM_Operation_Subsystem Root_Simulation_Binding Root_SystemClock /end SUB_GROUP
 /begin REF_CHARACTERISTIC System_gp_Model_xSimulation System_gp_Model_xVirtualTest gcp_M1Eff_TopGear145KW_aarEff gcp_M1Eff_TopGear220KW_aarEff gcp_M1Eff_TopGear286KW_aarEff gcp_M1External_TopGear145KW_arPeakSpeed gcp_M1External_TopGear220KW_arPeakSpeed gcp_M1External_TopGear286KW_arPeakSpeed gcp_M1test_1_5 gcp_M1test_2_5 gcp_M1test_6_1 gcp_M1test_6_2 test_cal_bool test_cal_double test_cal_enum test_cal_float test_cal_s16 test_cal_s32 test_cal_s8 test_cal_u16 test_cal_u32 test_cal_u8 /end REF_CHARACTERISTIC
 /begin REF_MEASUREMENT Can_A1_JiachengJCP070_xEnable Can_A1_WikaICM7110_xEnable Can_A1_u8Ports Can_A1_xBusoff Can_A2_WiKaE102_xEnable Can_A2_u8Ports Can_A2_xBusoff Can_BMS_CATL_xEnable Can_BMS_u8Ports Can_BMS_xBusoff Can_BQ1_u8Ports Can_BQ1_xBusoff Can_BQ2_u8Ports Can_BQ2_xBusoff Can_BQ3_u8Ports Can_BQ3_xBusoff Can_BQ4_u8Ports Can_BQ4_xBusoff Can_Engine_ZQ_xEnable Can_Engine_u8PortsOfRx Can_Engine_u8PortsOfTx Can_Engine_xBusoff Can_M1_TopGear_xEnable Can_M1_u8Ports Can_M1_xBusoff Can_M2_Gle_xEnable Can_M2_TopGear_xEnable Can_M2_u8Ports Can_M2_xBusoff Can_OBCPower_xBusoff Can_OBC_LinkCharging_xEnable Can_OBC_u8Ports Can_OBC_xBusoff Can_PDU_DCAC2Power_xBusoff Can_PDU_DCACPower_xBusoff Can_PDU_DCDCPower_xBusoff Can_PDU_Haige_xEnable Can_PDU_M1Power_xBusoff Can_PDU_M2Power_xBusoff Can_PDU_XinAn_xEnable Can_PDU_u8Ports Can_RM1A_u8Ports Can_RM1A_xBusoff Can_RM1_u8Ports Can_RM1_xBusoff Can_TCU_TopGear_xEnable Can_TCU_u8Ports Can_TCU_xBusoff Can_Z1_u32PeriodTime Can_Z1_u8Ports System_HeartBeat_byState System_HeartBeat_gs_byAppCycleTime System_HeartBeat_gsn_byDispType System_gs_AppVersion_u16Revised System_gs_AppVersion_u32MainMinor System_gs_AppVersion_u8Stage System_gs_byNVMOperation System_gs_u32ProtocolVersion System_gs_xCanSleep System_gs_xExecuteGsnVaraibleDefault System_gs_xExecuteModelPowerOn System_gs_xExecuteModelRetain System_gs_xHardwarePowerOn System_gs_xHardwireSleep System_gs_xSoftwarePowerOn System_gs_xVCUPowerOffBusy System_gs_xVhieclePowerOffCompleted System_gsn_eMachineModel System_gsn_xIECDownloadInit System_gsn_xIECDownloadInit_Disp core_gs_T_PLC_lrMS core_gs_T_PLC_u16day core_gs_T_PLC_u16hour core_gs_T_PLC_u16min core_gs_T_PLC_u16msec core_gs_T_PLC_u16sec core_gs_T_PLC_u16usec core_gs_T_PLC_u32MS core_gs_xSDOWriteExecuted fbBMSPower_eState fbBMSPower_xEnable fbBMSPower_xFaultWaitingBusy fbBMSPower_xOffProcessBusy fbBMSPower_xOffProcessDone fbBMSPower_xOffWaitingBusy fbBMSPower_xOffWaitingDone fbBMSPower_xOnProcessBusy fbBMSPower_xOnProcessDone fbBMSPower_xOnProcessErr fbBMSPower_xPowerHoldBusy fbBMSPower_xPowerHoldErr fbBMSPower_xRunAllowed fbBMSPower_xStandbyBusy fbBMSPower_xStandbyErr fbBQ1_eState fbBQ1_rMaxValue fbBQ1_rMinValue fbBQ1_rOut fbBQ1_rOutA fbBQ1_rOutB fbBQ1_rRatio fbBQ1_rRatioA fbBQ1_rRatioB fbBQ1_xEnable fbBQ1_xErr fbBQ1_xOutA fbBQ1_xOutB fbBQ2_eState fbBQ2_rMaxValue fbBQ2_rMinValue fbBQ2_rOut fbBQ2_rOutA fbBQ2_rOutB fbBQ2_rRatio fbBQ2_rRatioA fbBQ2_rRatioB fbBQ2_xEnable fbBQ2_xErr fbBQ2_xOutA fbBQ2_xOutB fbBQ3_eState fbBQ3_rMaxValue fbBQ3_rMinValue fbBQ3_rOut fbBQ3_rOutA fbBQ3_rOutB fbBQ3_rRatio fbBQ3_rRatioA fbBQ3_rRatioB fbBQ3_xEnable fbBQ3_xErr fbBQ3_xOutA fbBQ3_xOutB fbBQ4_eState fbBQ4_rMaxValue fbBQ4_rMinValue fbBQ4_rOut fbBQ4_rOutA fbBQ4_rOutB fbBQ4_rRatio fbBQ4_rRatioA fbBQ4_rRatioB fbBQ4_xEnable fbBQ4_xErr fbBQ4_xOutA fbBQ4_xOutB fbChargeManagement_rLoadPower fbChargeManagement_rMaxChargePower fbChargeManagement_xACChargeAllowed fbChargeManagement_xEnable fbChargeManagement_xLoadRequest fbChargeManagement_xRunAllowed fbDCAC2Control_eState fbDCAC2Control_xEnable fbDCAC2Control_xIn fbDCAC2Control_xOut fbDCAC2Power_eState fbDCAC2Power_xEnable fbDCAC2Power_xOffProcessBusy fbDCAC2Power_xOffProcessDone fbDCAC2Power_xOnProcessBusy fbDCAC2Power_xOnProcessDone fbDCAC2Power_xPowerHoldBusy fbDCAC2Power_xRunAllowed fbDCAC2Power_xStandbyBusy fbDCACPower_eState fbDCACPower_xEnable fbDCACPower_xOffProcessBusy fbDCACPower_xOffProcessDone fbDCACPower_xOnProcessBusy fbDCACPower_xOnProcessDone fbDCACPower_xPowerHoldBusy fbDCACPower_xRunAllowed fbDCACPower_xStandbyBusy fbDCDCControl_eState fbDCDCControl_xEnable fbDCDCControl_xIn fbDCDCControl_xOut fbDCDCPower_eState fbDCDCPower_xEnable fbDCDCPower_xOffProcessBusy fbDCDCPower_xOffProcessDone fbDCDCPower_xOnProcessBusy fbDCDCPower_xOnProcessDone fbDCDCPower_xPowerHoldBusy fbDCDCPower_xRunAllowed fbDCDCPower_xStandbyBusy fbHA1_eState fbHA1_xEnable fbHA1_xIn fbM1Clutch_xClosed fbM1Control_rEfficiency fbM1Control_rLimitErr fbM1Control_rMaxAviableDirveTorque fbM1Control_rMaxAviableRegenTorque fbM1Control_rMaxAviableSpeed fbM1Control_rSpeed fbM1Control_rSpeedCmd fbM1Control_rTorque fbM1Control_rTorqueCmd fbM1Control_xBusy fbM1Control_xEnable fbM1Control_xRunAllowed fbM1Control_xSpeedCmd fbM1Control_xTorqueCmd fbM1GearControl_eCurrentGearFeedback fbM1GearControl_eSelectGearCmd fbM1GearControl_eTargetGearFeedback fbM1GearControl_rTransRatio fbM1GearControl_xAvaiable fbM1GearControl_xEnable fbM1GearControl_xSwitchAllowed fbM1GearLevel_eSelectGear fbM1GearLevel_xEnable fbM1Power_eState fbM1Power_xEnable fbM1Power_xOffContactorBusy fbM1Power_xOffContactorDone fbM1Power_xOffControllerBusy fbM1Power_xOffControllerDone fbM1Power_xOffMotorBusy fbM1Power_xOffMotorDone fbM1Power_xOnContactorBusy fbM1Power_xOnContactorDone fbM1Power_xOnPreChargeBusy fbM1Power_xOnPreChargeDone fbM1Power_xPowerHoldBusy fbM1Power_xRunAllowed fbM1Power_xStandbyBusy fbM1Regen_rG1ResidualChargePower fbM1Regen_rTorqueCmd fbM1Regen_xEnable fbM1Regen_xRunAllowed fbM1Regen_xTorqueCmd fbM2Control_rLimitErr fbM2Control_rMaxAviableSpeed fbM2Control_rSpeed fbM2Control_rSpeedCmd fbM2Control_rTorque fbM2Control_xBusy fbM2Control_xEnable fbM2Control_xRunAllowed fbM2Control_xSpeedCmd fbM2Control_xSpeedLimited fbM2Power_eState fbM2Power_xEnable fbM2Power_xOffContactorBusy fbM2Power_xOffContactorDone fbM2Power_xOffControllerBusy fbM2Power_xOffControllerDone fbM2Power_xOffMotorBusy fbM2Power_xOffMotorDone fbM2Power_xOnContactorBusy fbM2Power_xOnContactorDone fbM2Power_xOnPreChargeBusy fbM2Power_xOnPreChargeDone fbM2Power_xPowerHoldBusy fbM2Power_xRunAllowed fbM2Power_xStandbyBusy fbM3_eState fbM3_xEnable fbM3_xIn fbM3_xOut fbOBCPower_eState fbOBCPower_xEnable fbOBCPower_xOffProcessBusy fbOBCPower_xOffProcessDone fbOBCPower_xOnProcessBusy fbOBCPower_xOnProcessDone fbOBCPower_xPowerHoldBusy fbOBCPower_xRunAllowed fbOBCPower_xStandbyBusy fbPTO_eState fbPTO_xEnable fbPTO_xIn fbRM1A_eState fbRM1A_rMaxValue fbRM1A_rMinValue fbRM1A_rOut fbRM1A_rOutA fbRM1A_rOutB fbRM1A_rRatio fbRM1A_rRatioA fbRM1A_rRatioB fbRM1A_xEnable fbRM1A_xErr fbRM1A_xOutA fbRM1A_xOutB fbRM1_eState fbRM1_rMaxValue fbRM1_rMinValue fbRM1_rOut fbRM1_rOutA fbRM1_rOutB fbRM1_rRatio fbRM1_rRatioA fbRM1_rRatioB fbRM1_xEnable fbRM1_xErr fbRM1_xOutA fbRM1_xOutB fbS1_eState fbS1_xEnable fbS1_xOut fbS2_eState fbS2_xEnable fbS2_xOut fbS3_eState fbS3_xEnable fbS3_xOut fbS4_eState fbS4_xEnable fbS4_xOut fbS5_eState fbS5_xEnable fbS5_xOut fbS8D1_eState fbS8D1_xEnable fbS8D1_xOut fbS8D2_eState fbS8D2_xEnable fbS8D2_xOut fbS8D3_eState fbS8D3_xEnable fbS8D3_xOut fbS8D4_eState fbS8D4_xEnable fbS8D4_xOut fbS8R_eState fbS8R_xEnable fbS8R_xOut fbSHA1_eState fbSHA1_xEnable fbSHA1_xOut fbSM1A_eState fbSM1A_xEnable fbSM1A_xOut fbSM1_eState fbSM1_xEnable fbSM1_xOut fbSM2H_eState fbSM2H_xEnable fbSM2H_xOut fbSM2L_eState fbSM2L_xEnable fbSM2L_xOut fbSM3_eState fbSM3_xEnable fbSM3_xOut fbSQ1_eState fbSQ1_xEnable fbSQ1_xOut gs_Enable_GPS_xAnitHeartbeatOffDirective gs_Enable_GPS_xAnitNetOffDirective gs_Enable_GPS_xLockDirective gs_Enable_xM1ReverseDirection gs_Enable_xM2ReverseDirection gs_Enable_xRM1CtrlClutch gs_GPS_u32TempKey gs_GPS_u32TempSeed gs_GPS_xKeyActived gs_GPS_xSeedActived gs_M1_eMotorModel gs_M2_eMotorModel gsn_BMS_rLimpCurrent gsn_BQ1_rAccuracy gsn_BQ1_rAccuracy_Disp gsn_BQ1_rCoef gsn_BQ1_rCoef_Disp gsn_BQ1_rRefValue gsn_BQ1_rRefValue_Disp gsn_BQ1_u16MaxAD gsn_BQ1_u16MaxAD_Disp gsn_BQ1_u16MinAD gsn_BQ1_u16MinAD_Disp gsn_BQ1_u16RatedMaxAD gsn_BQ1_u16RatedMaxAD_Disp gsn_BQ1_u16RatedMinAD gsn_BQ1_u16RatedMinAD_Disp gsn_BQ1_u16RefAD gsn_BQ1_u16RefAD_Disp gsn_BQ2_rAccuracy gsn_BQ2_rAccuracy_Disp gsn_BQ2_rCoef gsn_BQ2_rCoef_Disp gsn_BQ2_rRefValue gsn_BQ2_rRefValue_Disp gsn_BQ2_u16MaxAD gsn_BQ2_u16MaxAD_Disp gsn_BQ2_u16MinAD gsn_BQ2_u16MinAD_Disp gsn_BQ2_u16RatedMaxAD gsn_BQ2_u16RatedMaxAD_Disp gsn_BQ2_u16RatedMinAD gsn_BQ2_u16RatedMinAD_Disp gsn_BQ2_u16RefAD gsn_BQ2_u16RefAD_Disp gsn_BQ3_rAccuracy gsn_BQ3_rAccuracy_Disp gsn_BQ3_rCoef gsn_BQ3_rCoef_Disp gsn_BQ3_rRefValue gsn_BQ3_rRefValue_Disp gsn_BQ3_u16MaxAD gsn_BQ3_u16MaxAD_Disp gsn_BQ3_u16MinAD gsn_BQ3_u16MinAD_Disp gsn_BQ3_u16RatedMaxAD gsn_BQ3_u16RatedMaxAD_Disp gsn_BQ3_u16RatedMinAD gsn_BQ3_u16RatedMinAD_Disp gsn_BQ3_u16RefAD gsn_BQ3_u16RefAD_Disp gsn_BQ4_rAccuracy gsn_BQ4_rAccuracy_Disp gsn_BQ4_rCoef gsn_BQ4_rCoef_Disp gsn_BQ4_rRefValue gsn_BQ4_rRefValue_Disp gsn_BQ4_u16MaxAD gsn_BQ4_u16MaxAD_Disp gsn_BQ4_u16MinAD gsn_BQ4_u16MinAD_Disp gsn_BQ4_u16RatedMaxAD gsn_BQ4_u16RatedMaxAD_Disp gsn_BQ4_u16RatedMinAD gsn_BQ4_u16RatedMinAD_Disp gsn_BQ4_u16RefAD gsn_BQ4_u16RefAD_Disp gsn_Charge_rMaxChargePower gsn_Charge_rMaxDischargeCurrentInCharging gsn_Charge_rStartBMSTempForLimiting gsn_Charge_rStartSOCForLimiting gsn_DCDC_rWorkVoltage gsn_Dial_rRearTransCoef gsn_Dial_rRearTransEff gsn_GPS_timAntiCrack gsn_GPS_timAntiCrackRemaining gsn_GPS_u32Directive gsn_GPS_u32KeyGroup1 gsn_GPS_u32KeyGroup2 gsn_Hook_rRearTransCoef gsn_M1Regen_rRegenIntensity gsn_M1Trans_GearLevelRatio_rD1 gsn_M1Trans_GearLevelRatio_rD2 gsn_M1Trans_GearLevelRatio_rD3 gsn_M1Trans_GearLevelRatio_rD4 gsn_M1_rMaxHookSpeed gsn_M1_rMaxMotorSpeed gsn_M2_rSM2HSpeed gsn_M2_rSM2LSpeed gsn_M3_rRatedPower gsn_M3_rStartPressure gsn_M3_rStopPressure gsn_M3_rWorkSpeed gsn_RM1A_rAccuracy gsn_RM1A_rAccuracy_Disp gsn_RM1A_rCoef gsn_RM1A_rCoef_Disp gsn_RM1A_rRefValue gsn_RM1A_rRefValue_Disp gsn_RM1A_u16MaxAD gsn_RM1A_u16MaxAD_Disp gsn_RM1A_u16MinAD gsn_RM1A_u16MinAD_Disp gsn_RM1A_u16RatedMaxAD gsn_RM1A_u16RatedMaxAD_Disp gsn_RM1A_u16RatedMinAD gsn_RM1A_u16RatedMinAD_Disp gsn_RM1A_u16RefAD gsn_RM1A_u16RefAD_Disp gsn_RM1_rAccuracy gsn_RM1_rAccuracy_Disp gsn_RM1_rCoef gsn_RM1_rCoef_Disp gsn_RM1_rRefValue gsn_RM1_rRefValue_Disp gsn_RM1_u16MaxAD gsn_RM1_u16MaxAD_Disp gsn_RM1_u16MinAD gsn_RM1_u16MinAD_Disp gsn_RM1_u16RatedMaxAD gsn_RM1_u16RatedMaxAD_Disp gsn_RM1_u16RatedMinAD gsn_RM1_u16RatedMinAD_Disp gsn_RM1_u16RefAD gsn_RM1_u16RefAD_Disp gsn_Statistics_u32CumulativeWorkSeconds gsn_Statistics_u32M1CumulativeWorkSeconds gsn_u32Enable_6508h_001 gsn_u32Enable_6508h_010 gsn_u32Enable_6508h_020 in_A1_rM2HighSpeed in_A1_rM2LowSpeed in_A1_rMaxAllowedChargePower in_A1_xACChargeModeRequest in_A1_xACRechargeModeRequest in_A1_xChargeRequest in_A1_xDCAC2Request in_A1_xRemoteRequestAviable in_BMS_rChargeCurrentCmd in_BMS_rChargeLimitErr in_BMS_rCoolingPower in_BMS_rCurrent in_BMS_rDischargeLimitErr in_BMS_rDischargeLimitErrTemp in_BMS_rMaxAviableChargeCurrent in_BMS_rMaxAviableDischargeCurrent in_BMS_rMaxAviableTemperature in_BMS_rMaxAviableVoltage in_BMS_rSOC in_BMS_rTemperature in_BMS_rVoltage in_BMS_xChargeCmd in_BMS_xCooling in_BMS_xHeating in_BMS_xLimpErr in_BMS_xPowerOffRequestFromBMS in_DCAC2Control_xErr in_DCDCControl_xErr in_GPS_xAppNetOff in_GPS_xCarrierNetOff in_GPS_xHeartbeatOff in_GPS_xSimCardOff in_M1_rACCurrent in_M1_rACVoltage in_M1_rBusCurrent in_M1_rBusVoltage in_M1_rControllerTemp in_M1_rLimitErr in_M1_rMotorTemp in_M1_rSpeed in_M1_rTorque in_M1_rTorqueNegtiveLimit in_M1_rTorquePositiveLimit in_M1_u8ErrCode in_M1_u8ErrLevel in_M1_u8WorkMode in_M1_xPreChargeAllowed in_M1_xReady in_M1_xResetErr in_M1_xStopErr in_M2_Err_xControllerCurrentSensorErr in_M2_Err_xControllerIGBTErr in_M2_Err_xControllerLosePhase in_M2_Err_xControllerLowVoltageBelow in_M2_Err_xControllerOverCurrent in_M2_Err_xControllerOverTemp in_M2_Err_xControllerTempSenorErr in_M2_Err_xMotorBlocked in_M2_Err_xMotorBusVoltageBelow in_M2_Err_xMotorBusVoltageOver in_M2_Err_xMotorCanErr in_M2_Err_xMotorEncoderErr in_M2_Err_xMotorOverLoad in_M2_Err_xMotorOverSpeed in_M2_Err_xMotorOverTemp in_M2_Err_xMotorTempSensorErr in_M2_rACCurrent in_M2_rACVoltage in_M2_rBusCurrent in_M2_rBusVoltage in_M2_rControllerTemp in_M2_rLimitErr in_M2_rMotorTemp in_M2_rSpeed in_M2_rTorque in_M2_u8ErrCode in_M2_u8ErrLevel in_M2_u8WorkMode in_M2_xPreChargeAllowed in_M2_xReady in_M2_xResetErr in_M2_xStopErr in_M3_xErr in_OBC_Err_xChargeCanErr in_OBC_Err_xHardwareErr in_OBC_Err_xInputVoltageErr in_OBC_Err_xOverTemp in_OBC_rCurrent in_OBC_rVoltage in_OBC_xErr in_OBC_xIsWakeup in_OBC_xReady in_OBC_xRunning in_S2_Err_xRM1AOutOfInitialstate in_S2_Err_xRM1OutOfInitialstate in_S2_Err_xTCUOutOfInitalGearLevel in_u16BQ1 in_u16BQ2 in_u16BQ3 in_u16BQ4 in_u16RM1 in_u16RM1A in_wAI03_X16 in_wAI04_X35 in_wAI05_X17 in_wAI06_X36 in_wAI07_X18 in_wAI08_X37 in_wAI09_X71 in_wAI11_X24 in_wAI12_X62 in_wAI15_X20 in_wAI16_X22 in_wAI17_X79 in_wAI18_X23 in_wAI19_X61 in_wAI20_X72 in_wSystemVoltage in_xDI01_X42 in_xDI02_X52 in_xDI03_X53 in_xDI04_X38 in_xDI07_X43 in_xDI08_X31 in_xDI09_X25 in_xDI10_X65 in_xDI12_X21 in_xDI13_X26 in_xDI15_X45 in_xDI16_X63 in_xDI17_X67 in_xDI18_X68 in_xDI21_X40 in_xDI22_X81 in_xDI31_X64 in_xDI32_X47 in_xDI33_X66 in_xDI34_X08 in_xKeyOn_X59 in_xS1 in_xS2 in_xS3 in_xS4 in_xS5 in_xS8D1 in_xS8D2 in_xS8D3 in_xS8D4 in_xS8R in_xSHA1 in_xSM1 in_xSM1A in_xSM2H in_xSM2L in_xSM3 in_xSQ1 msr_gcp_M1Eff_TopGear145KW_aarEff_42_12 msr_gcp_M1Eff_TopGear145KW_arSpeed_1_12 msr_gcp_M1Eff_TopGear145KW_arTorque_1_42 msr_gcp_M1Eff_TopGear220KW_aarEff_28_11 msr_gcp_M1Eff_TopGear220KW_arSpeed_1_11 msr_gcp_M1Eff_TopGear220KW_arTorque_1_28 msr_gcp_M1Eff_TopGear286KW_aarEff_20_10 msr_gcp_M1Eff_TopGear286KW_arSpeed_1_10 msr_gcp_M1Eff_TopGear286KW_arTorque_1_20 msr_gcp_M1External_TopGear145KW_arPeakSpeed_9_1 msr_gcp_M1External_TopGear145KW_arPeakTroque_9_1 msr_gcp_M1External_TopGear220KW_arPeakSpeed_1_12 msr_gcp_M1External_TopGear220KW_arPeakTroque_1_12 msr_gcp_M1External_TopGear286KW_arPeakSpeed_1_10 msr_gcp_M1External_TopGear286KW_arPeakTroque_1_10 msr_gcp_M1test_1_5 msr_gcp_M1test_2_5 msr_gcp_M1test_6_1 msr_gcp_M1test_6_2 out_Dial_rSpeed out_Dial_rTorque out_GPS_xAntiCrackActived out_GPS_xLockingActived out_GPS_xTempResetBusy out_Hook_rSpeed out_M1_rSpeedCmd out_M1_rTorqueCmd out_M1_xQuickDrainCmd out_M1_xRM1AMode out_M1_xSpeedCmd out_M1_xTorqueCmd out_M2_rSpeedCmd out_M2_xQuickDrainCmd out_M2_xSpeedCmd out_OBC_rChargeCurrentCmd out_OBC_rChargePowerCmd out_OBC_xACChargeCmd out_OBC_xACRechargeCmd out_u8WindSpeedLevel out_xHA1 out_xHSO01_X108 out_xHSO02_X100 out_xHSO03_X107 out_xHSO04_X99 out_xHSO05_X106 out_xHSO06_X98 out_xHSO07_X94 out_xHSO08_X86 out_xHSO10_X114 out_xHSO14_X85 out_xLSO01_X95 out_xLSO02_X109 out_xLSO03_X90 out_xLSO04_X101 out_xLSO06_X96 out_xLSO07_X110 out_xLSO08_X89 out_xLSO09_X112 out_xLSO10_X111 out_xLSO11_X102 out_xLSO12_X103 out_xLSO13_X88 out_xLSO14_X113 out_xLSO15_X104 out_xLSO16_X105 out_xLSO17_X93 out_xLSO18_X92 out_xLSO19_X91 out_xPTO test_msr_bool test_msr_double test_msr_enum test_msr_float test_msr_s16 test_msr_s32 test_msr_s8 test_msr_u16 test_msr_u32 test_msr_u8 /end REF_MEASUREMENT
/end GROUP
/begin GROUP Root_IECDownload_Init_Subsystem "SC_KZQ_EV2274A_4_1/IECDownload Init Subsystem" /begin REF_CHARACTERISTIC System_gcp_eMachineModel core_gcp_byNVMOperation_Store /end REF_CHARACTERISTIC /end GROUP
/begin GROUP Root_Main "SC_KZQ_EV2274A_4_1/Main"
 /begin SUB_GROUP S5_CAN_IO S5_CAN_SDO S5_CAN_Status S5_Control_Layer S5_GPS_ S5_Miscellaneous_Layer S5__XJ_Model_Link_ S5_gsn_variable_default /end SUB_GROUP
/end GROUP
/begin GROUP Root_NVM_Operation_Subsystem "SC_KZQ_EV2274A_4_1/NVM Operation Subsystem" /begin SUB_GROUP S6_Reset_NVMOperation /end SUB_GROUP
 /begin REF_CHARACTERISTIC core_gcp_byNVMOperation_Restore core_gcp_byNVMOperation_Store /end REF_CHARACTERISTIC
/end GROUP
/begin GROUP Root_Simulation_Binding "SC_KZQ_EV2274A_4_1/Simulation Binding" /begin SUB_GROUP S8_Input_Vairables S8_Retain_Variables /end SUB_GROUP /end GROUP
/begin GROUP Root_SystemClock "SC_KZQ_EV2274A_4_1/SystemClock" /begin REF_CHARACTERISTIC core_gp_u32SystemCountingFre /end REF_CHARACTERISTIC /end GROUP
/begin GROUP S5__XJ_Model_Link_ "SC_KZQ_EV2274A_4_1/Main/ XJ Model Link "
 /begin SUB_GROUP S63_Model_XJ1100_0101 S63_Model_XJ1350_0101 S63_Model_XJ1600_0101 S63_Model_XJ900_0101 S63_Model_XJ900_0201 S63_Model_XJ900_0301 /end SUB_GROUP
 /begin REF_MEASUREMENT System_gsn_eMachineModel_Disp /end REF_MEASUREMENT
/end GROUP
/begin GROUP S5_CAN_IO "SC_KZQ_EV2274A_4_1/Main/CAN IO" /begin REF_CHARACTERISTIC System_gp_Model_xSimulation /end REF_CHARACTERISTIC /end GROUP
/begin GROUP S5_CAN_SDO "SC_KZQ_EV2274A_4_1/Main/CAN SDO" /begin SUB_GROUP S66_Enabled_Subsystem S66_SDO__0x7C /end SUB_GROUP
 /begin REF_MEASUREMENT gsn_DCDC_rWorkVoltage_Disp gsn_M3_rWorkSpeed_Disp gsn_u32Enable_6508h_001_Disp gsn_u32Enable_6508h_010_Disp gsn_u32Enable_6508h_020_Disp /end REF_MEASUREMENT
/end GROUP
/begin GROUP S5_CAN_Status "SC_KZQ_EV2274A_4_1/Main/CAN Status" /begin SUB_GROUP S67_value_To_uint8_4_1 S67_value_To_uint8_4_2 /end SUB_GROUP
 /begin REF_MEASUREMENT Can_Z1_u32PeriodTime_Disp Can_Z1_u8Ports_Disp System_HeartBeat_gsn_byDispType_Disp /end REF_MEASUREMENT
/end GROUP
/begin GROUP S5_Control_Layer "SC_KZQ_EV2274A_4_1/Main/Control Layer" /begin SUB_GROUP S68_fbM1Contol /end SUB_GROUP
 /begin REF_MEASUREMENT gsn_BMS_rLimpCurrent_Disp gsn_Charge_rMaxChargePower_Disp gsn_Charge_rMaxDischargeCurrentInCharging_Disp gsn_Charge_rStartBMSTempForLimiting_Disp gsn_Charge_rStartSOCForLimiting_Disp gsn_Dial_rRearTransCoef_Disp gsn_Dial_rRearTransEff_Disp gsn_Hook_rRearTransCoef_Disp gsn_M1Regen_rRegenIntensity_Disp gsn_M1Trans_GearLevelRatio_rD1_Disp gsn_M1Trans_GearLevelRatio_rD2_Disp gsn_M1Trans_GearLevelRatio_rD3_Disp gsn_M1Trans_GearLevelRatio_rD4_Disp gsn_M1_rMaxHookSpeed_Disp gsn_M1_rMaxMotorSpeed_Disp gsn_M2_rSM2HSpeed_Disp gsn_M2_rSM2LSpeed_Disp gsn_M3_rRatedPower_Disp gsn_M3_rStartPressure_Disp gsn_M3_rStopPressure_Disp /end REF_MEASUREMENT
/end GROUP
/begin GROUP S5_GPS_ "SC_KZQ_EV2274A_4_1/Main/GPS "
 /begin SUB_GROUP S70_SDO__0x7B S70_value_To_uint8_4_ S70_value_To_uint8_4_1 S70_value_To_uint8_4_2 S70_value_To_uint8_4_3 S70_value_To_uint8_4_4 S70_value_To_uint8_4_5 /end SUB_GROUP
 /begin REF_MEASUREMENT gsn_GPS_imAntiCrack_Disp gsn_GPS_timAntiCrackRemaining_Disp gsn_GPS_u32Directive_Disp gsn_GPS_u32KeyGroup1_Disp gsn_GPS_u32KeyGroup2_Disp /end REF_MEASUREMENT
/end GROUP
/begin GROUP S5_Miscellaneous_Layer "SC_KZQ_EV2274A_4_1/Main/Miscellaneous Layer"
 /begin REF_MEASUREMENT gsn_Statistics_u32CumulativeWorkSeconds_Disp gsn_Statistics_u32M1CumulativeWorkSeconds_Disp /end REF_MEASUREMENT
/end GROUP
/begin GROUP S5_gsn_variable_default "SC_KZQ_EV2274A_4_1/Main/gsn variable default" /begin REF_CHARACTERISTIC core_gcp_byNVMOperation_Store /end REF_CHARACTERISTIC /end GROUP
/begin GROUP S6_Reset_NVMOperation "SC_KZQ_EV2274A_4_1/NVM Operation Subsystem/Reset NVMOperation" /begin REF_CHARACTERISTIC core_gcp_byNVMOperation_None /end REF_CHARACTERISTIC /end GROUP
/begin GROUP S8_Input_Vairables "SC_KZQ_EV2274A_4_1/Simulation Binding/Input Vairables"
 /begin REF_CHARACTERISTIC fbBMSPower_xOffProcessDone_gp fbBMSPower_xOffWaitingDone_gp fbBMSPower_xOnProcessDone_gp fbBMSPower_xOnProcessErr_gp fbBMSPower_xPowerHoldErr_gp fbBMSPower_xStandbyErr_gp fbDCAC2Power_xOffProcessDone_gp fbDCAC2Power_xOnProcessDone_gp fbDCACPower_xOffProcessDone_gp fbDCACPower_xOnProcessDone_gp fbDCDCPower_xOffProcessDone_gp fbDCDCPower_xOnProcessDone_gp fbM1GearControl_eCurrentGearFeedback_gp fbM1GearControl_eTargetGearFeedback_gp fbM1Power_xOffContactorDone_gp fbM1Power_xOffControllerDone_gp fbM1Power_xOffMotorDone_gp fbM1Power_xOnContactorDone_gp fbM1Power_xPreChargeDone_gp fbM2Power_xOffContactorDone_gp fbM2Power_xOffControllerDone_gp fbM2Power_xOffMotorDone_gp fbM2Power_xOnContactorDone_gp fbM2Power_xOnPreChargeDone_gp fbOBCPower_xOffProcessDone_gp fbOBCPower_xOnProcessDone_gp gs_M1_eMotorModel_gp gs_M2_eMotorModel_gp in_A1_rM2HighSpeed_gp in_A1_rM2LowSpeed_gp in_A1_rMaxAllowedChargePower_gp in_A1_xACChargeModeRequest_gp in_A1_xACRechargeModeRequest_gp in_A1_xChargeRequest_gp in_A1_xRemoteRequestAviable_gp in_BMS_rChargeCurrentCmd_gp in_BMS_rChargeLimitErr_gp in_BMS_rCoolingPower_gp in_BMS_rCurrent_gp in_BMS_rDischargeLimitErrTemp_gp in_BMS_rMaxAviableChargeCurrent_gp in_BMS_rMaxAviableDischargeCurrent_gp in_BMS_rMaxAviableTemperature_gp in_BMS_rMaxAviableVoltage_gp in_BMS_rSOC_gp in_BMS_rTemperature_gp in_BMS_rVoltage_gp in_BMS_xChargeCmd_gp in_BMS_xCooling_gp in_BMS_xHeating_gp in_BMS_xLimpErr_gp in_BMS_xPowerOffRequestFromBMS_gp in_DCAC2Control_xErr_gp in_DCDCControl_xErr_gp in_M1_rACCurrent_gp in_M1_rACVoltage_gp in_M1_rBusCurrent_gp in_M1_rBusVoltage_gp in_M1_rControllerTemp_gp in_M1_rLimitErr_gp in_M1_rMotorTemp_gp in_M1_rSpeed_gp in_M1_rTorqueNegtiveLimit_gp in_M1_rTorquePositiveLimit_gp in_M1_rTorque_gp in_M1_xPreChargeAllowed_gp in_M1_xReady_gp in_M1_xResetErr_gp in_M1_xStopErr_gp in_M2_rACCurrent_gp in_M2_rACVoltage_gp in_M2_rBusCurrent_gp in_M2_rBusVoltage_gp in_M2_rControllerTemp_gp in_M2_rLimitErr_gp in_M2_rMotorTemp_gp in_M2_rSpeed_gp in_M2_rTorque_gp in_M2_xPreChargeAllowed_gp in_M2_xReady_gp in_M2_xResetErr_gp in_M2_xStopErr_gp in_M3_xErr_gp in_OBC_rCurrent_gp in_OBC_rVoltage_gp in_OBC_xErr_gp in_OBC_xIsWakeup_gp in_OBC_xReady_gp in_u16BQ1_gp in_u16BQ2_gp in_u16BQ3_gp in_u16BQ4_gp in_u16RM1A_gp in_u16RM1_gp in_xS1_gp in_xS2_gp in_xS3_gp in_xS4_gp in_xS5_gp in_xS8D1_gp in_xS8D2_gp in_xS8D3_gp in_xS8D4_gp in_xS8R_gp in_xSHA1_gp in_xSM1A_gp in_xSM1_gp in_xSM2H_gp in_xSM2L_gp in_xSM3_gp /end REF_CHARACTERISTIC
/end GROUP
/begin GROUP S63_Model_XJ1100_0101 "SC_KZQ_EV2274A_4_1/Main/ XJ Model Link /Model XJ1100_0101" /begin REF_CHARACTERISTIC System_gp_Model_xSimulation /end REF_CHARACTERISTIC /end GROUP
/begin GROUP S63_Model_XJ1350_0101 "SC_KZQ_EV2274A_4_1/Main/ XJ Model Link /Model XJ1350_0101" /begin REF_CHARACTERISTIC System_gp_Model_xSimulation /end REF_CHARACTERISTIC /end GROUP
/begin GROUP S63_Model_XJ1600_0101 "SC_KZQ_EV2274A_4_1/Main/ XJ Model Link /Model XJ1600_0101" /begin REF_CHARACTERISTIC System_gp_Model_xSimulation /end REF_CHARACTERISTIC /end GROUP
/begin GROUP S63_Model_XJ900_0101 "SC_KZQ_EV2274A_4_1/Main/ XJ Model Link /Model XJ900_0101" /begin REF_CHARACTERISTIC System_gp_Model_xSimulation /end REF_CHARACTERISTIC /end GROUP
/begin GROUP S63_Model_XJ900_0201 "SC_KZQ_EV2274A_4_1/Main/ XJ Model Link /Model XJ900_0201" /begin REF_CHARACTERISTIC System_gp_Model_xSimulation /end REF_CHARACTERISTIC /end GROUP
/begin GROUP S63_Model_XJ900_0301 "SC_KZQ_EV2274A_4_1/Main/ XJ Model Link /Model XJ900_0301" /begin REF_CHARACTERISTIC System_gp_Model_xSimulation /end REF_CHARACTERISTIC /end GROUP
/begin GROUP S66_Enabled_Subsystem "SC_KZQ_EV2274A_4_1/Main/CAN SDO/Enabled Subsystem" /begin REF_CHARACTERISTIC core_gcp_byNVMOperation_Store /end REF_CHARACTERISTIC /end GROUP
/begin GROUP S68_fbM1Contol "SC_KZQ_EV2274A_4_1/Main/Control Layer/fbM1Contol"
 /begin REF_CHARACTERISTIC gcp_M1Eff_TopGear145KW_aarEff gcp_M1Eff_TopGear220KW_aarEff gcp_M1Eff_TopGear286KW_aarEff gcp_M1External_TopGear145KW_arPeakSpeed gcp_M1External_TopGear220KW_arPeakSpeed gcp_M1External_TopGear286KW_arPeakSpeed /end REF_CHARACTERISTIC
/end GROUP
/begin GROUP S5186_Triggered_Retain_Store "SC_KZQ_EV2274A_4_1/Simulation Binding/Retain Variables/Triggered Retain Store" /begin REF_CHARACTERISTIC core_gcp_byNVMOperation_Store /end REF_CHARACTERISTIC /end GROUP
/begin GROUP S76_Model_RetainInit_Subsystem "SC_KZQ_EV2274A_4_1/Main/ XJ Model Link /Model XJ1100_0101/Model RetainInit Subsystem" /begin REF_CHARACTERISTIC core_gcp_byNVMOperation_Store /end REF_CHARACTERISTIC /end GROUP
/begin GROUP S77_Model_RetainInit_Subsystem "SC_KZQ_EV2274A_4_1/Main/ XJ Model Link /Model XJ1350_0101/Model RetainInit Subsystem" /begin REF_CHARACTERISTIC core_gcp_byNVMOperation_Store /end REF_CHARACTERISTIC /end GROUP
/begin GROUP S78_Model_RetainInit_Subsystem "SC_KZQ_EV2274A_4_1/Main/ XJ Model Link /Model XJ1600_0101/Model RetainInit Subsystem" /begin REF_CHARACTERISTIC core_gcp_byNVMOperation_Store /end REF_CHARACTERISTIC /end GROUP
/begin GROUP S79_Model_RetainInit_Subsystem "SC_KZQ_EV2274A_4_1/Main/ XJ Model Link /Model XJ900_0101/Model RetainInit Subsystem" /begin REF_CHARACTERISTIC core_gcp_byNVMOperation_Store /end REF_CHARACTERISTIC /end GROUP
/begin GROUP S80_Model_RetainInit_Subsystem "SC_KZQ_EV2274A_4_1/Main/ XJ Model Link /Model XJ900_0201/Model RetainInit Subsystem" /begin REF_CHARACTERISTIC core_gcp_byNVMOperation_Store /end REF_CHARACTERISTIC /end GROUP
/begin GROUP S81_Model_RetainInit_Subsystem "SC_KZQ_EV2274A_4_1/Main/ XJ Model Link /Model XJ900_0301/Model RetainInit Subsystem" /begin REF_CHARACTERISTIC core_gcp_byNVMOperation_Store /end REF_CHARACTERISTIC /end GROUP
/end MODULE
/end PROJECT
/* (add any file trailer comments here) */ /* EOF SC_KZQ_EV2274A_4_1.a2l */
